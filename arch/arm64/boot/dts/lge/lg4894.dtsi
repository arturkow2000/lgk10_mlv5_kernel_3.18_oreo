/*
 * LG Electronics lg4894 touch device tree source
 *
 * Copyright (c) 2016 LG Electronics Co., Ltd.
 *              http://www.lge.com
 *
 */

lg4894@28 {
	status = "okay";
	compatible = "lge,lg4894";
	reg = <0x28>;
	interrupt-parent = <&eintc>;
	interrupts = <1 0x2002>;
	debounce = <1 0>;
	irqflags = <0x2002>;

	pinctrl-names = "default", "touch_pin_active", "touch_pin_sleep";
	pinctrl-0 = <&ts_pin_default>;
	pinctrl-1 = <&ts_pin_active>;
	pinctrl-2 = <&ts_pin_suspend>;

	reset-gpio = <&pio 10 0x00>;
	irq-gpio = <&pio 1 0x2002>;
	maker_id-gpio = <&pio 17 0x00>;

	/* Caps */
	max_x = <720>;
	max_y = <1280>;
	max_pressure = <0xff>;
	max_width = <15>;
	max_orientation = <1>;
	max_id = <10>;

	/* role */
	hw_reset_delay = <210>;
	sw_reset_delay = <90>;
	use_lpwg = <1>;
	use_lpwg_test = <1>;
	hide_coordinate = <1>;

	/* firmware */
	use_fw_upgrade = <1>;
	use_firmware = <0>;
	fw_image = "touch/lv5/sic/L0W53LV5_1_06.img", /* for revision 9 & lcd fpcb revision 2 */
	           "touch/lv5/sic/L0W53LV5_1_09.img", /* for revision 9 & lcd fpcb revision 4 */
	           "touch/lv5/sic/L0W53LV5_1_19.img"; /* for revision 9 & lcd fpcb revision 5 */
	panel_spec = "touch/lv5/sic/lv5_limit.txt";
	panel_spec_mfts_folder = "touch/lv5/sic/lv5_limit_mfts.txt";
};
