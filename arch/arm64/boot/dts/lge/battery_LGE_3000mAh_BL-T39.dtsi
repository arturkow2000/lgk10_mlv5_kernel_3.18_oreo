/* Typical 3000mAh Battery, 3.3V cut-off */

&odm {
	fg,lgc-battery-data {
		/* Qmax for 0mA */
		q_max_pos_50 = <3009>;
		q_max_pos_25 = <2989>;
		q_max_pos_0 = <2808>;
		q_max_neg_10 = <1897>;
		/* Qmax for 400mA, said high current */
		q_max_pos_50_h_current = <2997>;
		q_max_pos_25_h_current = <2962>;
		q_max_pos_0_h_current = <2577>;
		q_max_neg_10_h_current = <1271>;

		/* Battery Temperature Table */
		batt_temperature_table_num = <21>;
		/* NTC 68 murata thermistor */
		batt_temperature_table = <
			(-20) 738978
			(-15) 485782
			(-10) 409600
			(-5) 309217
			0 235606
			5 180980
			10 140139
			15 109344
			20 85929
			25 68000
			30 53885
			35 42973
			40 34479
			45 27827
			50 22584
			55 18429
			60 15116
			65 12462
			70 10324
			75 8593
			80 7184 >;

		battery_profile_t0_num = <69>;
		battery_profile_t0 = <
			0 4297		3 4261 		5 4233 		8 4203 		11 4171
			13 4136 	16 4099 	18 4070 	21 4040 	24 4004
			26 3971 	29 3948 	32 3931 	34 3919 	37 3909
			39 3898 	42 3887 	45 3876 	47 3865 	50 3855
			53 3846 	55 3836 	58 3825 	61 3815 	63 3805
			66 3794 	68 3782 	71 3772 	74 3759 	76 3748
			79 3737 	82 3727 	84 3718 	87 3710 	89 3697
			92 3667 	95 3604 	96 3561 	97 3530 	98 3507
			98 3487 	98 3471 	99 3458 	99 3448 	99 3441
			99 3435 	99 3430 	99 3426 	99 3423 	99 3421
			99 3419		99 3416		100 3414	100 3413 	100 3412
			100 3410 	100 3408 	100 3407 	100 3405 	100 3404
			100 3401 	100 3399 	100 3397 	100 3395 	100 3393
			100 3392 	100 3391 	100 3389 	100 3300
		>;
		battery_profile_t1_num = <69>;
		battery_profile_t1 = <
			0 4350 		2 4320 		4 4280 		5 4238 		7 4210
			9 4189 		11 4170 	12 4151 	14 4133 	16 4115
			18 4099 	20 4088 	21 4076 	23 4052 	25 4021
			27 3996 	28 3977 	30 3965 	32 3956 	34 3946
			36 3933 	37 3920 	39 3903 	41 3887 	43 3873
			44 3860 	46 3849 	48 3840 	50 3831 	52 3824
			53 3817 	55 3810 	57 3804 	59 3798 	60 3793
			62 3789 	64 3785 	66 3784 	68 3781 	69 3779
			71 3775 	73 3772 	75 3767 	76 3762 	78 3754
			80 3746 	82 3737 	84 3727 	85 3716 	87 3707
			89 3701 	91 3695 	92 3686 	94 3659 	96 3598
			98 3523 	98 3472 	99 3429 	99 3392 	99 3361
			100 3336 	100 3315 	100 3296 	100 3282 	100 3270
			100 3259 	100 3250 	100 3243 	100 3243
		>;
		battery_profile_t2_num = <69>;
		battery_profile_t2 = <
			0 4370 		2 4340 		3 4317 		5 4296 		7 4276
			8 4256 		10 4237 	12 4218 	13 4199 	15 4180
			17 4161 	18 4144 	20 4126 	22 4108 	23 4091
			25 4075 	27 4065 	28 4046 	30 4021 	32 4000
			33 3987 	35 3978 	37 3968 	38 3955 	40 3942
			42 3928 	43 3911 	45 3891 	47 3875 	48 3862
			50 3852 	52 3844 	53 3836 	55 3828 	57 3821
			58 3814 	60 3808 	62 3803 	63 3798 	65 3793
			67 3788 	68 3784 	70 3779 	72 3774 	73 3769
			75 3762 	77 3756 	78 3748 	80 3743 	82 3737
			83 3727 	85 3717 	87 3707 	88 3694 	90 3691
			92 3689 	93 3686 	95 3668 	97 3599 	99 3493
			100 3280 	100 3169 	100 3105 	100 3081 	100 3069
			100 3063 	100 3063 	100 3063 	100 3063
		>;
		battery_profile_t3_num = <69>;
		battery_profile_t3 = <
			0 4386 		2 4354 		3 4329 		5 4307 		7 4286
			8 4265 		10 4246 	12 4227 	13 4208 	15 4189
			17 4170 	18 4152 	20 4133 	22 4116 	23 4099
			25 4081 	27 4064 	28 4048 	30 4033 	31 4016
			33 4001 	35 3987 	36 3974 	38 3961 	40 3947
			41 3935 	43 3922 	45 3904 	46 3882 	48 3868
			50 3857 	51 3847 	53 3839 	55 3831 	56 3824
			58 3816 	60 3809 	61 3803 	63 3798 	65 3792
			66 3787 	68 3783 	70 3777 	71 3771 	73 3758
			75 3750 	76 3742 	78 3735 	80 3729 	81 3723
			83 3715 	85 3704 	86 3695 	88 3682 	90 3677
			91 3676 	93 3673 	95 3665 	96 3615 	98 3531
			100 3389 	100 3164 	100 3087 	100 3058 	100 3049
			100 3042 	100 3041 	100 3041 	100 3041
		>;
		r_profile_t0_num = <69>;
		r_profile_t0 = <
			193 4297 	808 4261 	850 4233 	873 4203 	903 4171
			943 4136 	1030 4099 	1155 4070 	1203 4040 	1210 4004
			1208 3971 	1203 3948 	1203 3931 	1205 3919 	1210 3909
			1210 3898 	1213 3887 	1215 3876 	1213 3865 	1213 3855
			1218 3846 	1218 3836 	1220 3825 	1223 3815 	1223 3805
			1220 3794 	1223 3782 	1233 3772 	1243 3759 	1255 3748
			1275 3737 	1298 3727 	1320 3718 	1353 3710 	1398 3697
			1445 3667 	1488 3604 	1403 3561 	1325 3530 	1270 3507
			1220 3487 	1178 3471 	1148 3458 	1125 3448 	1103 3441
			1090 3435 	1083 3430 	1068 3426 	1063 3423 	1055 3421
			1048 3419 	1048 3416 	1040 3414 	1035 3413 	1040 3412
			1030 3410 	1030 3408 	1018 3407 	1028 3405 	1020 3404
			1018 3401 	1010 3399 	1003 3397 	1003 3395 	1000 3393
			985 3392 	980 3391 	985 3389 	770 3300
		>;
		r_profile_t1_num = <69>;
		r_profile_t1 = <
			180 4350 	335 4320 	345 4280 	405 4238 	450 4210
			470 4189 	475 4170 	478 4151 	478 4133 	480 4115
			488 4099 	508 4088 	533 4076 	528 4052 	508 4021
			498 3996 	490 3977 	495 3965 	505 3956 	508 3946
			500 3933 	498 3920 	488 3903 	480 3887 	473 3873
			470 3860 	468 3849 	470 3840 	470 3831 	475 3824
			475 3817 	478 3810 	480 3804 	478 3798 	478 3793
			485 3789 	490 3785 	505 3784 	513 3781 	530 3779
			543 3775 	563 3772 	578 3767 	600 3762 	618 3754
			643 3746 	663 3737 	690 3727 	728 3716 	775 3707
			838 3701 	913 3695 	1008 3686 	1105 3659 	1208 3598
			1308 3523 	1183 3472 	1080 3429 	980 3392 	910 3361
			848 3336 	795 3315 	745 3296 	708 3282 	675 3270
			650 3259 	635 3250 	618 3243 	608 3243
		>;
		r_profile_t2_num = <69>;
		r_profile_t2 = <
			128 4370 	148 4340 	145 4317 	148 4296 	150 4276
			148 4256 	150 4237 	153 4218 	155 4199 	155 4180
			155 4161 	160 4144 	160 4126 	160 4108 	165 4091
			165 4075 	178 4065 	175 4046 	173 4021 	178 4000
			180 3987 	188 3978 	188 3968 	188 3955 	190 3942
			185 3928 	178 3911 	160 3891 	150 3875 	145 3862
			145 3852 	148 3844 	148 3836 	148 3828 	150 3821
			148 3814 	150 3808 	153 3803 	155 3798 	158 3793
			158 3788 	160 3784 	155 3779 	155 3774 	153 3769
			148 3762 	148 3756 	143 3748 	148 3743 	150 3737
			150 3727 	153 3717 	158 3707 	150 3694 	153 3691
			163 3689 	178 3686 	193 3668 	198 3599 	240 3493
			398 3280 	430 3169 	283 3105 	210 3081 	178 3069
			165 3063 	160 3063 	160 3063 	208 3063
		>;
		r_profile_t3_num = <69>;
		r_profile_t3 = <
			115 4386 	105 4354 	103 4329 	103 4307 	103 4286
			100 4265 	103 4246 	105 4227 	105 4208 	105 4189
			105 4170 	108 4152 	108 4133 	110 4116 	113 4099
			110 4081 	113 4064 	115 4048 	118 4033 	115 4016
			118 4001 	120 3987 	125 3974 	128 3961 	128 3947
			133 3935 	138 3922 	128 3904 	110 3882 	105 3868
			103 3857 	105 3847 	105 3839 	108 3831 	110 3824
			108 3816 	110 3809 	110 3803 	115 3798 	115 3792
			115 3787 	120 3783 	118 3777 	120 3771 	105 3758
			108 3750 	105 3742 	105 3735 	108 3729 	108 3723
			108 3715 	105 3704 	105 3695 	105 3682 	105 3677
			110 3676 	115 3673 	120 3665 	125 3615 	148 3531
			183 3389 	415 3164 	228 3087 	150 3058 	133 3049
			125 3042 	110 3041 	105 3041 	110 3041
		>;
	};

	fg,tocad-battery-data {
		/* Qmax for 0mA */
		q_max_pos_50 = <2945>;
		q_max_pos_25 = <2904>;
		q_max_pos_0 = <2693>;
		q_max_neg_10 = <2341>;
		/* Qmax for 400mA, said high current */
		q_max_pos_50_h_current = <2934>;
		q_max_pos_25_h_current = <2889>;
		q_max_pos_0_h_current = <2317>;
		q_max_neg_10_h_current = <1473>;

		/* Battery Temperature Table */
		batt_temperature_table_num = <21>;
		/* NTC 68 murata thermistor */
		batt_temperature_table = <
			(-20) 738978
			(-15) 485782
			(-10) 409600
			(-5) 309217
			0 235606
			5 180980
			10 140139
			15 109344
			20 85929
			25 68000
			30 53885
			35 42973
			40 34479
			45 27827
			50 22584
			55 18429
			60 15116
			65 12462
			70 10324
			75 8593
			80 7184 >;

		battery_profile_t0_num = <69>;
		battery_profile_t0 = <
			0 4306 		2 4276 		4 4248 		6 4225 		9 4202
			11 4178 	13 4154 	15 4120 	17 4070 	19 4038
			21 4012 	23 3991 	26 3974 	28 3958 	30 3941
			32 3923 	34 3905 	36 3890 	38 3876 	40 3865
			43 3855 	45 3845 	47 3836 	49 3828 	51 3821
			53 3815 	55 3808 	58 3803 	60 3799 	62 3795
			64 3791 	66 3787 	68 3782 	70 3777 	72 3772
			75 3765 	77 3758 	79 3749 	81 3739 	83 3727
			85 3716 	87 3706 	89 3699 	92 3693 	94 3681
			95 3656 	96 3625 	97 3595 	97 3569 	98 3546
			98 3524 	99 3505 	99 3489 	99 3474 	99 3460
			99 3449 	99 3438 	99 3430 	100 3421 	100 3414
			100 3409 	100 3404 	100 3399 	100 3394 	100 3392
			100 3387 	100 3384 	100 3381 	100 3300
		>;
		battery_profile_t1_num = <69>;
		battery_profile_t1 = <
			0 4348 		2 4307 		4 4247 		6 4217 		7 4195
			9 4174 		11 4154 	13 4136 	15 4117 	17 4100
			18 4084 	20 4069 	22 4049 	24 4025 	26 4003
			28 3986 	30 3973 	31 3962 	33 3947 	35 3931
			37 3912 	39 3894 	41 3880 	43 3866 	44 3855
			46 3845 	48 3835 	50 3827 	52 3820 	54 3814
			56 3807 	57 3802 	59 3796 	61 3792 	63 3788
			65 3786 	67 3782 	69 3780 	70 3777 	72 3772
			74 3768 	76 3763 	78 3755 	80 3749 	81 3740
			83 3729 	85 3718 	87 3705 	89 3696 	91 3691
			93 3686 	94 3675 	96 3620 	97 3561 	98 3516
			99 3476 	99 3441 	99 3407 	99 3377 	100 3352
			100 3329 	100 3309 	100 3292 	100 3280 	100 3270
			100 3262 	100 3255 	100 3252 	100 3252
		>;
		battery_profile_t2_num = <69>;
		battery_profile_t2 = <
			0 4370 		2 4344 		3 4323 		5 4302 		7 4282
			9 4262 		10 4243 	12 4223 	14 4203 	15 4183
			17 4164 	19 4145 	21 4128 	22 4109 	24 4091
			26 4074 	27 4059 	29 4042 	31 4024 	33 4006
			34 3993 	36 3980 	38 3967 	39 3952 	41 3936
			43 3916 	45 3895 	46 3880 	48 3869 	50 3858
			52 3849 	53 3840 	55 3833 	57 3825 	58 3818
			60 3811 	62 3806 	64 3800 	65 3796 	67 3790
			69 3785 	70 3780 	72 3774 	74 3767 	76 3760
			77 3753 	79 3746 	81 3741 	82 3733 	84 3724
			86 3715 	88 3703 	89 3692 	91 3689 	93 3687
			94 3682 	96 3641 	98 3550 	100 3390 	100 3148
			100 3097 	100 3077 	100 3074 	100 3068 	100 3070
			100 3062 	100 3063 	100 3063 	100 3063
		>;
		battery_profile_t3_num = <69>;
		battery_profile_t3 = <
			0 4385 		2 4355 		3 4331 		5 4309 		7 4288
			8 4268 		10 4248 	12 4229 	14 4209 	15 4189
			17 4171 	19 4151 	20 4133 	22 4115 	24 4097
			25 4079 	27 4062 	29 4046 	30 4030 	32 4014
			34 3999 	36 3985 	37 3972 	39 3958 	41 3944
			42 3930 	44 3910 	46 3888 	47 3874 	49 3863
			51 3853 	52 3844 	54 3836 	56 3827 	58 3820
			59 3813 	61 3807 	63 3800 	64 3795 	66 3790
			68 3786 	69 3781 	71 3775 	73 3761 	75 3751
			76 3745 	78 3736 	80 3730 	81 3724 	83 3716
			85 3707 	86 3697 	88 3684 	90 3678 	91 3676
			93 3674 	95 3662 	97 3606 	98 3517 	100 3325
			100 3105 	100 3073 	100 3061 	100 3058 	100 3054
			100 3048 	100 3047 	100 3045 	100 3045
		>;
		r_profile_t0_num = <69>;
		r_profile_t0 = <
			193 4306 	1058 4276 	1075 4248 	1070 4225 	1068 4202
			1058 4178 	1055 4154 	1063 4120 	1138 4070 	1250 4038
			1245 4012 	1245 3991 	1248 3974 	1248 3958 	1238 3941
			1228 3923 	1218 3905 	1213 3890 	1208 3876 	1198 3865
			1200 3855 	1203 3845 	1205 3836 	1203 3828 	1208 3821
			1213 3815 	1213 3808 	1213 3803 	1220 3799 	1225 3795
			1238 3791 	1248 3787 	1250 3782 	1258 3777 	1310 3772
			1335 3765 	1365 3758 	1378 3749 	1408 3739 	1435 3727
			1470 3716 	1508 3706 	1550 3699 	1605 3693 	1663 3681
			1640 3656 	1568 3625 	1490 3595 	1425 3569 	1368 3546
			1318 3524 	1270 3505 	1225 3489 	1185 3474 	1158 3460
			1130 3449 	1098 3438 	1080 3430 	1060 3421 	1043 3414
			1023 3409 	1013 3404 	1003 3399 	998 3394 	985 3392
			978 3387 	965 3384 	955 3381 	763 3300
		>;
		r_profile_t1_num = <69>;
		r_profile_t1 = <
			180 4348 	485 4307 	548 4247 	640 4217 	655 4195
			663 4174 	665 4154 	668 4136 	670 4117 	673 4100
			683 4084 	695 4069 	693 4049 	680 4025 	675 4003
			675 3986 	680 3973 	688 3962 	685 3947 	678 3931
			665 3912 	655 3894 	653 3880 	648 3866 	653 3855
			655 3845 	655 3835 	658 3827 	665 3820 	670 3814
			675 3807 	685 3802 	690 3796 	695 3792 	703 3788
			718 3786 	723 3782 	740 3780 	758 3777 	775 3772
			795 3768 	823 3763 	850 3755 	888 3749 	923 3740
			960 3729 	1005 3718 	1058 3705 	1120 3696 	1200 3691
			1308 3686 	1423 3675 	1470 3620 	1405 3561 	1293 3516
			1195 3476 	1103 3441 	1028 3407 	945 3377 	885 3352
			823 3329 	778 3309 	735 3292 	708 3280 	680 3270
			663 3262 	638 3255 	630 3252 	630 3252
		>;
		r_profile_t2_num = <69>;
		r_profile_t2 = <
			128 4370 	168 4344 	170 4323 	168 4302 	168 4282
			170 4262 	173 4243 	175 4223 	173 4203 	170 4183
			173 4164 	175 4145 	178 4128 	180 4109 	180 4091
			185 4074 	190 4059 	193 4042 	195 4024 	195 4006
			200 3993 	205 3980 	208 3967 	208 3952 	200 3936
			185 3916 	165 3895 	160 3880 	163 3869 	158 3858
			160 3849 	160 3840 	163 3833 	165 3825 	168 3818
			168 3811 	173 3806 	173 3800 	180 3796 	178 3790
			180 3785 	178 3780 	175 3774 	170 3767 	168 3760
			168 3753 	163 3746 	170 3741 	173 3733 	170 3724
			175 3715 	175 3703 	173 3692 	178 3689 	193 3687
			210 3682 	203 3641 	215 3550 	253 3390 	385 3148
			250 3097 	210 3077 	185 3074 	183 3068 	178 3070
			180 3062 	178 3063 	178 3063 	160 3063
		>;
		r_profile_t3_num = <69>;
		r_profile_t3 = <
			115 4385 	113 4355 	108 4331 	108 4309 	103 4288
			108 4268 	108 4248 	108 4229 	108 4209 	110 4189
			113 4171 	110 4151 	115 4133 	115 4115 	118 4097
			118 4079 	120 4062 	123 4046 	125 4030 	125 4014
			130 3999 	133 3985 	138 3972 	140 3958 	143 3944
			145 3930 	135 3910 	115 3888 	113 3874 	110 3863
			115 3853 	113 3844 	113 3836 	113 3827 	115 3820
			118 3813 	120 3807 	120 3800 	125 3795 	125 3790
			130 3786 	133 3781 	133 3775 	115 3761 	115 3751
			120 3745 	115 3736 	118 3730 	118 3724 	120 3716
			118 3707 	120 3697 	118 3684 	113 3678 	118 3676
			128 3674 	128 3662 	128 3606 	165 3517 	140 3325
			270 3105 	188 3073 	165 3061 	150 3058 	148 3054
			140 3048 	135 3047 	133 3045 	120 3045
		>;
	};

	fg,lishen-battery-data {
		/* Qmax for 0mA */
		q_max_pos_50 = <2967>;
		q_max_pos_25 = <2960>;
		q_max_pos_0 = <2762>;
		q_max_neg_10 = <2363>;
		/* Qmax for 400mA, said high current */
		q_max_pos_50_h_current = <2957>;
		q_max_pos_25_h_current = <2950>;
		q_max_pos_0_h_current = <2624>;
		q_max_neg_10_h_current = <1990>;

		/* Battery Temperature Table */
		batt_temperature_table_num = <21>;
		/* NTC 68 murata thermistor */
		batt_temperature_table = <
			(-20) 738978
			(-15) 485782
			(-10) 409600
			(-5) 309217
			0 235606
			5 180980
			10 140139
			15 109344
			20 85929
			25 68000
			30 53885
			35 42973
			40 34479
			45 27827
			50 22584
			55 18429
			60 15116
			65 12462
			70 10324
			75 8593
			80 7184 >;

		battery_profile_t0_num = <69>;
		battery_profile_t0 = <
			0 4308 		2 4275 		4 4242 		6 4204 		8 4163
			11 4140 	13 4119 	15 4102 	17 4087 	19 4070
			21 4040 	23 4007 	25 3979 	28 3957 	30 3939
			32 3924 	34 3911 	36 3898 	38 3885 	40 3874
			42 3864 	44 3854 	47 3845 	49 3836 	51 3829
			53 3821 	55 3814 	57 3808 	59 3802 	61 3797
			63 3791 	66 3787 	68 3783 	70 3778 	72 3772
			74 3765 	76 3758 	78 3750 	80 3740 	83 3730
			85 3717 	87 3708 	89 3702 	91 3696 	93 3685
			95 3649 	97 3574 	98 3520 	98 3476 	99 3438
			99 3405 	99 3379 	100 3360 	100 3346 	100 3335
			100 3327 	100 3321 	100 3315 	100 3311 	100 3307
			100 3305 	100 3302 	100 3298 	100 3295 	100 3291
			100 3289 	100 3289 	100 3289 	100 3289
		>;
		battery_profile_t1_num = <69>;
		battery_profile_t1 = <
			0 4318 		2 4278 		4 4255 		5 4233 		7 4213
			9 4193 		11 4175 	13 4156 	14 4137 	16 4119
			18 4102 	20 4088 	22 4078 	24 4059 	25 4027
			27 4000 	29 3982 	31 3969 	33 3960 	34 3950
			36 3934 	38 3918 	40 3899 	42 3882 	43 3869
			45 3858 	47 3848 	49 3838 	51 3830 	52 3823
			54 3816 	56 3809 	58 3804 	60 3798 	62 3793
			63 3789 	65 3785 	67 3782 	69 3780 	71 3777
			72 3774 	74 3769 	76 3764 	78 3757 	80 3751
			81 3742 	83 3732 	85 3722 	87 3709 	89 3699
			90 3694 	92 3689 	94 3679 	96 3643 	98 3551
			99 3456 	100 3384 	100 3321 	100 3268 	100 3229
			100 3205 	100 3189 	100 3177 	100 3171 	100 3167
			100 3162 	100 3156 	100 3152 	100 3152
		>;
		battery_profile_t2_num = <69>;
		battery_profile_t2 = <
			0 4374 		2 4347 		3 4326 		5 4304 		7 4284
			8 4265 		10 4244 	12 4225 	14 4205 	15 4187
			17 4167 	19 4149 	20 4131 	22 4113 	24 4094
			25 4077 	27 4066 	29 4051 	30 4026 	32 4003
			34 3990 	35 3981 	37 3969 	39 3956 	41 3942
			42 3925 	44 3904 	46 3885 	47 3871 	49 3861
			51 3851 	52 3842 	54 3834 	56 3826 	57 3820
			59 3812 	61 3807 	62 3801 	64 3796 	66 3791
			68 3786 	69 3782 	71 3777 	73 3770 	74 3762
			76 3756 	78 3749 	79 3743 	81 3738 	83 3730
			84 3720 	86 3711 	88 3700 	89 3690 	91 3688
			93 3686 	95 3679 	96 3641 	98 3550 	100 3391
			100 3150 	100 3095 	100 3074 	100 3063 	100 3060
			100 3055 	100 3059 	100 3052 	100 3052
		>;
		battery_profile_t3_num = <69>;
		battery_profile_t3 = <
			0 4387 		2 4359 		3 4333 		5 4312 		7 4291
			8 4271 		10 4251 	12 4231 	13 4212 	15 4192
			17 4174 	19 4154 	20 4136 	22 4118 	24 4100
			25 4082 	27 4065 	29 4048 	30 4032 	32 4017
			34 4001 	35 3987 	37 3972 	39 3959 	40 3945
			42 3932 	44 3913 	45 3891 	47 3875 	49 3863
			51 3853 	52 3844 	54 3834 	56 3826 	57 3819
			59 3812 	61 3806 	62 3800 	64 3794 	66 3788
			67 3784 	69 3779 	71 3773 	72 3762 	74 3750
			76 3741 	77 3734 	79 3726 	81 3720 	83 3714
			84 3706 	86 3696 	88 3686 	89 3674 	91 3672
			93 3670 	94 3665 	96 3636 	98 3556 	99 3423
			100 3131 	100 3079 	100 3063 	100 3053 	100 3051
			100 3050 	100 3049 	100 3047 	100 3047
		>;
		r_profile_t0_num = <69>;
		r_profile_t0 = <
			193 4308 	615 4275 	638 4242 	668 4204 	740 4163
			813 4140 	823 4119 	833 4102 	850 4087 	868 4070
			855 4040 	835 4007 	818 3979 	813 3957 	810 3939
			810 3924 	808 3911 	808 3898 	808 3885 	810 3874
			815 3864 	818 3854 	820 3845 	825 3836 	833 3829
			833 3821 	838 3814 	845 3808 	850 3802 	858 3797
			860 3791 	868 3787 	878 3783 	890 3778 	903 3772
			918 3765 	938 3758 	963 3750 	988 3740 	1023 3730
			1055 3717 	1103 3708 	1160 3702 	1233 3696 	1325 3685
			1410 3649 	1435 3574 	1300 3520 	1190 3476 	1098 3438
			1020 3405 	953 3379 	903 3360 	873 3346 	845 3335
			820 3327 	813 3321 	800 3315 	788 3311 	773 3307
			768 3305 	758 3302 	755 3298 	743 3295 	755 3291
			745 3289 	753 3289 	753 3289 	753 3289
		>;
		r_profile_t1_num = <69>;
		r_profile_t1 = <
			180 4318 	318 4278 	335 4255 	340 4233 	348 4213
			348 4193 	355 4175 	358 4156 	360 4137 	363 4119
			365 4102 	370 4088 	398 4078 	403 4059 	385 4027
			375 4000 	373 3982 	378 3969 	385 3960 	390 3950
			380 3934 	373 3918 	358 3899 	348 3882 	345 3869
			345 3858 	348 3848 	348 3838 	350 3830 	355 3823
			358 3816 	360 3809 	365 3804 	368 3798 	370 3793
			375 3789 	378 3785 	383 3782 	388 3780 	393 3777
			400 3774 	405 3769 	418 3764 	430 3757 	448 3751
			468 3742 	493 3732 	525 3722 	555 3709 	600 3699
			658 3694 	733 3689 	838 3679 	960 3643 	1105 3551
			1143 3456 	963 3384 	808 3321 	678 3268 	575 3229
			515 3205 	483 3189 	453 3177 	433 3171 	418 3167
			428 3162 	418 3156 	403 3152 	415 3152
		>;
		r_profile_t2_num = <69>;
		r_profile_t2 = <
			128 4374 	120 4347 	123 4326 	123 4304 	123 4284
			125 4265 	123 4244 	128 4225 	125 4205 	128 4187
			125 4167 	128 4149 	133 4131 	133 4113 	133 4094
			133 4077 	143 4066 	143 4051 	143 4026 	143 4003
			145 3990 	153 3981 	153 3969 	158 3956 	160 3942
			155 3925 	138 3904 	125 3885 	118 3871 	120 3861
			120 3851 	120 3842 	120 3834 	120 3826 	123 3820
			120 3812 	125 3807 	125 3801 	128 3796 	130 3791
			130 3786 	133 3782 	133 3777 	128 3770 	123 3762
			120 3756 	118 3749 	118 3743 	123 3738 	118 3730
			120 3720 	120 3711 	125 3700 	123 3690 	125 3688
			133 3686 	138 3679 	138 3641 	148 3550 	185 3391
			383 3150 	258 3095 	195 3074 	163 3063 	153 3060
			155 3055 	148 3059 	150 3052 	158 3052
		>;
		r_profile_t3_num = <69>;
		r_profile_t3 = <
			115 4387 	93 4359 	83 4333 	90 4312 	90 4291
			90 4271 	90 4251 	90 4231 	93 4212 	90 4192
			95 4174 	93 4154 	95 4136 	95 4118 	98 4100
			95 4082 	98 4065 	98 4048 	98 4032 	103 4017
			100 4001 	105 3987 	105 3972 	110 3959 	113 3945
			120 3932 	113 3913 	100 3891 	95 3875 	90 3863
			93 3853 	95 3844 	93 3834 	93 3826 	95 3819
			95 3812 	98 3806 	98 3800 	98 3794 	98 3788
			103 3784 	105 3779 	103 3773 	98 3762 	93 3750
			95 3741 	93 3734 	93 3726 	93 3720 	95 3714
			95 3706 	95 3696 	98 3686 	90 3674 	95 3672
			100 3670 	103 3665 	100 3636 	105 3556 	120 3423
			330 3131 	198 3079 	163 3063 	150 3053 	133 3051
			128 3050 	125 3049 	125 3047 	133 3047
		>;
	};
};

