/*
 * LG Electronics bmm150 sensor device tree source
 *
 * Copyright (c) 2017 LG Electronics Co., Ltd.
 *              http://www.lge.com
 *
 */

// Slave Address 0x13 --> 0x12
cust_mag: cust_mag@12 {
    compatible = "mediatek,bmm150";
    reg = <0x12>;
    status = "okay";
    i2c_num = <3>;
    i2c_addr = <0x12 0 0 0>;
    direction = <7>;
    power_id = <0xffff>;
    power_vol = <0>;
    is_batch_supported = <0>;
};
