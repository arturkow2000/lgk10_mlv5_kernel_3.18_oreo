/*
 * LG Electronics lsm6ds3-acc sensor device tree source
 *
 * Copyright (c) 2016 LG Electronics Co., Ltd.
 *              http://www.lge.com
 *
 */

cust_accel: cust_accel@6b {
	compatible = "mediatek,lsm6ds3-acc";
	reg = <0x6b>;
	status = "okay";
	i2c_num = <1>;
	i2c_addr = <0x6b 0 0 0>;
	direction = <0>;
	power_id = <0xffff>;
	power_vol = <0>;
	firlen = <0>;
	is_batch_supported = <0>;
};
