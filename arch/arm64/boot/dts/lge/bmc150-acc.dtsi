/*
 * LG Electronics bma255 sensor device tree source
 *
 * Copyright (c) 2016 LG Electronics Co., Ltd.
 *              http://www.lge.com
 *
 */

cust_accel: cust_accel@11 {
	compatible = "mediatek,bma255";
	reg = <0x11>;
	status = "okay";
	i2c_num = <1>;
	i2c_addr = <0x11 0 0 0>;
	direction = <5>;
	power_id = <0xffff>;
	power_vol = <0>;
	firlen = <0>;
	is_batch_supported = <0>;
};
