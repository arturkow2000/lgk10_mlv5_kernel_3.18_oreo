/*
 * LG Electronics k303b-acc sensor device tree source
 *
 * Copyright (c) 2016 LG Electronics Co., Ltd.
 *              http://www.lge.com
 *
 */

cust_accel: cust_accel@1d {
	compatible = "mediatek,k2hh_acc";
	reg = <0x1d>;
	status = "okay";
	i2c_num = <1>;
	i2c_addr = <0x1d 0 0 0>;
	direction = <0>;
	power_id = <0xffff>;
	power_vol = <0>;
	firlen = <0>;
	is_batch_supported = <0>;
};
