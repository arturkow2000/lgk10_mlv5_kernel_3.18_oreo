/*
 * LG Electronics LV7V nfc device tree source
 *
 * Copyright (c) 2017 LG Electronics Co., Ltd.
 *              http://www.lge.com
 *
 */

&i2c3 {
	#address-cells = <1>;
	#size-cells = <0>;
	pn547@28 {
		compatible = "nxp,pn547";
		reg = <0x28>;
		status = "okay";

		interrupt-parent = <&eintc>;
		interrupts = <20 IRQ_TYPE_EDGE_RISING>;//<PINMUX_GPIO20__FUNC_GPIO20 IRQ_TYPE_EDGE_RISING>;
		debounce = <20 0>;

		nxp,gpio_ven = <22>;//<PINMUX_GPIO22__FUNC_GPIO22>;
		nxp,gpio_mode = <21>;//<PINMUX_GPIO21__FUNC_GPIO21>;
		nxp,gpio_irq = <20>;//<PINMUX_GPIO20__FUNC_GPIO20>;
	};
};
