/*
 * LG Electronics ICM406xx sensor device tree source
 *
 * Copyright (c) 2017 LG Electronics Co., Ltd.
 *              http://www.lge.com
 *
 */

cust_accel: cust_accel@68 {
	compatible = "inven,icm406_acc";
	reg = <0x68>;
	status = "okay";
	i2c_num = <1>;
	i2c_addr = <0x68 0 0 0>;
	direction = <4>;
	power_id = <0xffff>;
	power_vol = <0>;
	firlen = <0>;
	is_batch_supported = <0>;
};
