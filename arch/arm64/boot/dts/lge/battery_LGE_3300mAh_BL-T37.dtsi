/* Typical 3300mAh Battery, 3.4V cut-off */

&odm {
	/* LGC 3300mA Battery 4.4V - 3.4V cut off -Techonohill Temp DATA*/
	fg,lgc-battery-data {
		/* Qmax for 0mA */
		q_max_pos_50 = <3214 >;
		q_max_pos_25 = <3151 >;
		q_max_pos_0 = <2876 >;
		q_max_neg_10 = <1764 >;
		/* Qmax for 400mA, said high current */
		q_max_pos_50_h_current = <3148 >;
		q_max_pos_25_h_current = <3119 >;
		q_max_pos_0_h_current = <2209 >;
		q_max_neg_10_h_current = <475 >;

		/* Battery Temperature Table */
		batt_temperature_table_num = <21>;
		/* NTC 68 murata thermistor */
		batt_temperature_table = <
			(-20) 738978
			(-15) 547456
			(-10) 409600
			(-5) 309217
			0 235606
			5 180980
			10 140139
			15 109344
			20 85929
			25 68000
			30 54167
			35 43421
			40 35016
			45 28406
			50 23166
			55 18997
			60 15657
			65 12967
			70 10794
			75 9021
			80 7575 >;

		battery_profile_t0_num = <79 >;
		battery_profile_t0 = <
			0 4269  	3 4237  	6 4210  	8 4182  	11 4152
			14 4121 	17 4080 	20 4041 	23 4007 	25 3975
			28 3953 	31 3936 	34 3923 	37 3913 	40 3901
			42 3891 	45 3880 	48 3869 	51 3859 	54 3849
			56 3838 	59 3827 	62 3815 	65 3802 	68 3789
			71 3775 	73 3762 	76 3750 	79 3738 	82 3728
			85 3719 	88 3709 	90 3692 	93 3658 	95 3615
			96 3582 	97 3557 	97 3538 	98 3524 	98 3513
			98 3504 	98 3496 	99 3490 	99 3485 	99 3480
			99 3477 	99 3473 	99 3471 	99 3469 	99 3467
			99 3465 	99 3462 	99 3462 	99 3460 	99 3459
			99 3458 	99 3457 	100 3456 	100 3454 	100 3453
			100 3452 	100 3451 	100 3450 	100 3448 	100 3447
			100 3446 	100 3444 	100 3443 	100 3442 	100 3441
			100 3439 	100 3437 	100 3437 	100 3437 	100 3437
			100 3437 	100 3437 	100 3437 	100 3400
		>;
		battery_profile_t1_num = <79 >;
		battery_profile_t1 = <
			0 4328  	2 4300  	3 4264  	5 4222  	7 4192
			9 4171  	10 4152 	12 4135 	14 4118 	16 4103
			17 4091 	19 4078 	21 4059 	22 4035 	24 4010
			26 3990 	28 3974 	29 3961 	31 3950 	33 3939
			35 3926 	36 3910 	38 3895 	40 3881 	42 3869
			43 3858 	45 3849 	47 3841 	48 3833 	50 3826
			52 3819 	54 3813 	55 3806 	57 3800 	59 3795
			61 3792 	62 3788 	64 3785 	66 3782 	68 3779
			69 3776 	71 3773 	73 3768 	74 3763 	76 3758
			78 3752 	80 3745 	81 3736 	83 3728 	85 3719
			87 3710 	88 3702 	90 3696 	92 3689 	94 3677
			95 3650 	97 3588 	98 3545 	98 3511 	99 3484
			99 3460 	99 3441 	100 3424 	100 3408 	100 3396
			100 3385 	100 3377 	100 3368 	100 3360 	100 3354
			100 3347 	100 3342 	100 3338 	100 3333 	100 3328
			100 3323 	100 3318 	100 3318 	100 3318
		>;
		battery_profile_t2_num = <79 >;
		battery_profile_t2 = <
			0 4365  	2 4341  	3 4322  	5 4303  	6 4285
			8 4266  	9 4248  	11 4231 	13 4213 	14 4195
			16 4178 	17 4161 	19 4145 	21 4128 	22 4112
			24 4096 	25 4081 	27 4070 	28 4059 	30 4036
			32 4013 	33 3995 	35 3983 	36 3977 	38 3965
			40 3952 	41 3937 	43 3920 	44 3902 	46 3888
			47 3877 	49 3866 	51 3858 	52 3849 	54 3841
			55 3833 	57 3827 	58 3820 	60 3814 	62 3808
			63 3803 	65 3798 	66 3793 	68 3788 	70 3784
			71 3778 	73 3772 	74 3766 	76 3760 	77 3752
			79 3746 	81 3742 	82 3735 	84 3726 	85 3717
			87 3708 	89 3696 	90 3691 	92 3690 	93 3687
			95 3680 	96 3644 	98 3571 	100 3461 	100 3236
			100 3155 	100 3105 	100 3105 	100 3105 	100 3105
			100 3105 	100 3105 	100 3105 	100 3105 	100 3105
			100 3105 	100 3105 	100 3105 	100 3105
		>;
		battery_profile_t3_num = <79 >;
		battery_profile_t3 = <
			0 4385  	2 4361  	3 4341  	5 4323  	6 4304
			8 4286  	9 4268  	11 4250 	12 4233 	14 4215
			15 4198 	17 4180 	19 4163 	20 4146 	22 4129
			23 4113 	25 4097 	26 4081 	28 4065 	29 4051
			31 4035 	33 4022 	34 4007 	36 3994 	37 3981
			39 3968 	40 3955 	42 3942 	43 3926 	45 3907
			46 3890 	48 3878 	50 3868 	51 3858 	53 3850
			54 3842 	56 3834 	57 3827 	59 3821 	60 3814
			62 3808 	64 3803 	65 3797 	67 3792 	68 3787
			70 3782 	71 3774 	73 3763 	74 3754 	76 3746
			77 3739 	79 3732 	81 3726 	82 3721 	84 3713
			85 3703 	87 3695 	88 3683 	90 3678 	91 3676
			93 3673 	94 3668 	96 3642 	98 3580 	99 3489
			100 3327 	100 3144 	100 3079 	100 3053 	100 3041
			100 3040 	100 3033 	100 3030 	100 3026 	100 3021
			100 3021 	100 3018 	100 3016 	100 3016
		>;
		r_profile_t0_num = <79 >;
		r_profile_t0 = <
			193 4269 	978 4237 	1015 4210 	1033 4182 	1055 4152
			1098 4121 	1170 4080 	1313 4041 	1380 4007 	1400 3975
			1413 3953 	1413 3936 	1413 3923 	1415 3913 	1410 3901
			1410 3891 	1413 3880 	1410 3869 	1410 3859 	1410 3849
			1413 3838 	1413 3827 	1413 3815 	1410 3802 	1410 3789
			1410 3775 	1415 3762 	1428 3750 	1445 3738 	1463 3728
			1490 3719 	1523 3709 	1545 3692 	1575 3658 	1538 3615
			1455 3582 	1393 3557 	1348 3538 	1313 3524 	1283 3513
			1263 3504 	1240 3496 	1228 3490 	1215 3485 	1203 3480
			1198 3477 	1188 3473 	1185 3471 	1173 3469 	1175 3467
			1165 3465 	1168 3462 	1155 3462 	1155 3460 	1160 3459
			1150 3458 	1150 3457 	1143 3456 	1148 3454 	1143 3453
			1140 3452 	1130 3451 	1135 3450 	1130 3448 	1133 3447
			1120 3446 	1135 3444 	1110 3443 	1118 3442 	1113 3441
			1123 3439 	1103 3437 	1110 3437 	1110 3437 	1110 3437
			1110 3437 	1110 3437 	1110 3437 	1018 3400
		>;
		r_profile_t1_num = <79 >;
		r_profile_t1 = <
			180 4328 	460 4300 	483 4264 	553 4222 	630 4192
			673 4171 	680 4152 	688 4135 	688 4118 	690 4103
			705 4091 	723 4078 	725 4059 	713 4035 	700 4010
			700 3990 	700 3974 	703 3961 	710 3950 	715 3939
			713 3926 	700 3910 	688 3895 	688 3881 	685 3869
			685 3858 	690 3849 	693 3841 	698 3833 	700 3826
			705 3819 	708 3813 	710 3806 	713 3800 	718 3795
			723 3792 	733 3788 	748 3785 	765 3782 	778 3779
			798 3776 	818 3773 	838 3768 	855 3763 	880 3758
			908 3752 	933 3745 	958 3736 	983 3728 	1018 3719
			1065 3710 	1118 3702 	1173 3696 	1245 3689 	1318 3677
			1395 3650 	1453 3588 	1368 3545 	1278 3511 	1210 3484
			1155 3460 	1105 3441 	1060 3424 	1023 3408 	993 3396
			968 3385 	945 3377 	923 3368 	905 3360 	888 3354
			875 3347 	858 3342 	848 3338 	833 3333 	823 3328
			820 3323 	808 3318 	800 3318 	810 3318
		>;
		r_profile_t2_num = <79 >;
		r_profile_t2 = <
			128 4365 	138 4341 	140 4322 	140 4303 	143 4285
			143 4266 	140 4248 	143 4231 	145 4213 	143 4195
			145 4178 	148 4161 	150 4145 	153 4128 	155 4112
			155 4096 	158 4081 	165 4070 	173 4059 	168 4036
			165 4013 	170 3995 	170 3983 	180 3977 	175 3965
			170 3952 	165 3937 	155 3920 	143 3902 	138 3888
			135 3877 	133 3866 	135 3858 	135 3849 	135 3841
			135 3833 	140 3827 	140 3820 	143 3814 	143 3808
			145 3803 	145 3798 	148 3793 	150 3788 	150 3784
			150 3778 	145 3772 	143 3766 	143 3760 	138 3752
			138 3746 	145 3742 	145 3735 	148 3726 	150 3717
			155 3708 	148 3696 	153 3691 	165 3690 	183 3687
			200 3680 	205 3644 	228 3571 	273 3461 	528 3236
			403 3155 	268 3105 	270 3105 	270 3105 	270 3105
			270 3105 	270 3105 	270 3105 	270 3105 	270 3105
			270 3105 	270 3105 	270 3105 	270 3105
		>;
		r_profile_t3_num = <79 >;
		r_profile_t3 = <
			115 4385 	78 4361 	73 4341 	75 4323 	73 4304
			73 4286 	75 4268 	75 4250 	78 4233 	75 4215
			80 4198 	78 4180 	80 4163 	80 4146 	80 4129
			85 4113 	88 4097 	88 4081 	88 4065 	93 4051
			90 4035 	98 4022 	95 4007 	98 3994 	100 3981
			103 3968 	103 3955 	105 3942 	100 3926 	88 3907
			80 3890 	78 3878 	78 3868 	75 3858 	78 3850
			80 3842 	80 3834 	83 3827 	85 3821 	85 3814
			85 3808 	93 3803 	93 3797 	95 3792 	95 3787
			98 3782 	90 3774 	83 3763 	83 3754 	83 3746
			80 3739 	80 3732 	80 3726 	85 3721 	85 3713
			80 3703 	85 3695 	83 3683 	80 3678 	85 3676
			85 3673 	90 3668 	93 3642 	108 3580 	128 3489
			173 3327 	360 3144 	200 3079 	133 3053 	118 3041
			100 3040 	95 3033 	85 3030 	85 3026 	85 3021
			75 3021 	80 3018 	73 3016 	103 3016
		>;
	};

	/* TOCAD 3300mA Battery 4.4V - 3.4V cut off -Techonohill Temp DATA*/
	fg,tocad-battery-data {
		/* Qmax for 0mA */
		q_max_pos_50 = <3199 >;
		q_max_pos_25 = <3193 >;
		q_max_pos_0 = <2955 >;
		q_max_neg_10 = <2485 >;
		/* Qmax for 400mA, said high current */
		q_max_pos_50_h_current = <3186 >;
		q_max_pos_25_h_current = <3166 >;
		q_max_pos_0_h_current = <2412 >;
		q_max_neg_10_h_current = <1236 >;

		/* Battery Temperature Table */
		batt_temperature_table_num = <21>;
		/* NTC 68 murata thermistor */
		batt_temperature_table = <
			(-20) 738978
			(-15) 547456
			(-10) 409600
			(-5) 309217
			0 235606
			5 180980
			10 140139
			15 109344
			20 85929
			25 68000
			30 54167
			35 43421
			40 35016
			45 28406
			50 23166
			55 18997
			60 15657
			65 12967
			70 10794
			75 9021
			80 7575 >;

		battery_profile_t0_num = <74 >;
		battery_profile_t0 = <
			0 4285  	2 4254 		4 4217 		6 4178 		8 4147
			10 4125 	12 4106 	14 4091 	16 4073 	18 4052
			20 4030 	22 4006 	24 3985 	26 3966 	28 3948
			30 3932 	32 3917 	34 3904 	36 3891 	38 3880
			40 3870 	42 3860 	44 3852 	46 3843 	48 3836
			50 3828 	52 3821 	54 3815 	56 3809 	58 3804
			60 3799 	62 3795 	64 3791 	66 3787 	68 3783
			70 3778 	72 3771 	74 3765 	76 3757 	78 3749
			80 3740 	82 3730 	84 3718 	86 3709 	88 3702
			90 3696 	92 3688 	94 3666 	96 3612 	97 3574
			98 3544 	98 3518 	99 3495 	99 3476 	99 3457
			100 3442 	100 3429 	100 3418 	100 3408 	100 3401
			100 3394 	100 3388 	100 3383 	100 3379 	100 3374
			100 3370 	100 3366 	100 3364 	100 3361 	100 3359
			100 3359 	100 3359 	100 3359 	100 3359
		>;
		battery_profile_t1_num = <74 >;
		battery_profile_t1 = <
			0 4311 		2 4269 		3 4244 		5 4223 		7 4203
			8 4185 		10 4166 	12 4148 	14 4131 	15 4114
			17 4098 	19 4084 	20 4070 	22 4053 	24 4032
			25 4011 	27 3995 	29 3981 	30 3971 	32 3959
			34 3948 	35 3934 	37 3918 	39 3901 	41 3885
			42 3870 	44 3858 	46 3849 	47 3840 	49 3832
			51 3825 	52 3817 	54 3812 	56 3806 	57 3801
			59 3796 	61 3792 	62 3790 	64 3787 	66 3785
			68 3783 	69 3781 	71 3778 	73 3774 	74 3770
			76 3765 	78 3759 	79 3751 	81 3744 	83 3734
			84 3724 	86 3714 	88 3702 	89 3693 	91 3688
			93 3683 	95 3674 	96 3644 	98 3575 	99 3531
			99 3494 	99 3461 	100 3431 	100 3402 	100 3377
			100 3352 	100 3331 	100 3312 	100 3296 	100 3283
			100 3272 	100 3263 	100 3255 	100 3255
		>;
		battery_profile_t2_num = <74 >;
		battery_profile_t2 = <
			0 4369 		2 4345 		3 4323 		5 4304 		6 4286
			8 4267 		9 4249 		11 4231 	13 4213 	14 4195
			16 4177 	17 4160 	19 4142 	20 4126 	22 4109
			23 4093 	25 4077 	27 4062 	28 4049 	30 4033
			31 4016 	33 4003 	34 3990 	36 3978 	37 3966
			39 3953 	41 3941 	42 3927 	44 3909 	45 3890
			47 3875 	48 3864 	50 3854 	52 3846 	53 3838
			55 3831 	56 3825 	58 3818 	59 3812 	61 3807
			62 3801 	64 3797 	66 3792 	67 3788 	69 3785
			70 3781 	72 3776 	73 3771 	75 3764 	77 3757
			78 3752 	80 3746 	81 3741 	83 3734 	84 3726
			86 3717 	88 3707 	89 3694 	91 3689 	92 3688
			94 3685 	95 3677 	97 3634 	98 3547 	100 3405
			100 3175 	100 3125 	100 3096 	100 3079 	100 3074
			100 3074 	100 3071 	100 3070 	100 3070
		>;
		battery_profile_t3_num = <74 >;
		battery_profile_t3 = <
			0 4385 		2 4355 		3 4334 		5 4314 		6 4294
			8 4275 		9 4256 		11 4238 	12 4220 	14 4203
			16 4184 	17 4167 	19 4149 	20 4133 	22 4117
			23 4099 	25 4084 	27 4068 	28 4052 	30 4038
			31 4024 	33 4010 	34 3995 	36 3983 	37 3971
			39 3958 	41 3947 	42 3934 	44 3919 	45 3899
			47 3881 	48 3868 	50 3858 	51 3849 	53 3841
			55 3834 	56 3827 	58 3820 	59 3813 	61 3808
			62 3802 	64 3797 	65 3792 	67 3788 	69 3784
			70 3780 	72 3774 	73 3762 	75 3752 	76 3746
			78 3739 	80 3732 	81 3726 	83 3721 	84 3713
			86 3703 	87 3695 	89 3683 	90 3677 	92 3675
			94 3673 	95 3667 	97 3633 	98 3557 	100 3438
			100 3161 	100 3088 	100 3068 	100 3062 	100 3056
			100 3054 	100 3053 	100 3046 	100 3046
		>;
		r_profile_t0_num = <74 >;
		r_profile_t0 = <
			193 4285 	1043 4254 	1053 4217 	1075 4178 	1130 4147
			1158 4125 	1158 4106 	1158 4091 	1155 4073 	1145 4052
			1133 4030 	1115 4006 	1108 3985 	1098 3966 	1090 3948
			1083 3932 	1078 3917 	1075 3904 	1068 3891 	1068 3880
			1068 3870 	1068 3860 	1070 3852 	1070 3843 	1073 3836
			1075 3828 	1080 3821 	1080 3815 	1083 3809 	1090 3804
			1093 3799 	1103 3795 	1108 3791 	1118 3787 	1128 3783
			1145 3778 	1155 3771 	1175 3765 	1198 3757 	1220 3749
			1250 3740 	1278 3730 	1305 3718 	1340 3709 	1378 3702
			1418 3696 	1465 3688 	1503 3666 	1523 3612 	1438 3574
			1363 3544 	1295 3518 	1238 3495 	1190 3476 	1148 3457
			1110 3442 	1078 3429 	1053 3418 	1028 3408 	1003 3401
			985 3394 	970 3388 	960 3383 	955 3379 	943 3374
			935 3370 	923 3366 	913 3364 	913 3361 	908 3359
			908 3359 	908 3359 	908 3359 	908 3359
		>;
		r_profile_t1_num = <74 >;
		r_profile_t1 = <
			180 4311 	538 4269 	575 4244 	588 4223 	593 4203
			598 4185 	598 4166 	598 4148 	600 4131 	600 4114
			603 4098 	610 4084 	618 4070 	618 4053 	613 4032
			605 4011 	608 3995 	610 3981 	620 3971 	620 3959
			623 3948 	620 3934 	608 3918 	600 3901 	588 3885
			578 3870 	580 3858 	585 3849 	588 3840 	588 3832
			595 3825 	598 3817 	603 3812 	610 3806 	620 3801
			620 3796 	625 3792 	635 3790 	640 3787 	650 3785
			665 3783 	678 3781 	693 3778 	708 3774 	728 3770
			753 3765 	778 3759 	805 3751 	840 3744 	873 3734
			913 3724 	963 3714 	1013 3702 	1075 3693 	1148 3688
			1240 3683 	1338 3674 	1403 3644 	1438 3575 	1330 3531
			1238 3494 	1153 3461 	1078 3431 	1008 3402 	948 3377
			885 3352 	833 3331 	790 3312 	743 3296 	708 3283
			683 3272 	660 3263 	648 3255 	645 3255
		>;
		r_profile_t2_num = <74 >;
		r_profile_t2 = <
			128 4369 	150 4345 	148 4323 	150 4304 	148 4286
			148 4267 	148 4249 	150 4231 	150 4213 	150 4195
			150 4177 	150 4160 	148 4142 	153 4126 	153 4109
			155 4093 	155 4077 	158 4062 	163 4049 	165 4033
			165 4016 	170 4003 	170 3990 	175 3978 	180 3966
			180 3953 	183 3941 	180 3927 	170 3909 	153 3890
			145 3875 	143 3864 	143 3854 	143 3846 	143 3838
			143 3831 	145 3825 	143 3818 	145 3812 	148 3807
			148 3801 	150 3797 	153 3792 	153 3788 	158 3785
			158 3781 	155 3776 	153 3771 	148 3764 	143 3757
			145 3752 	145 3746 	148 3741 	145 3734 	148 3726
			150 3717 	150 3707 	150 3694 	150 3689 	158 3688
			165 3685 	175 3677 	178 3634 	190 3547 	228 3405
			443 3175 	313 3125 	248 3096 	215 3079 	195 3074
			185 3074 	185 3071 	178 3070 	190 3070
		>;
		r_profile_t3_num = <74 >;
		r_profile_t3 = <
			115 4385 	103 4355 	108 4334 	108 4314 	105 4294
			105 4275 	105 4256 	108 4238 	108 4220 	108 4203
			105 4184 	108 4167 	108 4149 	110 4133 	113 4117
			108 4099 	110 4084 	113 4068 	110 4052 	115 4038
			118 4024 	118 4010 	115 3995 	120 3983 	125 3971
			125 3958 	133 3947 	133 3934 	135 3919 	123 3899
			110 3881 	105 3868 	105 3858 	105 3849 	108 3841
			108 3834 	108 3827 	110 3820 	110 3813 	113 3808
			113 3802 	113 3797 	115 3792 	118 3788 	120 3784
			123 3780 	120 3774 	110 3762 	108 3752 	113 3746
			110 3739 	108 3732 	110 3726 	110 3721 	110 3713
			110 3703 	113 3695 	110 3683 	110 3677 	113 3675
			115 3673 	120 3667 	118 3633 	123 3557 	138 3438
			258 3161 	225 3088 	180 3068 	155 3062 	143 3056
			138 3054 	135 3053 	128 3046 	133 3046
		>;
	};
};

