/*
 * LG Electronics apds9930 sensor device tree source
 *
 * Copyright (c) 2016 LG Electronics Co., Ltd.
 *              http://www.lge.com
 *
 */

cust_alsps: cust_alsps@39 {
	compatible = "mediatek,apds9930";
	reg = <0x39>;
	status = "okay";
	i2c_num = <1>;
	i2c_addr= <0x39 0 0 0>;
	polling_mode_ps = <0>;
	polling_mode_als = <0>;
	power_id = <0xffff>;
	power_vol = <0>;
	als_level = <0 0 0 0 0 0 0 0 0 0 0 0 0 0 0>; // unused param 15
	als_value = <0 0 0 0 0 0 0 0 0 0 0 0 0 0 0 0>; // unused param 16
	offset = <300>;
	hysteresis = <80>;
	crosstalk_max = <650>;
	ppcount = <0x06>;
	ps_led_current = <0x28>;/* 4:50mA  5:75mA  6:100mA */
	als_threshold = <100>; /* ch0 value for 8 lux */
	als_ga = <1080>;
	als_coe_b = <183>;
	als_coe_c = <68>;
	als_coe_d = <120>;
	is_batch_supported_ps = <0>;
	is_batch_supported_als = <0>;
};
