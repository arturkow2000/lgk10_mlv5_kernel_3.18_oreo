/*
 * LG Electronics bma253 sensor device tree source
 *
 * Copyright (c) 2016 LG Electronics Co., Ltd.
 *              http://www.lge.com
 *
 */

cust_accel: cust_accel@18 {
	compatible = "mediatek,bma255"; /* compatible with bma255 dd */
	reg = <0x18>;
	status = "okay";
	i2c_num = <1>;
	i2c_addr = <0x18 0 0 0>;
	direction = <6>;
	power_id = <0xffff>;
	power_vol = <0>;
	firlen = <0>;
	is_batch_supported = <0>;
};
