## arch/arm/configs/lv7_lgu_kr_debug_defconfig
```kconfig
CONFIG_CROSS_COMPILE="arm-eabi-"
# CONFIG_LOCALVERSION_AUTO is not set
# CONFIG_USELIB is not set
CONFIG_KERNEL_LZ4=y
CONFIG_AUDIT=y
CONFIG_NO_HZ=y
CONFIG_HIGH_RES_TIMERS=y
CONFIG_TASKSTATS=y
CONFIG_TASK_XACCT=y
CONFIG_TASK_IO_ACCOUNTING=y
CONFIG_IKCONFIG=y
CONFIG_IKCONFIG_PROC=y
CONFIG_LOG_BUF_SHIFT=21
CONFIG_CGROUPS=y
CONFIG_CGROUP_DEBUG=y
CONFIG_CGROUP_FREEZER=y
CONFIG_CGROUP_CPUACCT=y
CONFIG_RESOURCE_COUNTERS=y
CONFIG_CGROUP_SCHED=y
CONFIG_RT_GROUP_SCHED=y
CONFIG_BLK_DEV_INITRD=y
# CONFIG_RD_GZIP is not set
CONFIG_RD_LZ4=y
CONFIG_EMBEDDED=y
CONFIG_PROFILING=y
CONFIG_CC_STACKPROTECTOR_STRONG=y
CONFIG_ARCH_MMAP_RND_BITS=16
CONFIG_MODULES=y
CONFIG_MODULE_UNLOAD=y
CONFIG_MODVERSIONS=y
CONFIG_MODULE_SRCVERSION_ALL=y
CONFIG_MODULE_SIG=y
CONFIG_MODULE_SIG_FORCE=y
# CONFIG_BLK_DEV_BSG is not set
CONFIG_ARCH_MT6755=y
CONFIG_ARM_KERNMEM_PERMS=y
CONFIG_SMP=y
CONFIG_SCHED_MC=y
CONFIG_HAVE_ARM_ARCH_TIMER=y
CONFIG_NR_CPUS=8
CONFIG_ARM_PSCI=y
CONFIG_PREEMPT=y
CONFIG_AEABI=y
CONFIG_HIGHMEM=y
# CONFIG_BOUNCE is not set
CONFIG_ZSMALLOC=y
CONFIG_PROCESS_RECLAIM=y
CONFIG_HSWAP=y
CONFIG_MIGRATE_HIGHORDER=y
CONFIG_HIGHORDER_PAGES=17920
CONFIG_DM_BUFIO=y
CONFIG_DM_BUFIO_HASH_BITS=16
CONFIG_READAHEAD_MMAP_SIZE_ENABLE=y
CONFIG_READAHEAD_MMAP_PAGE_CNT=8
CONFIG_SECCOMP=y
CONFIG_USE_OF=y
CONFIG_BUILD_ARM_APPENDED_DTB_IMAGE=y
CONFIG_BUILD_ARM_APPENDED_DTB_IMAGE_NAMES="lv7_lgu_kr"
CONFIG_CMDLINE="console=tty0 console=ttyMT3,921600n1 root=/dev/ram vmalloc=496M slub_max_order=0 slub_debug=O "
CONFIG_AUTO_ZRELADDR=y
CONFIG_CPU_FREQ=y
CONFIG_CPU_FREQ_STAT_DETAILS=y
CONFIG_CPU_FREQ_DEFAULT_GOV_INTERACTIVE=y
CONFIG_CPU_FREQ_GOV_PERFORMANCE=y
CONFIG_CPU_FREQ_GOV_POWERSAVE=y
CONFIG_CPU_FREQ_GOV_USERSPACE=y
CONFIG_CPU_FREQ_GOV_ONDEMAND=y
CONFIG_VFP=y
CONFIG_NEON=y
# CONFIG_CORE_DUMP_DEFAULT_ELF_HEADERS is not set
CONFIG_PM_AUTOSLEEP=y
CONFIG_PM_WAKELOCKS=y
CONFIG_NET=y
CONFIG_PACKET=y
CONFIG_UNIX=y
CONFIG_XFRM_USER=y
CONFIG_XFRM_SUB_POLICY=y
CONFIG_XFRM_MIGRATE=y
CONFIG_NET_KEY=y
CONFIG_XFRM_FRAG_ESP_BEFORE_TUNNEL_ENC=y
CONFIG_INET=y
CONFIG_IP_MULTICAST=y
CONFIG_IP_ADVANCED_ROUTER=y
CONFIG_IP_MULTIPLE_TABLES=y
CONFIG_IP_PNP=y
CONFIG_IP_PNP_DHCP=y
CONFIG_IP_PNP_BOOTP=y
CONFIG_NET_IPIP=y
CONFIG_IP_MROUTE=y
CONFIG_IP_MROUTE_MULTIPLE_TABLES=y
CONFIG_IP_PIMSM_V1=y
CONFIG_IP_PIMSM_V2=y
CONFIG_SYN_COOKIES=y
CONFIG_INET_AH=y
CONFIG_INET_ESP=y
CONFIG_INET_IPCOMP=y
# CONFIG_INET_LRO is not set
CONFIG_INET_DIAG_DESTROY=y
CONFIG_IPV6=y
CONFIG_IPV6_ROUTER_PREF=y
CONFIG_IPV6_ROUTE_INFO=y
CONFIG_IPV6_OPTIMISTIC_DAD=y
CONFIG_INET6_AH=y
CONFIG_INET6_ESP=y
CONFIG_INET6_IPCOMP=y
CONFIG_IPV6_MIP6=y
CONFIG_INET6_XFRM_MODE_ROUTEOPTIMIZATION=y
CONFIG_IPV6_SIT_6RD=y
CONFIG_IPV6_MULTIPLE_TABLES=y
CONFIG_IPV6_SUBTREES=y
CONFIG_IPV6_MROUTE=y
CONFIG_IPV6_PIMSM_V2=y
CONFIG_NETFILTER=y
CONFIG_BRIDGE_NETFILTER=y
CONFIG_NF_CONNTRACK=y
CONFIG_NF_CONNTRACK_SECMARK=y
CONFIG_NF_CONNTRACK_EVENTS=y
CONFIG_NF_CT_PROTO_DCCP=y
CONFIG_NF_CT_PROTO_SCTP=y
CONFIG_NF_CT_PROTO_UDPLITE=y
CONFIG_NF_CONNTRACK_AMANDA=y
CONFIG_NF_CONNTRACK_FTP=y
CONFIG_NF_CONNTRACK_H323=y
CONFIG_NF_CONNTRACK_IRC=y
CONFIG_NF_CONNTRACK_NETBIOS_NS=y
CONFIG_NF_CONNTRACK_PPTP=y
CONFIG_NF_CONNTRACK_SANE=y
CONFIG_NF_CONNTRACK_TFTP=y
CONFIG_NF_CT_NETLINK=y
CONFIG_NETFILTER_XT_TARGET_CLASSIFY=y
CONFIG_NETFILTER_XT_TARGET_CONNMARK=y
CONFIG_NETFILTER_XT_TARGET_CONNSECMARK=y
CONFIG_NETFILTER_XT_TARGET_IDLETIMER=y
CONFIG_NETFILTER_XT_TARGET_MARK=y
CONFIG_NETFILTER_XT_TARGET_NFLOG=y
CONFIG_NETFILTER_XT_TARGET_NFQUEUE=y
CONFIG_NETFILTER_XT_TARGET_TPROXY=y
CONFIG_NETFILTER_XT_TARGET_TRACE=y
CONFIG_NETFILTER_XT_TARGET_SECMARK=y
CONFIG_NETFILTER_XT_TARGET_TCPMSS=y
CONFIG_NETFILTER_XT_MATCH_COMMENT=y
CONFIG_NETFILTER_XT_MATCH_CONNBYTES=y
CONFIG_NETFILTER_XT_MATCH_CONNLIMIT=y
CONFIG_NETFILTER_XT_MATCH_CONNMARK=y
CONFIG_NETFILTER_XT_MATCH_CONNTRACK=y
CONFIG_NETFILTER_XT_MATCH_HASHLIMIT=y
CONFIG_NETFILTER_XT_MATCH_HELPER=y
CONFIG_NETFILTER_XT_MATCH_IPRANGE=y
CONFIG_NETFILTER_XT_MATCH_LENGTH=y
CONFIG_NETFILTER_XT_MATCH_LIMIT=y
CONFIG_NETFILTER_XT_MATCH_MAC=y
CONFIG_NETFILTER_XT_MATCH_MARK=y
CONFIG_NETFILTER_XT_MATCH_MULTIPORT=y
CONFIG_NETFILTER_XT_MATCH_POLICY=y
CONFIG_NETFILTER_XT_MATCH_PHYSDEV=y
CONFIG_NETFILTER_XT_MATCH_PKTTYPE=y
CONFIG_NETFILTER_XT_MATCH_QTAGUID=y
CONFIG_NETFILTER_XT_MATCH_QUOTA=y
CONFIG_NETFILTER_XT_MATCH_QUOTA2=y
CONFIG_NETFILTER_XT_MATCH_QUOTA2_LOG=y
CONFIG_NETFILTER_XT_MATCH_REALM=y
CONFIG_NETFILTER_XT_MATCH_RECENT=y
CONFIG_NETFILTER_XT_MATCH_SOCKET=y
CONFIG_NETFILTER_XT_MATCH_STATE=y
CONFIG_NETFILTER_XT_MATCH_STATISTIC=y
CONFIG_NETFILTER_XT_MATCH_STRING=y
CONFIG_NETFILTER_XT_MATCH_TCPMSS=y
CONFIG_NETFILTER_XT_MATCH_TIME=y
CONFIG_NETFILTER_XT_MATCH_U32=y
CONFIG_NF_CONNTRACK_IPV4=y
CONFIG_IP_NF_IPTABLES=y
CONFIG_IP_NF_MATCH_AH=y
CONFIG_IP_NF_MATCH_ECN=y
CONFIG_IP_NF_MATCH_TTL=y
CONFIG_IP_NF_FILTER=y
CONFIG_IP_NF_TARGET_REJECT=y
CONFIG_IP_NF_NAT=y
CONFIG_IP_NF_TARGET_MASQUERADE=y
CONFIG_IP_NF_TARGET_NETMAP=y
CONFIG_IP_NF_TARGET_REDIRECT=y
CONFIG_IP_NF_MANGLE=y
CONFIG_IP_NF_RAW=y
CONFIG_IP_NF_SECURITY=y
CONFIG_IP_NF_ARPTABLES=y
CONFIG_IP_NF_ARPFILTER=y
CONFIG_IP_NF_ARP_MANGLE=y
CONFIG_NF_CONNTRACK_IPV6=y
CONFIG_IP6_NF_IPTABLES=y
CONFIG_IP6_NF_MATCH_FRAG=y
CONFIG_IP6_NF_MATCH_IPV6HEADER=y
CONFIG_IP6_NF_MATCH_RPFILTER=y
CONFIG_IP6_NF_TARGET_HL=y
CONFIG_IP6_NF_FILTER=y
CONFIG_IP6_NF_TARGET_REJECT=y
CONFIG_IP6_NF_MANGLE=y
CONFIG_IP6_NF_RAW=y
CONFIG_L2TP=y
CONFIG_BRIDGE=y
CONFIG_VLAN_8021Q=y
CONFIG_NET_SCHED=y
CONFIG_NET_SCH_HTB=y
CONFIG_NET_SCH_INGRESS=y
CONFIG_NET_CLS_FW=y
CONFIG_NET_CLS_U32=y
CONFIG_CLS_U32_MARK=y
CONFIG_NET_CLS_FLOW=y
CONFIG_NET_EMATCH=y
CONFIG_NET_EMATCH_U32=y
CONFIG_NET_CLS_ACT=y
CONFIG_NET_ACT_POLICE=y
CONFIG_NET_ACT_MIRRED=y
CONFIG_NET_ACT_IPT=y
CONFIG_NET_CLS_IND=y
CONFIG_CFG80211=y
CONFIG_NL80211_TESTMODE=y
CONFIG_CFG80211_DEVELOPER_WARNINGS=y
# CONFIG_CFG80211_DEFAULT_PS is not set
CONFIG_CFG80211_DEBUGFS=y
CONFIG_CFG80211_INTERNAL_REGDB=y
CONFIG_MTK_NET_LOGGING=y
CONFIG_LGE_NFC=y
CONFIG_LGE_NFC_PN547_C2=y
CONFIG_PN5XX_MTK_PLATFORM=y
CONFIG_MTD=y
# CONFIG_MTD_OF_PARTS is not set
CONFIG_MTD_BLOCK=y
CONFIG_MTD_NAND_IDS=y
CONFIG_ZRAM=y
CONFIG_ZRAM_LZ4_COMPRESS=y
CONFIG_ZRAM_DEBUG=y
CONFIG_BLK_DEV_LOOP=y
CONFIG_UID_STAT=y
CONFIG_UID_SYS_STATS=y
CONFIG_MEDIATEK_SOLUTION=y
CONFIG_MTK_PLATFORM="mt6755"
CONFIG_ARCH_MTK_PROJECT="muse6750_lv7_o"
# CONFIG_MTK_DTBO_FEATURE is not set
CONFIG_MTK_LATE_MOUNT=y
# CONFIG_TARGET_COPY_OUT_ODM is not set
CONFIG_MTK_SHARED_SDCARD=y
CONFIG_MTK_GPT_SCHEME_SUPPORT=y
CONFIG_MTK_FREQ_HOPPING=y
CONFIG_MTK_PMIC_NEW_ARCH=y
CONFIG_MTK_PMIC_CHIP_MT6353=y
CONFIG_MTK_THERMAL_PA_VIA_ATCMD=y
CONFIG_CUSTOM_KERNEL_IMGSENSOR="s5k2p8_mipi_raw ov8858_mipi_raw"
CONFIG_CUSTOM_KERNEL_CAM_CAL_DRV="Common_eeprom DW9763_eeprom ZC533_eeprom BRCB032GWZ3_eeprom"
CONFIG_MTK_CAM_CAL_COMMON_SUPPORT=y
CONFIG_MTK_CAM_CAL_DW9763_SUPPORT=y
CONFIG_MTK_CAM_CAL_ZC533_SUPPORT=y
CONFIG_MTK_CAM_CAL_BRCB032GWZ3_SUPPORT=y
CONFIG_MTK_CAM_CAL=y
CONFIG_MTK_CAM_CAL_COMMON="common_cam_cal_drv"
CONFIG_MTK_CAM_CAL_LIST="DW9763 ZC533 BRCB032GWZ3"
CONFIG_MTK_CMDQ=y
CONFIG_MTK_CQDMA=y
CONFIG_MTK_FLASHLIGHT=y
CONFIG_CUSTOM_KERNEL_FLASHLIGHT="constant_flashlight"
CONFIG_MTK_GPU_SUPPORT=y
CONFIG_MTK_GPU_VERSION="mali midgard r18p0"
CONFIG_MTK_GPU_COMMON_DVFS_SUPPORT=y
CONFIG_MTK_IMGSENSOR=y
CONFIG_MTK_JPEG=y
CONFIG_MTK_LCM=y
CONFIG_CUSTOM_KERNEL_LCM="td4100_hd720_dsi_vdo_tovis_lv7"
CONFIG_TOVIS_INCELL_TD4100_HD_LV7=y
CONFIG_TOVIS_INCELL_TD4100_HD_LV7_SPR=y
CONFIG_MTK_LENS=y
CONFIG_MTK_LENS_DUMMYLENS_SUPPORT=y
CONFIG_MTK_LENS_DW9763AF_SUPPORT=y
CONFIG_MTK_LENS_ZC533AF_SUPPORT=y
CONFIG_MTK_MMPROFILE_SUPPORT=y
CONFIG_MMPROFILE=y
CONFIG_MTK_SYNC=y
CONFIG_MTK_VIDEOCODEC_DRIVER=y
CONFIG_MTK_FB=y
CONFIG_MTK_VIDEOX=y
CONFIG_MTK_LCM_PHYSICAL_ROTATION="0"
CONFIG_LCM_HEIGHT="1280"
CONFIG_LCM_WIDTH="720"
CONFIG_LCM_SEND_CMD_IN_VIDEO=y
CONFIG_TUNING_MIPI_CLOCK=y
CONFIG_LGE_COMFORT_VIEW=y
CONFIG_LGE_VSYNC_SKIP=y
CONFIG_MTK_SENSOR_SUPPORT=y
CONFIG_MTK_SENSORS_1_0=y
CONFIG_CUSTOM_KERNEL_ACCELEROMETER=y
CONFIG_MTK_BMI160_NEW=y
CONFIG_CUSTOM_KERNEL_ALSPS=y
CONFIG_MTK_APDS9930_NEW=y
CONFIG_LGE_SENSOR_DYNAMIC_AGAIN=y
CONFIG_CUSTOM_KERNEL_GYROSCOPE=y
CONFIG_MTK_BMI160GY_NEW=y
CONFIG_CUSTOM_KERNEL_MAGNETOMETER=y
CONFIG_MTK_AKM09916=y
CONFIG_LGE_SENSOR_UNIFIED_NODE=y
CONFIG_MTK_HWMON=y
CONFIG_CUSTOM_KERNEL_SENSOR_CAL=y
CONFIG_MTK_BTIF=y
CONFIG_MTK_MD1_SUPPORT=10
CONFIG_MTK_COMBO=y
CONFIG_MTK_COMBO_CHIP_CONSYS_6755=y
CONFIG_MTK_COMBO_BT=y
CONFIG_MTK_COMBO_GPS=y
CONFIG_MTK_COMBO_WIFI=y
# CONFIG_MTK_WAPI_SUPPORT is not set
CONFIG_MTK_PASSPOINT_R1_SUPPORT=y
CONFIG_MTK_PASSPOINT_R2_SUPPORT=y
CONFIG_MTK_GPS_SUPPORT=y
CONFIG_MTK_FMRADIO=y
CONFIG_MTK_FM_CHIP="MT6625_FM"
CONFIG_MTK_ECCCI_DRIVER=y
CONFIG_MTK_ECCCI_C2K=y
CONFIG_MTK_ACCDET=y
CONFIG_ACCDET_EINT=y
CONFIG_FOUR_KEY_HEADSET=y
CONFIG_MTK_DEBUG_LATCH=y
CONFIG_MTK_LASTPC=y
CONFIG_MTK_LASTBUS=y
CONFIG_MTK_DEVAPC_DRIVER=y
CONFIG_MTK_DRAMC=y
CONFIG_MTK_LEDS=y
CONFIG_CUSTOM_KERNEL_CHARGEPUMP=y
CONFIG_LEDS_LM3648=y
CONFIG_LEDS_DW8767=y
CONFIG_USB_MU3D_DRV=y
CONFIG_MTK_SIB_USB_SWITCH=y
CONFIG_USB_MU3D_ONLY_U2_MODE=y
CONFIG_MU3_PHY=y
CONFIG_U3_PHY_AHB_SUPPORT=y
CONFIG_PROJECT_PHY=y
CONFIG_MTK_PWM=y
CONFIG_MTK_RTC=y
CONFIG_RTC_INTF_SECCLK=y
CONFIG_MTK_SMI_EXT=y
# CONFIG_USB_MTK_HDRC is not set
CONFIG_MTK_MUSB_QMU_SUPPORT=y
CONFIG_MTK_VIBRATOR=y
CONFIG_USB_XHCI_MTK=y
CONFIG_USB_MTK_DUALMODE=y
CONFIG_MTK_MEMCFG=y
CONFIG_MTK_AEE_FEATURE=y
CONFIG_MTK_AEE_MRDUMP=y
CONFIG_MTK_CHIP=y
CONFIG_MTK_DRAM_LOG_STORE=y
CONFIG_MTK_DRAM_LOG_STORE_ADDR=0x0011DF00
CONFIG_MTK_DRAM_LOG_STORE_SIZE=0x100
CONFIG_TRUSTONIC_TEE_SUPPORT=y
CONFIG_MOBICORE_DRIVER=y
CONFIG_MOBICORE_API=y
CONFIG_MTPROF=y
CONFIG_MTK_WQ_DEBUG=y
CONFIG_MT_SCHED_MONITOR=y
CONFIG_MT_RT_THROTTLE_MON=y
CONFIG_PREEMPT_MONITOR=y
CONFIG_MTK_PERFMGR_TOUCH_BOOST=y
CONFIG_MTK_RAM_CONSOLE=y
CONFIG_MTK_RAM_CONSOLE_USING_SRAM=y
CONFIG_MTK_RAM_CONSOLE_SIZE=0xc00
CONFIG_MTK_RAM_CONSOLE_ADDR=0x0011D000
CONFIG_MTK_RAM_CONSOLE_DRAM_SIZE=0x10000
CONFIG_MTK_RAM_CONSOLE_DRAM_ADDR=0x44400000
CONFIG_MTK_SCHED_RQAVG_KS=y
CONFIG_MTK_SCHED_RQAVG_US=y
CONFIG_MT_CPU_AFFINITY=y
CONFIG_MT_LOAD_BALANCE_ENHANCEMENT=y
CONFIG_MT_SCHED_INTEROP=y
CONFIG_MT_SCHED_TRACE=y
CONFIG_MTK_CPU_TOPOLOGY=y
CONFIG_MTK_SCHED_CMP=y
CONFIG_MTK_SCHED_CMP_TGS=y
CONFIG_MTK_SCHED_CMP_TGS_WAKEUP=y
CONFIG_SCHED_HMP=y
CONFIG_SCHED_HMP_PRIO_FILTER=y
CONFIG_HMP_TRACER=y
CONFIG_SCHED_HMP_PLUS=y
CONFIG_MTK_SYSENV=y
CONFIG_MTK_TC1_FEATURE=y
# CONFIG_SCSI_LOWLEVEL is not set
CONFIG_MD=y
CONFIG_BLK_DEV_DM=y
CONFIG_DM_DEBUG=y
CONFIG_DM_CRYPT=y
CONFIG_DM_UEVENT=y
CONFIG_DM_VERITY=y
CONFIG_DM_VERITY_FEC=y
CONFIG_NETDEVICES=y
CONFIG_IFB=y
CONFIG_TUN=y
# CONFIG_ETHERNET is not set
CONFIG_PPP=y
CONFIG_PPP_BSDCOMP=y
CONFIG_PPP_DEFLATE=y
CONFIG_PPP_FILTER=y
CONFIG_PPP_MPPE=y
CONFIG_PPP_MULTILINK=y
CONFIG_PPPOE=y
CONFIG_PPPOL2TP=y
CONFIG_PPPOLAC=y
CONFIG_PPPOPNS=y
CONFIG_PPP_ASYNC=y
CONFIG_PPP_SYNC_TTY=y
# CONFIG_INPUT_MOUSEDEV is not set
# CONFIG_KEYBOARD_ATKBD is not set
# CONFIG_INPUT_MOUSE is not set
CONFIG_INPUT_TOUCHSCREEN=y
CONFIG_LGE_TOUCH_CORE=y
CONFIG_LGE_TOUCH_CORE_MTK=y
CONFIG_LGE_TOUCH_FW_PATH="touch/lv7/synaptics"
CONFIG_LGE_TOUCH_SYNAPTICS_TD4100=y
CONFIG_LGE_TOUCH_TOVIS_SYNAPTICS_TD4100=y
# CONFIG_LGE_TOUCH_HALL_IC_COVER is not set
CONFIG_KEYBOARD_MTK=y
CONFIG_TWOKEY_REBOOT_NORMAL_MODE=y
CONFIG_KPD_PWRKEY_USE_PMIC=y
CONFIG_INPUT_MISC=y
CONFIG_INPUT_KEYCHORD=y
CONFIG_INPUT_UINPUT=y
# CONFIG_MTK_FINGERPRINT_SUPPORT=y
# CONFIG_LGE_FINGERPRINT_KEYMODE=y
# CONFIG_LGE_FINGERPRINT_ONE_BINARY=y
# CONFIG_GOODIX_FINGERPRINT=y
# CONFIG_SERIO is not set
# CONFIG_VT is not set
# CONFIG_LEGACY_PTYS is not set
# CONFIG_HW_RANDOM is not set
CONFIG_SPI=y
CONFIG_MTK_SPI=y
CONFIG_MTK_SMART_BATTERY=y
CONFIG_MTK_HAFG_20=y
CONFIG_MTK_PUMP_EXPRESS_PLUS_SUPPORT=y
CONFIG_MTK_PUMP_EXPRESS_PLUS_20_SUPPORT=y
CONFIG_LGE_PM_EXTERNAL_CHARGER_SUPPORT=y
CONFIG_LGE_PM_EXTERNAL_CHARGER_SM5424_SUPPORT=y
CONFIG_LGE_PM_EXTERNAL_CHARGER_BQ25898S_SLAVE_SUPPORT=y
CONFIG_LGE_PM_BATTERY_OCV_COMPENSATE=y
CONFIG_LGE_PM_BATTERY_PRESENT=y
CONFIG_LGE_PM_CHARGER_CONTROLLER=y
CONFIG_LGE_PM_FLOATED_CHARGER_DETECT=y
CONFIG_LGE_PM_LLK_MODE=y
CONFIG_LGE_PM_MTK_POWERTOP=y
CONFIG_LGE_PM_MTK_SAVE_BATTERY_CYCLE_GM_2_0=y
CONFIG_LGE_PM_MTK_CANCUN_GOV=y
CONFIG_LGE_PM_MTK_GAME_MODE=y
CONFIG_LGE_PM_MTK_PRM=y
CONFIG_POWER_AWARENESS_HPS=y
CONFIG_SCHED_NEURAL_NETWORKS=y
# CONFIG_HWMON is not set
CONFIG_THERMAL=y
CONFIG_THERMAL_DEFAULT_GOV_BACKWARD_COMPATIBLE=y
CONFIG_WATCHDOG=y
CONFIG_MFD_SYSCON=y
CONFIG_REGULATOR=y
CONFIG_FB=y
CONFIG_FB_MODE_HELPERS=y
CONFIG_FB_TILEBLITTING=y
CONFIG_LOGO=y
CONFIG_SOUND=y
CONFIG_SND=y
CONFIG_SND_SEQUENCER=y
CONFIG_SND_SEQ_DUMMY=y
CONFIG_SND_PCM_OSS=y
CONFIG_SND_SEQUENCER_OSS=y
CONFIG_SND_HRTIMER=y
CONFIG_SND_DYNAMIC_MINORS=y
CONFIG_SND_VERBOSE_PRINTK=y
CONFIG_SND_DEBUG=y
CONFIG_SND_DEBUG_VERBOSE=y
CONFIG_SND_PCM_XRUN_DEBUG=y
# CONFIG_SND_SPI is not set
CONFIG_SND_SOC=y
CONFIG_MT_SND_SOC_6750=y
CONFIG_MTK_SPEAKER=y
CONFIG_MTK_HP_ANASWITCH=y
CONFIG_MTK_BTCVSD_ALSA=y
CONFIG_MTK_LGE_EXT_SPEAKER_AMP=y
CONFIG_SND_SOC_TPA2015D=y
CONFIG_MTK_LGE_FM_TDMB_SWITCH=y
CONFIG_MTK_LGE_HSOUT_GAIN=y
CONFIG_SND_SIMPLE_CARD=y
CONFIG_SOUND_PRIME=y
CONFIG_USB_ANNOUNCE_NEW_DEVICES=y
CONFIG_USB_XHCI_HCD=y
CONFIG_USB_TRANCEVIBRATOR=y
CONFIG_NOP_USB_XCEIV=y
CONFIG_USB_GADGET=y
CONFIG_USB_GADGET_VBUS_DRAW=500
CONFIG_USB_G_ANDROID=y
CONFIG_LGE_USB_G_ANDROID=y
CONFIG_LGE_USB_FACTORY=y
CONFIG_LGE_USB_G_AUTORUN=y
CONFIG_LGE_USB_G_CDROM_MAC_SUPPORT=y
CONFIG_LGE_USB_G_MULTIPLE_CONFIGURATION=y
CONFIG_LGE_USB_EMBEDDED_BATTERY=y
CONFIG_LGE_USB_DIAG_LOCK=y
CONFIG_LGE_USB_HOST_SUPPORT_LIST_HID=y
CONFIG_LGE_USB_HOST_SUPPORT_LIST_NETWORK=y
CONFIG_LGE_USB_HOST_SUPPORT_LIST_INPUT=y
CONFIG_LGE_USB_HOST_SUPPORT_LIST_SOUND=y
CONFIG_LGE_USB_HOST_SUPPORT_LIST_VIDEO=y
CONFIG_LGE_USB_HOST_SUPPORT_LIST_STORAGE=y
CONFIG_LGE_USB_HOST_SUPPORT_LIST_SERIAL=y
CONFIG_MMC=y
CONFIG_MMC_BLOCK_MINORS=32
CONFIG_MMC_MTK=y
CONFIG_MTK_EMMC_SUPPORT=y
CONFIG_MTK_EMMC_CACHE=y
CONFIG_MTK_EMMC_CQ_SUPPORT=y
CONFIG_MMC_DELAYED_SDCARD_INIT=y
CONFIG_LGE_MMC_RESET_IF_HANG=y
CONFIG_LEDS_TRIGGERS=y
CONFIG_LEDS_TRIGGER_TIMER=y
CONFIG_SWITCH=y
CONFIG_RTC_CLASS=y
# CONFIG_RTC_SYSTOHC is not set
CONFIG_STAGING=y
CONFIG_ANDROID=y
CONFIG_ANDROID_BINDER_IPC=y
CONFIG_ASHMEM=y
CONFIG_ANDROID_LOW_MEMORY_KILLER=y
CONFIG_SYNC=y
CONFIG_SW_SYNC=y
CONFIG_SW_SYNC_USER=y
CONFIG_ION=y
CONFIG_MTK_ION=y
CONFIG_MACH_MT6750_LV7=y
CONFIG_T32_ON_MTK=y
CONFIG_LGE_PM=y
CONFIG_LGE_PM_DEBUG=y
CONFIG_LGE_BOOTLOADER_LOG=y
CONFIG_LGE_RTC_TIMESTAMP=y
CONFIG_PRE_SELF_DIAGNOSIS=y
CONFIG_LGE_PM_PSEUDO_BATTERY=y
CONFIG_LGE_PM_USB_CURRENT_MAX=y
CONFIG_LGE_PM_BATTERY_ID_CHECKER=y
CONFIG_LGE_PM_BATTERY_ID_EMBEDDED_ADC=y
CONFIG_LGE_PM_USB_ID=y
CONFIG_LGE_PM_USB_ID_R_100K=y
CONFIG_LGE_PM_AT_CMD_SUPPORT=y
CONFIG_LGE_HALLIC=y
CONFIG_SMART_COVER_DETECTION=y
CONFIG_LGE_BOOT_MODE=y
CONFIG_LGE_HANDLE_PANIC=y
CONFIG_LGE_HANDLE_PANIC_BY_KEY=y
CONFIG_LGE_PM_CHARGERLOGO=y
CONFIG_LGE_PM_CHARGERLOGO_WAIT_FOR_FG_INIT=y
CONFIG_LGE_QFPROM_INTERFACE=y
CONFIG_LGE_QFPROM_SECHASH="89d8f7d68a20c21335d17bda4eadc284d4c20e67c48a8a169d7b698dbcf06e68"
CONFIG_LGE_MTK_RTB=y
CONFIG_LGE_MTK_RTB_SEPARATE_CPUS=y
# CONFIG_ARM_ARCH_TIMER_SUSPEND_NONSTOP is not set
CONFIG_EXT4_FS=y
CONFIG_EXT4_FS_SECURITY=y
CONFIG_EXT4_DEBUG=y
CONFIG_QUOTA=y
CONFIG_QUOTA_NETLINK_INTERFACE=y
CONFIG_QFMT_V2=y
CONFIG_FUSE_FS=y
CONFIG_FUSE_SHORTCIRCUIT_PLUS=y
CONFIG_ISO9660_FS=y
CONFIG_JOLIET=y
CONFIG_ZISOFS=y
CONFIG_MSDOS_FS=y
CONFIG_VFAT_FS=y
CONFIG_TMPFS=y
CONFIG_SDCARD_FS=y
CONFIG_ECRYPT_FS=y
CONFIG_SD_ENCRYPTION_MANAGER=y
CONFIG_PSTORE=y
CONFIG_PSTORE_CONSOLE=y
CONFIG_PSTORE_PMSG=y
CONFIG_PSTORE_RAM=y
CONFIG_PSTORE_CONSOLE_SIZE=0x40000
CONFIG_PSTORE_PMSG_SIZE=0x10000
CONFIG_PSTORE_MEM_ADDR=0x44410000
CONFIG_PSTORE_MEM_SIZE=0xe0000
# CONFIG_NETWORK_FILESYSTEMS is not set
CONFIG_NLS_CODEPAGE_437=y
CONFIG_NLS_CODEPAGE_950=y
CONFIG_NLS_ASCII=y
CONFIG_NLS_ISO8859_1=y
CONFIG_NLS_UTF8=y
CONFIG_LGE_SREADAHEAD=y
CONFIG_PRINTK_TIME=y
CONFIG_DYNAMIC_DEBUG=y
CONFIG_DEBUG_INFO=y
CONFIG_FRAME_WARN=1400
CONFIG_PAGE_OWNER=y
CONFIG_PAGE_OWNER_SLIM=y
CONFIG_SLUB_DEBUG_ON=y
CONFIG_DEBUG_KMEMLEAK=y
CONFIG_DEBUG_KMEMLEAK_EARLY_LOG_SIZE=3200
CONFIG_DEBUG_KMEMLEAK_DEFAULT_OFF=y
CONFIG_DETECT_HUNG_TASK=y
CONFIG_PANIC_ON_OOPS=y
CONFIG_PANIC_TIMEOUT=5
CONFIG_SCHEDSTATS=y
CONFIG_DEBUG_SPINLOCK=y
CONFIG_DEBUG_MUTEXES=y
CONFIG_DEBUG_ATOMIC_SLEEP=y
CONFIG_DEBUG_LIST=y
CONFIG_RCU_CPU_STALL_TIMEOUT=60
CONFIG_RCU_TRACE=y
CONFIG_FAULT_INJECTION=y
CONFIG_SLUB_DEBUG_PANIC_ON=y
CONFIG_ENABLE_DEFAULT_TRACERS=y
CONFIG_MTK_SCHED_TRACERS=y
CONFIG_MTK_FTRACE_DEFAULT_ENABLE=y
CONFIG_DMA_API_DEBUG=y
CONFIG_KGDB=y
CONFIG_KGDB_KDB=y
# CONFIG_ARM_UNWIND is not set
CONFIG_KEYS=y
CONFIG_ENCRYPTED_KEYS=y
CONFIG_SECURITY_PERF_EVENTS_RESTRICT=y
CONFIG_SECURITY=y
CONFIG_SECURITY_NETWORK=y
CONFIG_HARDENED_USERCOPY=y
CONFIG_SECURITY_SELINUX=y
CONFIG_SECURITY_SELINUX_BOOTPARAM=y
CONFIG_CRYPTO_NULL=y
CONFIG_CRYPTO_CTR=y
CONFIG_CRYPTO_XCBC=y
CONFIG_CRYPTO_SHA512=y
CONFIG_CRYPTO_AES_ARM32_CE=y
CONFIG_CRYPTO_TWOFISH=y
CONFIG_CRYPTO_LZO=y
CONFIG_KPD_PMIC_LPRST_TD=0
# CONFIG_CRYPTO_ANSI_CPRNG is not set
# CONFIG_CRYPTO_HW is not set
CONFIG_LGE_BROADCAST_TDMB=y
CONFIG_TCP_CONG_ADVANCED=y
CONFIG_TCP_CONG_BIC=y
CONFIG_DEFAULT_BIC=y
CONFIG_LGP_DATA_TCPIP_IPV6_MTU_MTK=y
CONFIG_LGE_LCD_OFF_DIMMING=y
CONFIG_MT6750_LV7_KR=y
CONFIG_TRUSTONIC_TEE_VERSION="302d"
CONFIG_INET6_XFRM_MODE_BEET=y
CONFIG_INET6_XFRM_MODE_TRANSPORT=y
CONFIG_INET6_XFRM_MODE_TUNNEL=y
# CONFIG_INET6_XFRM_TUNNEL is not set
CONFIG_INET_XFRM_MODE_BEET=y
CONFIG_INET_XFRM_MODE_TRANSPORT=y
CONFIG_INET_XFRM_MODE_TUNNEL=y
CONFIG_IP6_NF_NAT=y
# CONFIG_IP6_NF_TARGET_REJECT_SKERR is not set
CONFIG_IP_NF_MATCH_RPFILTER=y
# CONFIG_IP_NF_TARGET_REJECT_SKERR is not set
CONFIG_IP_ROUTE_VERBOSE=y
CONFIG_NETFILTER_TPROXY=y
CONFIG_NETFILTER_XT_MATCH_DSCP=y
CONFIG_NETFILTER_XT_MATCH_ESP=y
CONFIG_NETFILTER_XT_TARGET_HARDIDLETIMER=y
# CONFIG_NETFILTER_XT_TARGET_LOG is not set
# CONFIG_NETFILTER_XT_TARGET_NOTRACK is not set
# CONFIG_NETFILTER_XT_TARGET_TEE is not set
CONFIG_NET_EMATCH_CMP=y
CONFIG_NET_EMATCH_META=y
CONFIG_NET_EMATCH_NBYTE=y
CONFIG_NET_EMATCH_TEXT=y
CONFIG_NET_SCH_CBQ=y
CONFIG_NET_SCH_CHOKE=y
CONFIG_NET_SCH_DRR=y
CONFIG_NET_SCH_DSMARK=y
CONFIG_NET_SCH_GRED=y
CONFIG_NET_SCH_HFSC=y
CONFIG_NET_SCH_MQPRIO=y
CONFIG_NET_SCH_MULTIQ=y
CONFIG_NET_SCH_NETEM=y
CONFIG_NET_SCH_QFQ=y
CONFIG_NET_SCH_RED=y
CONFIG_NET_SCH_SFB=y
CONFIG_NET_SCH_SFQ=y
CONFIG_NET_SCH_TBF=y
CONFIG_NET_SCH_TEQL=y
# CONFIG_NF_CONNTRACK_SIP is not set
CONFIG_NF_CONNTRACK_TIMEOUT=y
CONFIG_NF_CONNTRACK_TIMESTAMP=y
CONFIG_NF_NAT_IPV4=y
CONFIG_NF_NAT_IPV6=y
CONFIG_XFRM_STATISTICS=y
```
