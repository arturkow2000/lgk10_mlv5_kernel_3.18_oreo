## drivers/input/epack/Kconfig
```kconfig
#
# External-pack
#

config INPUT_EPACK
	bool "External-pack device"
	default n
	---help---
	  Say Y here if you are using a driver for an external-pack
```

## drivers/input/fingerprint/Kconfig
```kconfig
#
#Fingerprint
#
menu "Fingerprint support"
	depends on INPUT

config MTK_FINGERPRINT_SUPPORT
	bool "Mediatek Fingerprint"
	default n
	---help---
	Fingerprint mtk driver enable/disable in the kernel.
	Say Y here if you want to use mediatek fingerprint driver,
	fingerprint driver will support fingerprint function

if MTK_FINGERPRINT_SUPPORT
#config MTK_FINGERPRINT_SELECT
#	string "sensor type"
#	default "GF3208"

#if MTK_FINGERPRINT_SELECT = "FPC1145"
#config FPC_FINGERPRINT
#	bool "FPC Fingerprint"
#	default y
#	---help---
#	FPC fingerprint FPC's 102x/104x device.
#endif

#if MTK_FINGERPRINT_SELECT = "FPC1028"
config FPC_FINGERPRINT
	bool "FPC Fingerprint"
	default n
	---help---
	FPC fingerprint FPC's FPC1028 device.
#endif

config FPC_CHECK_CONTACT
	bool "FPC_CHECK_CONTACT"
	default n
	help
	If you say yes here you get debugging support to check contact about pin.

#if MTK_FINGERPRINT_SELECT = "GF3208"
config LGE_FINGERPRINT_KEYMODE
	bool "support fingerprint key mode"
	default n

config LGE_FINGERPRINT_ONE_BINARY
	bool "support fingerprint one binary"
	default n

config GOODIX_FINGERPRINT
	bool "Goodix Fingerprint"
	default n
	---help---
	Goodix Fingerprint chip GF316M/GF318M/GF3118M/GF518M/GF5118M/GF516M/GF816M/GF3208/GF5216 TEE driver

#config GOODIX_SENSOR_TYPE
#	string "SENSOR_TYPE"
#	default "GF3208"
#	---help---
#	Must input sensor type, or default is GF316M GF318M GF3118M GF518M GF5118M GF516M GF816M GF3208 GF5216
#endif
endif
endmenu
```

## drivers/input/sar_sensor_1/Kconfig
```kconfig
config INPUT_SX9310_1
	tristate "SX9310_SAR_1_sensor"
	depends on SAR_SENSOR_SX9310
	default n
	help
	  Say Y to enable the SAR detection application, if N here not to use the
	  this SAR sensor
```

## drivers/input/sar_sensor_2/Kconfig
```kconfig
config INPUT_SX9310_2
	tristate "SX9310_SAR_2_sensor"
	depends on SAR_SENSOR_SX9310
	default n
	help
	  Say Y to enable the SAR detection application, if N here not to use the
	  this SAR sensor
```

## drivers/input/touchscreen/lge/focaltech/FT8006M/Kconfig
```kconfig
#
# LGE touch core configuration
#
if INPUT_TOUCHSCREEN

menuconfig LGE_TOUCH_FOCALTECH_FT8006M
	bool "LGE Touch Core ODM Device Driver - FT8006M"
	depends on LGE_TOUCH_CORE_BASE
	help
	  If your device is ft8006m, say Y
# To Do : Focal Tech Chipseet

#source "drivers/input/touchscreen/lge/focaltech/fts/Kconfig"

endif
```

## drivers/input/touchscreen/lge/focaltech/Kconfig
```kconfig
#
# LGE touch core configuration
#
if INPUT_TOUCHSCREEN

source "drivers/input/touchscreen/lge/focaltech/FT8006M/Kconfig"
source "drivers/input/touchscreen/lge/focaltech/ft5526/Kconfig"

endif
```

## drivers/input/touchscreen/lge/focaltech/ft5526/Kconfig
```kconfig
#
# LGE touch core configuration
#
if INPUT_TOUCHSCREEN

menuconfig LGE_TOUCH_FOCALTECH_FT5526
	bool "LGE Touch Core ODM Device Driver - FT5526"
	depends on LGE_TOUCH_CORE_BASE
	help
	  If your device is ft5526, say Y
# To Do : Focal Tech Chipseet

#source "drivers/input/touchscreen/lge/focaltech/ft5526/fts/Kconfig"

endif
```

## drivers/input/touchscreen/lge_nos/melfas/Kconfig
```kconfig
#
# LGE touch core configuration
#
if INPUT_TOUCHSCREEN

menuconfig LGE_TOUCH_MELFAS_MIT300
	bool "LGE Touch Core ODM Device Driver - Melfas(mit300)"
	depends on LGE_TOUCH_CORE_BASE
	help
	  If your device is Melfas(mit300), say Y

endif
```

## drivers/input/touchscreen/lge_nos/sentron/Kconfig
```kconfig
#
# LGE touch core configuration
#

if INPUT_TOUCHSCREEN

menuconfig LGE_TOUCH_SENTRON_SSD6600
	bool "LGE Touch Core ODM Device Driver - Sentron(SSD6600)"
	depends on LGE_TOUCH_CORE_BASE
	help
	  If your device is sentron(ssd6600), say Y

endif
```

## drivers/input/touchscreen/lge_nos/sharp/Kconfig
```kconfig
#
# LGE touch core configuration
#

if INPUT_TOUCHSCREEN

menuconfig LGE_TOUCH_SHARP_LR388K6
	bool "LGE Touch Core ODM Device Driver - Sharp(LR388K6)"
	depends on LGE_TOUCH_CORE_BASE
	help
	  If your device is Sharp(LR388K6), say Y

endif
```

## drivers/input/touchscreen/mediatek/lge/synaptics_lv7/Kconfig
```kconfig
#
# LGE touch core configuration
#

if INPUT_TOUCHSCREEN

menuconfig LGE_TOUCH_SYNAPTICS_TD4100_LV7
	bool "LGE Touch Core ODM Device Driver - Synaptics(td4100_lv7)"
	depends on LGE_TOUCH_CORE_BASE
	help
	  If your device is synaptics(td4100_lv7), say Y

menuconfig LGE_TOUCH_TOVIS_SYNAPTICS_TD4100
	bool "LGE Touch Core ODM Device Driver - Tovis Synaptics(td4100)"
	depends on LGE_TOUCH_CORE_BASE
	help
	  If your device is tovis synaptics(td4100), say Y

endif
```

## drivers/misc/mediatek/broadcast/Kconfig
```kconfig
# LGE Broadcast Device Driver Support

menu "LGE Broadcast Device Support"


config LGE_BROADCAST_SBTVD_LATIN
	bool "1Seg Broadcast service"
	depends on (ARCH_MT6755)
	default n
	help
	  Select this if you want to use Japanese 1Seg mobile broadcast service

config LGE_BROADCAST_TDMB
	bool "LGE broadcast TDMB device Driver"
	depends on (ARCH_MT6755)
	default n
	help
	  Select this if you want to use TDMB broadcast service

source "drivers/misc/mediatek/broadcast/oneseg/Kconfig"
source "drivers/misc/mediatek/broadcast/tdmb/Kconfig"
endmenu
```

## drivers/misc/mediatek/broadcast/oneseg/Kconfig
```kconfig
#
# Broadcast Device Driver Support
#

menu "LGE Japanese/Latin Mobile Broadcast(ISDB-T 1seg/ISDB-Tmm 13seg) Device Support"

config LGE_BROADCAST_ONESEG_FC8180
	bool "1Seg broacast tuner chipset fc8180 device driver"
	depends on LGE_BROADCAST_SBTVD_LATIN
	default y
	help
	  Select this if you want to use Japanese/Latin 1Seg mobile broadcast service

endmenu
```

## drivers/misc/mediatek/cam_cal/Kconfig
```kconfig
config MTK_CAM_CAL
  bool CONFIG_MTK_CAM_CAL
  default n
  help
    CONFIG_MTK_CAM_CAL define if the camera cal driver should be built in or not
config CUSTOM_KERNEL_CAM_CAL_DRV
        string "CUSTOM_KERNEL_CAM_CAL_DRV"
        help
          Kernel space camera cal driver. You can use this driver
          choose camera cal type.
config MTK_CAM_CAL_COMMON
       string "MTK_CAM_CAL_COMMON"
	   help
	     To support common camcal driver.
config MTK_CAM_CAL_LIST
       string "MTK_CAM_CAL_LIST"
	   help
	     To support multiple camcal driver.
```

## drivers/misc/mediatek/chargepump/Kconfig
```kconfig
config	CUSTOM_KERNEL_CHARGEPUMP
	bool "chargepump Support"
	default n
	help
	  This feature Option is used for projects which using exteranl backlight driver
	  if you want to  external backlight driver, please turn on this feature first,
	  then LED driver call external backlight driver API.
	  Also this feature related to flashlight and DSV driver.

config LEDS_RT4832
	bool "RT4832 Support"
	default n
	help
	  charge pump driver for external backlight and flashlight
	  it support DSV, flashlight, LED module.
	  if you want to use external backlight driver moulde on your project,
	  please turn on chargepump option also.


config LEDS_DW8767_CV1
	bool "DW8767 Support"
	default n
	help
	  charge pump driver for external backlight and flashlight
	  it support DSV, flashlight, LED module.
	  if you want to use external backlight driver moulde on your project,
	  please turn on chargepump option also.
config LEDS_RT8542
	bool "RT8542 Support"
	default n
	help
	  charge pump driver for external backlight and flashlight
	  it support DSV, flashlight, LED module.
	  if you want to use external backlight driver moulde on your project,
	  please turn on chargepump option also.

config DSV_SM5107
	bool "SM5107 Support"
	default n
	help
	  charge pump driver for external backlight and flashlight
	  it support DSV, flashlight, LED module.
	  if you want to use external backlight driver moulde on your project,
	  please turn on chargepump option also.

config LEDS_RT4832_LV5
	bool "RT4832 Support"
	default n
	help
	  charge pump driver for external backlight and flashlight
	  it support DSV, flashlight, LED module.
	  if you want to use external backlight driver moulde on your project,
	  please turn on chargepump option also.

config LGD_INCELL_LG4894_HD_LV5
	bool "LG4894_LV5 Support"
	default n
	help
	  charge pump driver for external backlight and flashlight
	  it support DSV, flashlight, LED module.
	  if you want to use external backlight driver moulde on your project,
	  please turn on chargepump option also.

config TOVIS_INCELL_TD4100_HD_LV7
	bool "TD4100_HD_LV7 Support"
	default n
	help
	  charge pump driver for external backlight and flashlight
	  it support DSV, flashlight, LED module.
	  if you want to use external backlight driver moulde on your project,
	  please turn on chargepump option also.

config LEDS_LM3632
	bool "LM3632 LED"
	default n

config LEDS_LM3648
	bool "LM3648 LED"
	default n

config LEDS_DW8767
	bool "DW8767 Support"
	default n
	help
	  charge pump driver for external backlight and flashlight
	  it support DSV, flashlight, LED module.
	  if you want to use external backlight driver moulde on your project,
	  please turn on chargepump option also.

config LEDS_DW8767_CV7A
	bool "DW8767 Support"
	default n
	help
		charge pump driver for external backlight and flashlight
		it support DSV, flashlight, LED module.
		if you want to use external backlight driver moulde on your project,
		please turn on chargepump option also.

config LEDS_OPR_MODE_RECOVERY
	bool "backlight operation mode recovery"
	default n
	help
		when the register for the operation mode of backlight has abnormal value,
		this feature recovers the value of register to normal value when the backlight turns on.
```

## drivers/misc/mediatek/freqhopping/Kconfig
```kconfig
config MTK_FREQ_HOPPING
    tristate "MediaTek FREQHOPPING driver"
    default N
    help
      FREQHOPPING driver support for MediaTek SOC
      If you want to use MediaTek FREQHOPPING driver, say Y or M here.If unsure, say N.

config MTK_MSDC_SSC_CONTROL
    bool "eMMC, SDCARD SSC control on"
    default N
    help
      FREQHOPPING set for SSC control
```

## drivers/misc/mediatek/lcd_bias/Kconfig
```kconfig
config HQ_SET_LCD_BIAS
	bool CONFIG_HQ_SET_LCD_BIAS
	default n
	help
	  HQ LCD BIAS driver
```

## drivers/misc/mediatek/lcm/Kconfig
```kconfig
config MTK_LCM
	bool CONFIG_MTK_LCM
	default n
	help
	  LCM driver

config CUSTOM_KERNEL_LCM
	string "CUSTOM_KERNEL_LCM"
	help
	  To choose kernel LCM driver name

config MTK_LCM_DEVICE_TREE_SUPPORT
	bool "MTK_LCM_DEVICE_TREE_SUPPORT"
	help
	  Decide whether to support LCM device tree based configuration.
	  This feature requires the connection between display driver and LCM devices.
	  Please also turn on MTK_LCM_DEVICE_TREE_SUPPORT in ProjectConfig.mk.

config LGE_LCM_KD_HX8394A_TH8
        bool "Enable King Display HX8394-A WXGA panel for TH8"
        default n

config LGE_DISPLAY_SIZE_CONTROL
	bool "LGE_DISPLAY_SIZE_CONTROL"
	default n
	help
	  To support display size control setting mode

source "drivers/misc/mediatek/lcm/sw49106_fhdplus_dsi_vdo_lgd_cv5/Kconfig"
source "drivers/misc/mediatek/lcm/td4100_hd720_dsi_vdo_tovis_lv7/Kconfig"
source "drivers/misc/mediatek/lcm/sw49107_lgd_fhdplus_dsi_cmd_cv7a/Kconfig"
source "drivers/misc/mediatek/lcm/lg4894_hd720_dsi_vdo_tovis_cv3_spr/Kconfig"
source "drivers/misc/mediatek/lcm/td4100_hd720_dsi_vdo_tovis_lv5/Kconfig"
source "drivers/misc/mediatek/lcm/lg4894_hd720_dsi_vdo/Kconfig"
source "drivers/misc/mediatek/lcm/ft8006m_hd720_dsi_vdo_tcl_cv1/Kconfig"
```

## drivers/misc/mediatek/lcm/ft8006m_hd720_dsi_vdo_tcl_cv1/Kconfig
```kconfig
config TCL_INCELL_FT8006M_HD_CV1
    bool "Enable TCL FT8006M INCELL HD panel for CV1"
    default n
```

## drivers/misc/mediatek/lcm/hx8394a_guoxian_inx_a026_zal2017/Kconfig
```kconfig
config LGE_LCM_KD_HX8394A_TH8
        bool "Enable King Display HX8394-A WXGA panel for TH8"
        default n
```

## drivers/misc/mediatek/lcm/lg4894_hd720_dsi_vdo/Kconfig
```kconfig
config LGD_INCELL_LG4894_HD_LV5
        bool "Enable LGD LG4894 INCELL HD panel for LV5"
        default n
```

## drivers/misc/mediatek/lcm/lg4894_hd720_dsi_vdo_tovis_cv3_spr/Kconfig
```kconfig
config TOVIS_INCELL_LG4894_HD_CV3_SPR
    bool "Enable TOVIS LG4894 INCELL HD panel for CV3 Sprint"
    default n
```

## drivers/misc/mediatek/lcm/sw49106_fhdplus_dsi_vdo_lgd_cv5/Kconfig
```kconfig
config SW49106_FHDPLUS_DSI_VDO_LGD_CV5
	bool "Enable LGD SW49106 INCELL FHD+ panel for MCV5"
	default n
	help
		LGD SW49106 INCELL FHD+ panel for MCV5
```

## drivers/misc/mediatek/lcm/sw49107_lgd_fhdplus_dsi_cmd_cv7a/Kconfig
```kconfig
config SW49107_LGD_FHDPLUS_DSI_CMD_CV7A
	bool "Enable LGD SW49107 INCELL Command Mode FHD+ panel for CV7A"
	default n
	help
		LGD SW49106 INCELL Command Mode FHD+ panel for CV7A
```
