/*
 * LG Electronics ap3426 sensor device tree source
 *
 * Copyright (c) 2016 LG Electronics Co., Ltd.
 *              http://www.lge.com
 *
 */

cust_alsps: cust_alsps@1e {
	compatible = "mediatek,ap3426";
	reg = <0x1e>;
	status = "okay";
	i2c_num = <1>;
	i2c_addr= <0x1e 0 0 0>;
	polling_mode_ps = <0>;
	polling_mode_als = <0>;
	power_id = <0xffff>;
	power_vol = <0>;
	als_level = <0 0 0 0 0 0 0 0 0 0 0 0 0 0 0>; // unused param 15
	als_value = <0 0 0 0 0 0 0 0 0 0 0 0 0 0 0 0>; // unused param 16
	ps_threshold_high = <750>;		//default 750
	ps_threshold_low = <500>;		//default 500
	is_batch_supported_ps = <0>;
	is_batch_supported_als = <0>;
	ps_offset = <50>;
	ps_hysteresis = <25>;
	ps_integrated_time = <0x05>;
	als_threshold_high = <163>;
	als_threshold_low = <150>;
	als_light_ratio_flu = <481>;
	als_light_ratio_inc = <591>;
};
