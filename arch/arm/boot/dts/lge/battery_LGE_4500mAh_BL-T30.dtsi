/* Typical 4500mAh Battery, 3.3V cut-off */

&odm {
	/* LGC 4500mA Battery 4.4V - 3.3V cut off -Techonohill Temp DATA*/
	fg,lgc-battery-data {
		/* Qmax for 0mA */
		q_max_pos_50 = <4572 >;
		q_max_pos_25 = <4577 >;
		q_max_pos_0 = <4148 >;
		q_max_neg_10 = <3537 >;
		/* Qmax for 400mA, said high current */
		q_max_pos_50_h_current = <4555 >;
		q_max_pos_25_h_current = <4535 >;
		q_max_pos_0_h_current = <3726 >;
		q_max_neg_10_h_current = <2537 >;

		/* Battery Temperature Table */
		batt_temperature_table_num = <21>;
		/* NTC 68 murata thermistor */
		batt_temperature_table = <
			(-20) 738978
			(-15) 485782
			(-10) 409600
			(-5) 309217
			0 235606
			5 180980
			10 140139
			15 109344
			20 85929
			25 68000
			30 54167
			35 43421
			40 35016
			45 28406
			50 23166
			55 18997
			60 15657
			65 12967
			70 10794
			75 9021
			80 7575 >;

		battery_profile_t0_num = <102 >;
		battery_profile_t0 = <
			0 4359 		1 4338 		3 4318 		4 4300 		6 4283
			7 4267 		8 4250 		10 4234 	11 4218 	13 4200
			14 4180 	15 4156 	17 4130 	18 4106 	20 4088
			21 4073 	23 4056 	24 4039 	25 4021 	27 4004
			28 3987 	30 3972 	31 3957 	32 3944 	34 3931
			35 3919 	37 3907 	38 3895 	39 3886 	41 3877
			42 3869 	44 3862 	45 3855 	46 3848 	48 3841
			49 3835 	51 3829 	52 3824 	54 3819 	55 3813
			56 3809 	58 3804 	59 3802 	61 3798 	62 3795
			63 3793 	65 3791 	66 3787 	68 3784 	69 3778
			70 3774 	72 3768 	73 3761 	75 3754 	76 3747
			77 3739 	79 3730 	80 3721 	82 3713 	83 3706
			84 3700 	86 3694 	87 3689 	89 3684 	90 3677
			92 3668 	93 3654 	94 3630 	96 3594 	97 3536
			98 3473 	99 3433 	99 3402 	99 3375 	100 3351
			100 3330 	100 3312 	100 3295 	100 3280 	100 3267
			100 3255 	100 3246 	100 3237 	100 3229 	100 3221
			100 3215 	100 3207 	100 3201 	100 3195 	100 3188
			100 3181 	100 3174 	100 3165 	100 3158 	100 3149
			100 3138 	100 3127 	100 3117 	100 3107 	100 3095
			100 3083 	100 3083 >;
		battery_profile_t1_num = <102 >;
		battery_profile_t1 = <
			0 4383 		1 4362 		2 4336 		4 4300 		5 4263
			6 4240 		7 4222 		8 4208 		10 4194 	11 4180
			12 4168 	13 4154 	14 4142 	16 4129 	17 4116
			18 4104 	19 4094 	20 4084 	22 4074 	23 4064
			24 4049 	25 4031 	26 4012 	28 3996 	29 3983
			30 3971 	31 3961 	32 3953 	34 3944 	35 3934
			36 3924 	37 3913 	38 3901 	40 3890 	41 3878
			42 3869 	43 3860 	44 3852 	46 3845 	47 3839
			48 3832 	49 3827 	51 3820 	52 3815 	53 3810
			54 3805 	55 3801 	57 3798 	58 3794 	59 3791
			60 3789 	61 3787 	63 3785 	64 3784 	65 3782
			66 3780 	67 3778 	69 3776 	70 3775 	71 3772
			72 3768 	73 3765 	75 3760 	76 3755 	77 3750
			78 3745 	79 3738 	81 3730 	82 3722 	83 3713
			84 3705 	85 3696 	87 3689 	88 3685 	89 3679
			90 3675 	91 3669 	93 3662 	94 3649 	95 3628
			96 3589 	97 3527 	99 3434 	99 3364 	100 3334
			100 3314 	100 3298 	100 3283 	100 3283 	100 3283
			100 3283 	100 3283 	100 3283 	100 3283 	100 3283
			100 3283 	100 3283 	100 3283 	100 3283 	100 3283
			100 3283 	100 3283 >;
		battery_profile_t2_num = <102 >;
		battery_profile_t2 = <
			0 4394 		1 4377 		2 4362 		3 4349 		4 4335
			5 4322 		7 4309 		8 4295 		9 4281 		10 4268
			11 4254 	12 4241 	13 4227 	14 4215 	15 4202
			16 4188 	17 4175 	19 4163 	20 4150 	21 4138
			22 4126 	23 4114 	24 4100 	25 4088 	26 4077
			27 4068 	28 4061 	29 4049 	30 4030 	32 4014
			33 3999 	34 3989 	35 3981 	36 3975 	37 3968
			38 3960 	39 3951 	40 3942 	41 3932 	42 3924
			44 3913 	45 3903 	46 3890 	47 3878 	48 3866
			49 3856 	50 3848 	51 3841 	52 3835 	53 3829
			54 3824 	55 3819 	57 3814 	58 3810 	59 3806
			60 3801 	61 3798 	62 3794 	63 3792 	64 3788
			65 3785 	66 3783 	67 3780 	69 3777 	70 3775
			71 3774 	72 3773 	73 3772 	74 3770 	75 3766
			76 3764 	77 3759 	78 3754 	79 3749 	81 3744
			82 3740 	83 3733 	84 3724 	85 3716 	86 3706
			87 3694 	88 3688 	89 3687 	90 3686 	91 3684
			93 3683 	94 3681 	95 3674 	96 3657 	97 3609
			98 3538 	99 3438 	100 3278 	100 3062 	100 2991
			100 2944 	100 2924 	100 2908 	100 2897 	100 2889
			100 2882 	100 2882 >;
		battery_profile_t3_num = <102 >;
		battery_profile_t3 = <
			0 4396 		1 4379 		2 4365 		3 4351 		4 4339
			5 4325 		7 4312 		8 4299 		9 4285 		10 4272
			11 4258 	12 4245 	13 4232 	14 4219 	15 4205
			16 4192 	17 4178 	19 4166 	20 4153 	21 4140
			22 4128 	23 4115 	24 4103 	25 4091 	26 4078
			27 4067 	28 4056 	30 4044 	31 4033 	32 4022
			33 4011 	34 4001 	35 3991 	36 3981 	37 3972
			38 3962 	39 3953 	40 3944 	41 3935 	43 3926
			44 3917 	45 3908 	46 3896 	47 3881 	48 3868
			49 3857 	50 3849 	51 3842 	52 3836 	54 3830
			55 3825 	56 3819 	57 3814 	58 3809 	59 3805
			60 3800 	61 3796 	62 3792 	63 3789 	64 3786
			66 3782 	67 3779 	68 3776 	69 3774 	70 3771
			71 3768 	72 3763 	73 3755 	74 3750 	75 3747
			76 3743 	78 3740 	79 3736 	80 3731 	81 3727
			82 3723 	83 3717 	84 3708 	85 3699 	86 3689
			87 3677 	88 3675 	90 3674 	91 3673 	92 3672
			93 3670 	94 3666 	95 3657 	96 3626 	97 3572
			98 3502 	99 3395 	100 3213 	100 2964 	100 2908
			100 2881 	100 2869 	100 2858 	100 2850 	100 2848
			100 2843 	100 2843 >;
		battery_profile_temperature_num = <102 >;
		battery_profile_temperature = <
			0 0 	0 0 	0 0 	0 0 	0 0
			0 0 	0 0 	0 0 	0 0 	0 0
			0 0 	0 0 	0 0 	0 0 	0 0
			0 0 	0 0 	0 0 	0 0 	0 0
			0 0 	0 0 	0 0 	0 0 	0 0
			0 0 	0 0 	0 0 	0 0 	0 0
			0 0 	0 0 	0 0 	0 0 	0 0
			0 0 	0 0 	0 0 	0 0 	0 0
			0 0 	0 0 	0 0 	0 0 	0 0
			0 0 	0 0 	0 0 	0 0 	0 0
			0 0 	0 0 	0 0 	0 0 	0 0
			0 0 	0 0 	0 0 	0 0 	0 0
			0 0 	0 0 	0 0 	0 0 	0 0
			0 0 	0 0 	0 0 	0 0 	0 0
			0 0 	0 0 	0 0 	0 0 	0 0
			0 0 	0 0 	0 0 	0 0 	0 0
			0 0 	0 0 	0 0 	0 0 	0 0
			0 0 	0 0 	0 0 	0 0 	0 0
			0 0 	0 0 	0 0 	0 0 	0 0
			0 0 	0 0 	0 0 	0 0 	0 0
			0 0 	0 0 >;
		r_profile_t0_num = <102 >;
		r_profile_t0 = <
			695 4359 	695 4338 	715 4318 	723 4300 	728 4283
			733 4267 	738 4250 	748 4234 	755 4218 	763 4200
			778 4180 	795 4156 	838 4130 	895 4106 	943 4088
			975 4073 	978 4056 	975 4039 	968 4021 	963 4004
			960 3987 	963 3972 	963 3957 	965 3944 	963 3931
			965 3919 	963 3907 	960 3895 	960 3886 	963 3877
			965 3869 	965 3862 	973 3855 	975 3848 	978 3841
			985 3835 	988 3829 	993 3824 	1000 3819 	1000 3813
			1008 3809 	1010 3804 	1018 3802 	1030 3798 	1038 3795
			1050 3793 	1068 3791 	1083 3787 	1103 3784 	1120 3778
			1150 3774 	1173 3768 	1203 3761 	1235 3754 	1268 3747
			1300 3739 	1333 3730 	1360 3721 	1385 3713 	1413 3706
			1440 3700 	1465 3694 	1495 3689 	1528 3684 	1558 3677
			1593 3668 	1628 3654 	1658 3630 	1688 3594 	1705 3536
			1685 3473 	1585 3433 	1505 3402 	1440 3375 	1383 3351
			1328 3330 	1285 3312 	1240 3295 	1210 3280 	1170 3267
			1145 3255 	1123 3246 	1095 3237 	1088 3229 	1068 3221
			1045 3215 	1028 3207 	1015 3201 	998 3195 	973 3188
			975 3181 	948 3174 	948 3165 	905 3158 	903 3149
			908 3138 	913 3127 	815 3117 	825 3107 	830 3095
			835 3083 	868 3083 >;
		r_profile_t1_num = <102 >;
		r_profile_t1 = <
			315 4383 	315 4362 	325 4336 	345 4300 	393 4263
			423 4240 	430 4222 	435 4208 	438 4194 	438 4180
			443 4168 	443 4154 	448 4142 	450 4129 	448 4116
			448 4104 	453 4094 	470 4084 	483 4074 	493 4064
			488 4049 	478 4031 	470 4012 	468 3996 	468 3983
			463 3971 	470 3961 	478 3953 	478 3944 	478 3934
			475 3924 	468 3913 	458 3901 	455 3890 	448 3878
			448 3869 	445 3860 	445 3852 	448 3845 	450 3839
			453 3832 	458 3827 	455 3820 	458 3815 	460 3810
			463 3805 	468 3801 	470 3798 	475 3794 	480 3791
			483 3789 	488 3787 	498 3785 	505 3784 	515 3782
			528 3780 	540 3778 	560 3776 	583 3775 	605 3772
			623 3768 	648 3765 	670 3760 	693 3755 	713 3750
			733 3745 	748 3738 	765 3730 	783 3722 	800 3713
			820 3705 	835 3696 	855 3689 	888 3685 	913 3679
			955 3675 	1000 3669 	1060 3662 	1125 3649 	1193 3628
			1260 3589 	1333 3527 	1400 3434 	1413 3364 	1338 3334
			1288 3314 	1248 3298 	1208 3283 	1215 3283 	1215 3283
			1215 3283 	1215 3283 	1215 3283 	1215 3283 	1215 3283
			1215 3283 	1215 3283 	1215 3283 	1215 3283 	1215 3283
			1215 3283 	1215 3283 >;
		r_profile_t2_num = <102 >;
		r_profile_t2 = <
			108 4394 	108 4377 	108 4362 	108 4349 	105 4335
			105 4322 	108 4309 	108 4295 	108 4281 	110 4268
			110 4254 	110 4241 	110 4227 	115 4215 	113 4202
			115 4188 	115 4175 	118 4163 	118 4150 	120 4138
			128 4126 	133 4114 	130 4100 	133 4088 	140 4077
			145 4068 	155 4061 	150 4049 	145 4030 	148 4014
			143 3999 	150 3989 	150 3981 	155 3975 	153 3968
			155 3960 	158 3951 	158 3942 	155 3932 	158 3924
			153 3913 	150 3903 	140 3890 	133 3878 	120 3866
			118 3856 	115 3848 	115 3841 	113 3835 	113 3829
			115 3824 	115 3819 	115 3814 	120 3810 	123 3806
			120 3801 	125 3798 	128 3794 	135 3792 	133 3788
			133 3785 	138 3783 	135 3780 	135 3777 	133 3775
			135 3774 	138 3773 	140 3772 	138 3770 	133 3766
			133 3764 	128 3759 	123 3754 	120 3749 	120 3744
			123 3740 	120 3733 	123 3724 	125 3716 	128 3706
			128 3694 	123 3688 	128 3687 	133 3686 	138 3684
			148 3683 	158 3681 	168 3674 	185 3657 	213 3609
			268 3538 	333 3438 	395 3278 	665 3062 	480 2991
			375 2944 	315 2924 	290 2908 	265 2897 	248 2889
			235 2882 	235 2882 >;
		r_profile_t3_num = <102 >;
		r_profile_t3 = <
			78 4396 	78 4379 	80 4365 	80 4351 	83 4339
			80 4325 	80 4312 	83 4299 	80 4285 	85 4272
			83 4258 	85 4245 	88 4232 	88 4219 	88 4205
			88 4192 	88 4178 	90 4166 	88 4153 	88 4140
			88 4128 	90 4115 	93 4103 	90 4091 	90 4078
			93 4067 	95 4056 	95 4044 	95 4033 	95 4022
			95 4011 	98 4001 	98 3991 	100 3981 	105 3972
			103 3962 	105 3953 	108 3944 	110 3935 	113 3926
			115 3917 	118 3908 	115 3896 	103 3881 	95 3868
			88 3857 	85 3849 	85 3842 	88 3836 	88 3830
			85 3825 	88 3819 	88 3814 	88 3809 	90 3805
			88 3800 	93 3796 	90 3792 	95 3789 	95 3786
			93 3782 	95 3779 	98 3776 	100 3774 	100 3771
			98 3768 	93 3763 	85 3755 	88 3750 	90 3747
			88 3743 	90 3740 	88 3736 	88 3731 	90 3727
			88 3723 	88 3717 	88 3708 	88 3699 	88 3689
			88 3677 	88 3675 	88 3674 	90 3673 	93 3672
			95 3670 	98 3666 	103 3657 	105 3626 	118 3572
			138 3502 	148 3395 	180 3213 	413 2964 	273 2908
			215 2881 	178 2869 	155 2858 	143 2850 	128 2848
			123 2843 	125 2843 >;
		r_profile_temperature_num = <102 >;
		r_profile_temperature = <
			0 0 	0 0 	0 0 	0 0 	0 0
			0 0 	0 0 	0 0 	0 0 	0 0
			0 0 	0 0 	0 0 	0 0 	0 0
			0 0 	0 0 	0 0 	0 0 	0 0
			0 0 	0 0 	0 0 	0 0 	0 0
			0 0 	0 0 	0 0 	0 0 	0 0
			0 0 	0 0 	0 0 	0 0 	0 0
			0 0 	0 0 	0 0 	0 0 	0 0
			0 0 	0 0 	0 0 	0 0 	0 0
			0 0 	0 0 	0 0 	0 0 	0 0
			0 0 	0 0 	0 0 	0 0 	0 0
			0 0 	0 0 	0 0 	0 0 	0 0
			0 0 	0 0 	0 0 	0 0 	0 0
			0 0 	0 0 	0 0 	0 0 	0 0
			0 0 	0 0 	0 0 	0 0 	0 0
			0 0 	0 0 	0 0 	0 0 	0 0
			0 0 	0 0 	0 0 	0 0 	0 0
			0 0 	0 0 	0 0 	0 0 	0 0
			0 0 	0 0 	0 0 	0 0 	0 0
			0 0 	0 0 	0 0 	0 0 	0 0
			0 0 	0 0 >;
	};


	/* TOCAD(sanyo) 4500mA Battery 4.4V - 3.3V cut off -Techonohill Temp DATA*/
	fg,tocad-battery-data {
		/* Qmax for 0mA */
		q_max_pos_50 = <4613 >;
		q_max_pos_25 = <4589 >;
		q_max_pos_0 = <4508 >;
		q_max_neg_10 = <4268 >;
		/* Qmax for 400mA, said high current */
		q_max_pos_50_h_current = <4595 >;
		q_max_pos_25_h_current = <4577 >;
		q_max_pos_0_h_current = <4202 >;
		q_max_neg_10_h_current = <3804 >;

		/* Battery Temperature Table */
		batt_temperature_table_num = <21>;
		/* NTC 68 murata thermistor */
		batt_temperature_table = <
			(-20) 738978
			(-15) 485782
			(-10) 409600
			(-5) 309217
			0 235606
			5 180980
			10 140139
			15 109344
			20 85929
			25 68000
			30 54167
			35 43421
			40 35016
			45 28406
			50 23166
			55 18997
			60 15657
			65 12967
			70 10794
			75 9021
			80 7575 >;

		battery_profile_t0_num = <102 >;
		battery_profile_t0 = <
			0 4370 		1 4342 		2 4323 		4 4306 		5 4291
			6 4276 		7 4263 		8 4249 		9 4234 		11 4220
			12 4206 	13 4193 	14 4180 	15 4167 	16 4154
			18 4141 	19 4128 	20 4117 	21 4104 	22 4092
			23 4080 	25 4068 	26 4057 	27 4045 	28 4033
			29 4021 	30 4010 	32 3998 	33 3988 	34 3977
			35 3966 	36 3955 	37 3944 	39 3933 	40 3922
			41 3911 	42 3901 	43 3891 	44 3882 	46 3874
			47 3866 	48 3858 	49 3852 	50 3845 	51 3838
			53 3833 	54 3827 	55 3822 	56 3818 	57 3812
			58 3807 	60 3804 	61 3800 	62 3795 	63 3792
			64 3789 	65 3786 	67 3783 	68 3780 	69 3778
			70 3775 	71 3772 	72 3770 	74 3767 	75 3764
			76 3760 	77 3756 	78 3751 	79 3746 	81 3741
			82 3735 	83 3729 	84 3721 	85 3714 	86 3705
			88 3697 	89 3687 	90 3677 	91 3665 	92 3654
			93 3644 	95 3635 	96 3624 	96 3619 	97 3614
			97 3611 	98 3607 	98 3603 	98 3599 	98 3595
			99 3591 	99 3587 	99 3582 	99 3577 	99 3572
			99 3566 	99 3561 	100 3556 	100 3551 	100 3545
			100 3540 	100 3300 >;
		battery_profile_t1_num = <102 >;
		battery_profile_t1 = <
			0 4384 		1 4363 		2 4347 		3 4332 		4 4318
			6 4304 		7 4291 		8 4277 		9 4264 		10 4251
			11 4237 	12 4225 	13 4212 	14 4198 	15 4185
			17 4173 	18 4160 	19 4147 	20 4135 	21 4123
			22 4111 	23 4099 	24 4087 	25 4076 	27 4065
			28 4054 	29 4043 	30 4031 	31 4020 	32 4010
			33 4000 	34 3989 	35 3979 	36 3969 	38 3957
			39 3946 	40 3935 	41 3923 	42 3912 	43 3901
			44 3891 	45 3882 	46 3874 	48 3866 	49 3859
			50 3852 	51 3846 	52 3840 	53 3835 	54 3829
			55 3824 	56 3819 	58 3815 	59 3810 	60 3806
			61 3802 	62 3798 	63 3794 	64 3791 	65 3788
			66 3784 	67 3782 	69 3779 	70 3777 	71 3774
			72 3771 	73 3768 	74 3765 	75 3760 	76 3755
			77 3751 	79 3746 	80 3742 	81 3736 	82 3730
			83 3723 	84 3715 	85 3707 	86 3699 	87 3690
			89 3679 	90 3667 	91 3658 	92 3650 	93 3641
			94 3631 	95 3616 	96 3590 	97 3540 	98 3513
			98 3491 	98 3472 	99 3454 	99 3439 	99 3424
			99 3410 	99 3398 	100 3386 	100 3375 	100 3364
			100 3354 	100 3300 >;
		battery_profile_t2_num = <102 >;
		battery_profile_t2 = <
			0 4394 		1 4376 		2 4361 		3 4347 		4 4333
			5 4320 		7 4306 		8 4294 		9 4281 		10 4267
			11 4254 	12 4241 	13 4228 	14 4216 	15 4203
			16 4190 	17 4178 	19 4165 	20 4153 	21 4140
			22 4129 	23 4117 	24 4105 	25 4093 	26 4081
			27 4071 	28 4060 	29 4050 	30 4039 	32 4029
			33 4019 	34 4009 	35 3999 	36 3990 	37 3980
			38 3971 	39 3961 	40 3951 	41 3941 	42 3929
			44 3917 	45 3904 	46 3894 	47 3885 	48 3877
			49 3870 	50 3862 	51 3856 	52 3850 	53 3844
			54 3838 	56 3834 	57 3829 	58 3824 	59 3819
			60 3815 	61 3810 	62 3807 	63 3804 	64 3800
			65 3797 	66 3794 	68 3790 	69 3788 	70 3784
			71 3780 	72 3776 	73 3770 	74 3763 	75 3758
			76 3752 	77 3746 	78 3741 	80 3737 	81 3733
			82 3729 	83 3725 	84 3720 	85 3713 	86 3706
			87 3700 	88 3694 	89 3684 	90 3675 	91 3672
			93 3667 	94 3662 	95 3654 	96 3644 	97 3619
			98 3572 	98 3512 	99 3432 	100 3313 	100 3078
			100 2988 	100 2950 	100 2925 	100 2912 	100 2902
			100 2896 	100 2901 >;
		battery_profile_t3_num = <102 >;
		battery_profile_t3 = <
			0 4392 		1 4375 		2 4360 		3 4346 		4 4332
			5 4319 		6 4306 		8 4293 		9 4280 		10 4267
			11 4254 	12 4241 	13 4228 	14 4216 	15 4203
			16 4190 	17 4178 	18 4165 	19 4153 	21 4141
			22 4129 	23 4116 	24 4105 	25 4093 	26 4082
			27 4070 	28 4059 	29 4049 	30 4039 	31 4028
			32 4018 	34 4008 	35 3999 	36 3989 	37 3980
			38 3971 	39 3961 	40 3952 	41 3941 	42 3928
			43 3915 	44 3903 	45 3892 	46 3884 	48 3876
			49 3869 	50 3862 	51 3856 	52 3850 	53 3844
			54 3840 	55 3833 	56 3828 	57 3823 	58 3818
			59 3814 	61 3810 	62 3805 	63 3801 	64 3797
			65 3794 	66 3790 	67 3787 	68 3784 	69 3780
			70 3775 	71 3766 	72 3758 	74 3751 	75 3745
			76 3740 	77 3734 	78 3729 	79 3725 	80 3721
			81 3717 	82 3713 	83 3707 	84 3700 	85 3694
			86 3687 	88 3680 	89 3670 	90 3666 	91 3662
			92 3658 	93 3652 	94 3644 	95 3627 	96 3588
			97 3536 	98 3468 	99 3375 	100 3225 	100 2975
			100 2934 	100 2913 	100 2901 	100 2892 	100 2889
			100 2886 	100 2886 >;
		battery_profile_temperature_num = <102 >;
		battery_profile_temperature = <
			0 0 	0 0 	0 0 	0 0 	0 0
			0 0 	0 0 	0 0 	0 0 	0 0
			0 0 	0 0 	0 0 	0 0 	0 0
			0 0 	0 0 	0 0 	0 0 	0 0
			0 0 	0 0 	0 0 	0 0 	0 0
			0 0 	0 0 	0 0 	0 0 	0 0
			0 0 	0 0 	0 0 	0 0 	0 0
			0 0 	0 0 	0 0 	0 0 	0 0
			0 0 	0 0 	0 0 	0 0 	0 0
			0 0 	0 0 	0 0 	0 0 	0 0
			0 0 	0 0 	0 0 	0 0 	0 0
			0 0 	0 0 	0 0 	0 0 	0 0
			0 0 	0 0 	0 0 	0 0 	0 0
			0 0 	0 0 	0 0 	0 0 	0 0
			0 0 	0 0 	0 0 	0 0 	0 0
			0 0 	0 0 	0 0 	0 0 	0 0
			0 0 	0 0 	0 0 	0 0 	0 0
			0 0 	0 0 	0 0 	0 0 	0 0
			0 0 	0 0 	0 0 	0 0 	0 0
			0 0 	0 0 	0 0 	0 0 	0 0
			0 0 	0 0>;
		r_profile_t0_num = <102 >;
		r_profile_t0 = <
			438 4370 	438 4342 	455 4323 	463 4306 	470 4291
			468 4276 	325 4263 	405 4249 	465 4234 	478 4220
			480 4206 	485 4193 	490 4180 	490 4167 	490 4154
			490 4141 	490 4128 	495 4117 	500 4104 	500 4092
			505 4080 	513 4068 	518 4057 	523 4045 	523 4033
			525 4021 	530 4010 	530 3998 	533 3988 	533 3977
			533 3966 	533 3955 	533 3944 	530 3933 	528 3922
			530 3911 	533 3901 	535 3891 	535 3882 	533 3874
			533 3866 	538 3858 	548 3852 	550 3845 	553 3838
			560 3833 	560 3827 	568 3822 	575 3818 	575 3812
			580 3807 	588 3804 	593 3800 	595 3795 	603 3792
			613 3789 	618 3786 	620 3783 	628 3780 	635 3778
			638 3775 	643 3772 	650 3770 	658 3767 	668 3764
			670 3760 	680 3756 	685 3751 	695 3746 	708 3741
			725 3735 	748 3729 	770 3721 	798 3714 	828 3705
			880 3697 	940 3687 	1020 3677 	1120 3665 	1258 3654
			1448 3644 	1708 3635 	2035 3624 	2050 3619 	2038 3614
			2033 3611 	2025 3607 	2015 3603 	2000 3599 	1995 3595
			1988 3591 	1973 3587 	1963 3582 	1948 3577 	1953 3572
			1928 3566 	1918 3561 	1913 3556 	1900 3551 	1868 3545
			1855 3540 	1265 3300 >;
		r_profile_t1_num = <102 >;
		r_profile_t1 = <
			268 4384 	268 4363 	278 4347 	278 4332 	278 4318
			278 4304 	280 4291 	280 4277 	283 4264 	283 4251
			283 4237 	288 4225 	288 4212 	285 4198 	288 4185
			290 4173 	290 4160 	290 4147 	295 4135 	298 4123
			300 4111 	300 4099 	300 4087 	303 4076 	305 4065
			308 4054 	313 4043 	310 4031 	313 4020 	315 4010
			318 4000 	318 3989 	320 3979 	323 3969 	318 3957
			315 3946 	315 3935 	310 3923 	310 3912 	310 3901
			308 3891 	308 3882 	310 3874 	313 3866 	313 3859
			315 3852 	318 3846 	318 3840 	323 3835 	323 3829
			328 3824 	330 3819 	335 3815 	338 3810 	340 3806
			345 3802 	350 3798 	353 3794 	355 3791 	358 3788
			360 3784 	365 3782 	368 3779 	373 3777 	375 3774
			378 3771 	380 3768 	385 3765 	385 3760 	390 3755
			398 3751 	400 3746 	410 3742 	413 3736 	423 3730
			433 3723 	445 3715 	460 3707 	483 3699 	508 3690
			538 3679 	575 3667 	630 3658 	708 3650 	813 3641
			958 3631 	1165 3616 	1468 3590 	1855 3540 	1783 3513
			1730 3491 	1683 3472 	1640 3454 	1603 3439 	1570 3424
			1533 3410 	1500 3398 	1478 3386 	1448 3375 	1425 3364
			1405 3354 	1273 3300 >;
		r_profile_t2_num = <102 >;
		r_profile_t2 = <
			145 4394 	145 4376 	150 4361 	150 4347 	143 4333
			140 4320 	135 4306 	133 4294 	133 4281 	130 4267
			133 4254 	133 4241 	133 4228 	135 4216 	135 4203
			133 4190 	135 4178 	135 4165 	135 4153 	135 4140
			138 4129 	138 4117 	140 4105 	135 4093 	128 4081
			130 4071 	130 4060 	135 4050 	133 4039 	138 4029
			143 4019 	145 4009 	145 3999 	145 3990 	135 3980
			138 3971 	138 3961 	138 3951 	138 3941 	130 3929
			128 3917 	118 3904 	115 3894 	118 3885 	118 3877
			120 3870 	120 3862 	120 3856 	123 3850 	120 3844
			118 3838 	123 3834 	123 3829 	123 3824 	120 3819
			123 3815 	120 3810 	123 3807 	128 3804 	130 3800
			133 3797 	138 3794 	138 3790 	140 3788 	138 3784
			140 3780 	138 3776 	133 3770 	130 3763 	133 3758
			130 3752 	130 3746 	125 3741 	128 3737 	128 3733
			128 3729 	128 3725 	130 3720 	125 3713 	125 3706
			128 3700 	130 3694 	130 3684 	128 3675 	133 3672
			133 3667 	138 3662 	140 3654 	148 3644 	148 3619
			150 3572 	165 3512 	180 3432 	205 3313 	323 3078
			478 2988 	385 2950 	330 2925 	300 2912 	270 2902
			255 2896 	275 2901 >;
		r_profile_t3_num = <102 >;
		r_profile_t3 = <
			98 4392 	98 4375 	98 4360 	100 4346 	98 4332
			98 4319 	98 4306 	98 4293 	98 4280 	98 4267
			98 4254 	98 4241 	98 4228 	100 4216 	103 4203
			100 4190 	100 4178 	100 4165 	100 4153 	103 4141
			103 4129 	98 4116 	103 4105 	103 4093 	103 4082
			100 4070 	103 4059 	105 4049 	108 4039 	105 4028
			108 4018 	108 4008 	110 3999 	108 3989 	110 3980
			113 3971 	110 3961 	113 3952 	113 3941 	108 3928
			103 3915 	103 3903 	98 3892 	103 3884 	100 3876
			100 3869 	100 3862 	100 3856 	100 3850 	103 3844
			108 3840 	103 3833 	103 3828 	103 3823 	103 3818
			105 3814 	105 3810 	103 3805 	103 3801 	105 3797
			105 3794 	105 3790 	108 3787 	108 3784 	108 3780
			108 3775 	100 3766 	103 3758 	103 3751 	103 3745
			105 3740 	103 3734 	103 3729 	103 3725 	105 3721
			105 3717 	108 3713 	105 3707 	105 3700 	105 3694
			105 3687 	105 3680 	103 3670 	108 3666 	105 3662
			108 3658 	108 3652 	113 3644 	113 3627 	113 3588
			118 3536 	123 3468 	133 3375 	155 3225 	440 2975
			340 2934 	303 2913 	273 2901 	253 2892 	228 2889
			218 2886 	220 2886 >;
		r_profile_temperature_num = <102 >;
		r_profile_temperature = <
			0 0 	0 0 	0 0 	0 0 	0 0
			0 0 	0 0 	0 0 	0 0 	0 0
			0 0 	0 0 	0 0 	0 0 	0 0
			0 0 	0 0 	0 0 	0 0 	0 0
			0 0 	0 0 	0 0 	0 0 	0 0
			0 0 	0 0 	0 0 	0 0 	0 0
			0 0 	0 0 	0 0 	0 0 	0 0
			0 0 	0 0 	0 0 	0 0 	0 0
			0 0 	0 0 	0 0 	0 0 	0 0
			0 0 	0 0 	0 0 	0 0 	0 0
			0 0 	0 0 	0 0 	0 0 	0 0
			0 0 	0 0 	0 0 	0 0 	0 0
			0 0 	0 0 	0 0 	0 0 	0 0
			0 0 	0 0 	0 0 	0 0 	0 0
			0 0 	0 0 	0 0 	0 0 	0 0
			0 0 	0 0 	0 0 	0 0 	0 0
			0 0 	0 0 	0 0 	0 0 	0 0
			0 0 	0 0 	0 0 	0 0 	0 0
			0 0 	0 0 	0 0 	0 0 	0 0
			0 0 	0 0 	0 0 	0 0 	0 0
			0 0 	0 0  >;
	};

	/* ATL(sanyo) 4500mA Battery 4.4V - 3.3V cut off -Techonohill Temp DATA*/
	fg,atl-battery-data {
		/* Qmax for 0mA */
		q_max_pos_50 = <4575 >;
		q_max_pos_25 = <4506 >;
		q_max_pos_0 = <4482 >;
		q_max_neg_10 = <4268 >;
		/* Qmax for 400mA, said high current */
		q_max_pos_50_h_current = <4548 >;
		q_max_pos_25_h_current = <4454 >;
		q_max_pos_0_h_current = <4098 >;
		q_max_neg_10_h_current = <3627 >;

		/* Battery Temperature Table */
		batt_temperature_table_num = <21>;
		/* NTC 68 murata thermistor */
		batt_temperature_table = <
			(-20) 738978
			(-15) 485782
			(-10) 409600
			(-5) 309217
			0 235606
			5 180980
			10 140139
			15 109344
			20 85929
			25 68000
			30 54167
			35 43421
			40 35016
			45 28406
			50 23166
			55 18997
			60 15657
			65 12967
			70 10794
			75 9021
			80 7575 >;

		battery_profile_t0_num = <102 >;
		battery_profile_t0 = <
			0 4370		1 4342		2 4323		4 4306		5 4291
			6 4276		7 4263		8 4249		9 4234		11 4220
			12 4206		13 4193		14 4180		15 4167		16 4154
			18 4141		19 4128		20 4117		21 4104		22 4092
			23 4080		25 4068		26 4057		27 4045		28 4033
			29 4021		30 4010		32 3998		33 3988		34 3977
			35 3966		36 3955		37 3944		39 3933		40 3922
			41 3911		42 3901		43 3891		44 3882		46 3874
			47 3866		48 3858		49 3852		50 3845		51 3838
			53 3833		54 3827		55 3822		56 3818		57 3812
			58 3807		60 3804		61 3800		62 3795		63 3792
			64 3789		65 3786		67 3783		68 3780		69 3778
			70 3775		71 3772		72 3770		74 3767		75 3764
			76 3760		77 3756		78 3751		79 3746		81 3741
			82 3735		83 3729		84 3721		85 3714		86 3705
			88 3697		89 3687		90 3677		91 3665		92 3654
			93 3644		95 3635		96 3624		96 3619		97 3614
			97 3611		98 3607		98 3603		98 3599		98 3595
			99 3591		99 3587		99 3582		99 3577		99 3572
			99 3566		99 3561		100 3556	100 3551	100 3545
			100 3540	100 3400 >;
		battery_profile_t1_num = <102 >;
		battery_profile_t1 = <
			0 4384		1 4363		2 4347		3 4332		4 4318
			6 4304		7 4291		8 4277		9 4264		10 4251
			11 4237		12 4225		13 4212		14 4198		16 4185
			17 4173		18 4160		19 4147		20 4135		21 4123
			22 4111		23 4099		24 4087		26 4076		27 4065
			28 4054		29 4043		30 4031		31 4020		32 4010
			33 4000		34 3989		36 3979		37 3969		38 3957
			39 3946		40 3935		41 3923		42 3912		43 3901
			44 3891		46 3882		47 3874		48 3866		49 3859
			50 3852		51 3846		52 3840		53 3835		55 3829
			56 3824		57 3819		58 3815		59 3810		60 3806
			61 3802		62 3798		63 3794		65 3791		66 3788
			67 3784		68 3782		69 3779		70 3777		71 3774
			72 3771		73 3768		75 3765		76 3760		77 3755
			78 3751		79 3746		80 3742		81 3736		82 3730
			83 3723		85 3715		86 3707		87 3699		88 3690
			89 3679		90 3667		91 3658		92 3650		93 3641
			95 3631		96 3616		97 3590		98 3540		98 3513
			99 3491		99 3472		99 3454		100 3439	100 3424
			100 3410    100 3398	100 3386	100 3375	100 3364
			100 3354	101 3354 >;
		battery_profile_t2_num = <102 >;
		battery_profile_t2 = <
			0 4390		1 4375		2 4361		3 4343		4 4332
			6 4319		7 4306		8 4293		9 4280		10 4266
			11 4254		12 4241		13 4228		14 4215		15 4203
			17 4190		18 4178		19 4165		20 4153		21 4141
			22 4129		23 4116		24 4105		25 4093		27 4082
			28 4070		29 4059		30 4049		31 4039		32 4028
			33 4018		34 4008		35 3999		37 3989		38 3980
			39 3971		40 3961		41 3952		42 3941		43 3928
			44 3915		45 3903		46 3892		48 3884		49 3876
			50 3869		51 3862		52 3856		53 3850		54 3844
			55 3840		56 3833		58 3828		59 3823		60 3818
			61 3814		62 3810		63 3805		64 3801		65 3797
			66 3794		68 3790		69 3787		70 3784		71 3780
			72 3775		73 3766		74 3758		75 3751		76 3745
			77 3740		79 3734		80 3729		81 3725		82 3721
			83 3717		84 3713		85 3708		86 3701		87 3682
			89 3677		90 3675		91 3670		92 3665		93 3659
			94 3653		95 3643		96 3622		97 3579		98 3520
			100 3442	101 3322	102 3084	103 3002	104 2971
			104 2948	104 2930	104 2923	104 2898	104 2908
			104 2905	104 2901 >;
		battery_profile_t3_num = <102 >;
		battery_profile_t3 = <
			0 4392		1 4375		2 4360		3 4346		4 4332
			5 4319		7 4306		8 4293		9 4280		10 4267
			11 4254		12 4241		13 4228		14 4216		15 4203
			16 4190		17 4178		19 4165		20 4153		21 4141
			22 4129		23 4116		24 4105		25 4093		26 4082
			27 4070		28 4059		29 4049		31 4039		32 4028
			33 4018		34 4008		35 3999		36 3989		37 3980
			38 3971		39 3961		40 3952		41 3941		43 3928
			44 3915		45 3903		46 3892		47 3884		48 3876
			49 3869		50 3862		51 3856		52 3850		53 3844
			55 3840		56 3833		57 3828		58 3823		59 3818
			60 3814		61 3810		62 3805		63 3801		64 3797
			65 3794		66 3790		68 3787		69 3784		70 3780
			71 3775		72 3766		73 3758		74 3751		75 3745
			76 3740		77 3734		78 3729		80 3725		81 3721
			82 3717		83 3713		84 3707		85 3700		86 3694
			87 3687		88 3680		89 3670		90 3666		92 3662
			93 3658		94 3652		95 3644		96 3627		97 3588
			98 3536		99 3468		100 3375	100 3225	100 2975
			100 2934	100 2913	100 2901	100 2892	100 2889
			100 2886	100 2886 >;
		battery_profile_temperature_num = <102 >;
		battery_profile_temperature = <
			0 0 	0 0 	0 0 	0 0 	0 0
			0 0 	0 0 	0 0 	0 0 	0 0
			0 0 	0 0 	0 0 	0 0 	0 0
			0 0 	0 0 	0 0 	0 0 	0 0
			0 0 	0 0 	0 0 	0 0 	0 0
			0 0 	0 0 	0 0 	0 0 	0 0
			0 0 	0 0 	0 0 	0 0 	0 0
			0 0 	0 0 	0 0 	0 0 	0 0
			0 0 	0 0 	0 0 	0 0 	0 0
			0 0 	0 0 	0 0 	0 0 	0 0
			0 0 	0 0 	0 0 	0 0 	0 0
			0 0 	0 0 	0 0 	0 0 	0 0
			0 0 	0 0 	0 0 	0 0 	0 0
			0 0 	0 0 	0 0 	0 0 	0 0
			0 0 	0 0 	0 0 	0 0 	0 0
			0 0 	0 0 	0 0 	0 0 	0 0
			0 0 	0 0 	0 0 	0 0 	0 0
			0 0 	0 0 	0 0 	0 0 	0 0
			0 0 	0 0 	0 0 	0 0 	0 0
			0 0 	0 0 	0 0 	0 0 	0 0
			0 0 	0 0>;
		r_profile_t0_num = <102 >;
		r_profile_t0 = <
			438 4370	438 4342	455 4323	463 4306	470 4291
			468 4276	325 4263	405 4249	465 4234	478 4220
			480 4206	485 4193	490 4180	490 4167	490 4154
			490 4141	490 4128	495 4117	500 4104	500 4092
			505 4080	513 4068	518 4057	523 4045	523 4033
			525 4021	530 4010	530 3998	533 3988	533 3977
			533 3966	533 3955	533 3944	530 3933	528 3922
			530 3911	533 3901	535 3891	535 3882	533 3874
			533 3866	538 3858	548 3852	550 3845	553 3838
			560 3833	560 3827	568 3822	575 3818	575 3812
			580 3807	588 3804	593 3800	595 3795	603 3792
			613 3789	618 3786	620 3783	628 3780	635 3778
			638 3775	643 3772	650 3770	658 3767	668 3764
			670 3760	680 3756	685 3751	695 3746	708 3741
			725 3735	748 3729	770 3721	798 3714	828 3705
			880 3697	940 3687	1020 3677	1120 3665	1258 3654
			1448 3644	1708 3635	2035 3624	2050 3619	2038 3614
			2033 3611	2025 3607	2015 3603	2000 3599	1995 3595
			1988 3591	1973 3587	1963 3582	1948 3577	1953 3572
			1928 3566	1918 3561	1913 3556	1900 3551	1868 3545
			1855 3540	1515 3400 >;
		r_profile_t1_num = <102 >;
		r_profile_t1 = <
			268 4384	268 4363	278 4347	278 4332	278 4318
			278 4304	280 4291	280 4277	283 4264	283 4251
			283 4237	288 4225	288 4212	285 4198	288 4185
			290 4173	290 4160	290 4147	295 4135	298 4123
			300 4111	300 4099	300 4087	303 4076	305 4065
			308 4054	313 4043	310 4031	313 4020	315 4010
			318 4000	318 3989	320 3979	323 3969	318 3957
			315 3946	315 3935	310 3923	310 3912	310 3901
			308 3891	308 3882	310 3874	313 3866	313 3859
			315 3852	318 3846	318 3840	323 3835	323 3829
			328 3824	330 3819	335 3815	338 3810	340 3806
			345 3802	350 3798	353 3794	355 3791	358 3788
			360 3784	365 3782	368 3779	373 3777	375 3774
			378 3771	380 3768	385 3765	385 3760	390 3755
			398 3751	400 3746	410 3742	413 3736	423 3730
			433 3723	445 3715	460 3707	483 3699	508 3690
			538 3679	575 3667	630 3658	708 3650	813 3641
			958 3631	1165 3616	1468 3590	1855 3540	1783 3513
			1730 3491	1683 3472	1640 3454	1603 3439	1570 3424
			1533 3410	1500 3398	1478 3386	1448 3375	1425 3364
			1405 3354	1408 3354  >;
		r_profile_t2_num = <102 >;
		r_profile_t2 = <
			113 4390	113 4375	120 4361	125 4343	128 4332
			130 4319	138 4306	140 4293	138 4280	135 4266
			135 4254	138 4241	138 4228	133 4215	133 4203
			135 4190	138 4178	135 4165	133 4153	138 4141
			138 4129	140 4116	135 4105	135 4093	143 4082
			140 4070	143 4059	133 4049	145 4039	145 4028
			138 4018	145 4008	133 3999	138 3989	150 3980
			153 3971	150 3961	140 3952	140 3941	133 3928
			123 3915	118 3903	118 3892	133 3884	130 3876
			130 3869	130 3862	135 3856	135 3850	138 3844
			138 3840	133 3833	133 3828	135 3823	135 3818
			135 3814	138 3810	138 3805	138 3801	138 3797
			140 3794	140 3790	143 3787	143 3784	143 3780
			138 3775	123 3766	118 3758	115 3751	120 3745
			133 3740	140 3734	143 3729	150 3725	158 3721
			160 3717	170 3713	153 3708	150 3701	123 3682
			143 3677	155 3675	160 3670	163 3665	165 3659
			178 3653	188 3643	195 3622	205 3579	225 3520
			258 3442	308 3322	470 3084	505 3002	428 2971
			383 2948	330 2930	313 2923	260 2898	293 2908
			265 2905	265 2901 >;
		r_profile_t3_num = <102 >;
		r_profile_t3 = <
			98 4392		98 4375		98 4360		100 4346	98 4332
			98 4319		98 4306		98 4293		98 4280		98 4267
			98 4254		98 4241		98 4228		100 4216	103 4203
			100 4190	100 4178	100 4165	100 4153	103 4141
			103 4129	98 4116		103 4105	103 4093	103 4082
			100 4070	103 4059	105 4049	108 4039	105 4028
			108 4018	108 4008	110 3999	108 3989	110 3980
			113 3971	110 3961	113 3952	113 3941	108 3928
			103 3915	103 3903	98 3892		103 3884	100 3876
			100 3869	100 3862	100 3856	100 3850	103 3844
			108 3840	103 3833	103 3828	103 3823	103 3818
			105 3814	105 3810	103 3805	103 3801	105 3797
			105 3794	105 3790	108 3787	108 3784	108 3780
			108 3775	100 3766	103 3758	103 3751	103 3745
			105 3740	103 3734	103 3729	103 3725	105 3721
			105 3717	108 3713	105 3707	105 3700	105 3694
			105 3687	105 3680	103 3670	108 3666	105 3662
			108 3658	108 3652	113 3644	113 3627	113 3588
			118 3536	123 3468	133 3375	155 3225	440 2975
			340 2934	303 2913	273 2901	253 2892	228 2889
			218 2886	220 2886 >;
		r_profile_temperature_num = <102 >;
		r_profile_temperature = <
			0 0 	0 0 	0 0 	0 0 	0 0
			0 0 	0 0 	0 0 	0 0 	0 0
			0 0 	0 0 	0 0 	0 0 	0 0
			0 0 	0 0 	0 0 	0 0 	0 0
			0 0 	0 0 	0 0 	0 0 	0 0
			0 0 	0 0 	0 0 	0 0 	0 0
			0 0 	0 0 	0 0 	0 0 	0 0
			0 0 	0 0 	0 0 	0 0 	0 0
			0 0 	0 0 	0 0 	0 0 	0 0
			0 0 	0 0 	0 0 	0 0 	0 0
			0 0 	0 0 	0 0 	0 0 	0 0
			0 0 	0 0 	0 0 	0 0 	0 0
			0 0 	0 0 	0 0 	0 0 	0 0
			0 0 	0 0 	0 0 	0 0 	0 0
			0 0 	0 0 	0 0 	0 0 	0 0
			0 0 	0 0 	0 0 	0 0 	0 0
			0 0 	0 0 	0 0 	0 0 	0 0
			0 0 	0 0 	0 0 	0 0 	0 0
			0 0 	0 0 	0 0 	0 0 	0 0
			0 0 	0 0 	0 0 	0 0 	0 0
			0 0 	0 0  >;
	};
};

