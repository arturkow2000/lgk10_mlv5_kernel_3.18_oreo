/*
 * LG Electronics BHI160 sensor device tree source
 *
 * Copyright (c) 2017 LG Electronics Co., Ltd.
 *              http://www.lge.com
 *
 */

bhy_acc: bhy_acc@29{
    compatible = "mediatek,bhi160_acc";
    reg = <0x29>;
    status = "okay";
    i2c_num = <1>;
    i2c_addr = <0x29 0 0 0>;
    direction = <5>;
    power_id = <0xffff>;
    power_vol = <0>;
    firlen = <0>;
    is_batch_supported = <0>;
};

bhy_gyro: bhy_gyro@2a{
    compatible = "mediatek,bhi160_gyro";
    reg = <0x2a>;
    status = "okay";
    i2c_num = <1>;
    i2c_addr = <0x2a 0 0 0>;
    direction = <5>;
    power_id = <0xffff>;
    power_vol = <0>;
    firlen = <0>;
    is_batch_supported = <0>;
};

