/*
 * LG Electronics lsm6dse-acc sensor device tree source
 *
 * Copyright (c) 2016 LG Electronics Co., Ltd.
 *              http://www.lge.com
 *
 */

cust_accel: cust_accel@6a {
	compatible = "mediatek,lsm6dse-acc";
	reg = <0x6a>;
	status = "okay";
	i2c_num = <1>;
	i2c_addr = <0x6a 0 0 0>;
	direction = <0>;
	power_id = <0xffff>;
	power_vol = <0>;
	firlen = <0>;
	is_batch_supported = <0>;
};
