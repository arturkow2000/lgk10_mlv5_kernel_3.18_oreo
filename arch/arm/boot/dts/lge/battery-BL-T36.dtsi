/* Typical 3000mAh Battery, 3.4V cut-off */

&odm {
	battery,BL-T36_TOCAD {
		batt_temperature_table_num = <21>;
		batt_temperature_table = <
			(-20)	601129	(-15)	459581
			(-10)	362915	(-5)	280636
			0	213810	5	168665
			10	131929	15	103032
			20	81520	25	65681
			30	52685	35	42660
			40	34465	45	27890
			50	22909	55	18774
			60	15423	65	12967
			70	10791	75	9021
			80	7574
		>;

		q_max_pos_50 = <2923>;
		q_max_pos_25 = <2904>;
		q_max_pos_0 = <2201>;
		q_max_neg_10 = <1110>;

		q_max_pos_50_h_current = <2865>;
		q_max_pos_25_h_current = <2846>;
		q_max_pos_0_h_current = <2157>;
		q_max_neg_10_h_current = <1088>;

		battery_profile_t0_num = <77>;
		battery_profile_t0 = <
			0 4292		4 4268		6 4248		10 4229		15 4211
			19 4193		21 4177		25 4163		29 4149		33 4133
			35 4110		40 4073		44 4021		46 3994		50 3978
			54 3965		58 3953		60 3940		65 3926		69 3912
			73 3899		75 3887		79 3876		83 3867		85 3858
			90 3851		94 3844		98 3837		100 3830	104 3825
			108 3819	113 3813	115 3809	119 3804	123 3800
			125 3796	129 3792	133 3789	138 3786	140 3783
			144 3779	148 3775	152 3770	154 3765	158 3759
			163 3752	167 3744	169 3736	173 3727	177 3717
			179 3709	183 3704	188 3699	192 3694	194 3684
			198 3660	202 3607	204 3526	206 3475	208 3432
			208 3394	208 3363	210 3335	210 3312	210 3295
			210 3282	210 3271	210 3263	210 3257	210 3252
			210 3247	210 3244	210 3240	210 3236	210 3233
			210 3231	210 3229
		>;
		battery_profile_t1_num = <77>;
		battery_profile_t1 = <
			0 4341		1 4319		4 4299		5 4270		7 4213
			8 4189		11 4171		12 4156		14 4140		17 4125
			18 4111		19 4097		23 4085		24 4074		25 4061
			27 4044		30 4024		31 4005		33 3990		35 3979
			37 3970		38 3961		39 3951		42 3940		43 3926
			46 3912		46 3897		49 3883		50 3872		53 3862
			54 3854		56 3846		58 3839		61 3832		61 3826
			64 3820		65 3815		68 3810		68 3805		71 3800
			73 3796		75 3792		76 3789		79 3787		80 3784
			82 3783		83 3780		84 3778		88 3775		89 3772
			90 3768		92 3764		95 3759		96 3754		98 3748
			100 3742	102 3734	103 3725	106 3716	107 3707
			109 3699	111 3694	113 3690	114 3685	117 3675
			118 3650	120 3591	121 3496	123 3418	123 3356
			125 3298	125 3246	125 3201	125 3169	125 3147
			125 3132	125 3122
		>;
		battery_profile_t2_num = <77>;
		battery_profile_t2 = <
			0 4356		1 4335		3 4318		4 4301		5 4285
			7 4269		8 4254		9 4238		11 4222		12 4207
			13 4192		15 4177		16 4162		18 4147		19 4133
			20 4118		22 4104		23 4090		24 4077		27 4064
			28 4052		29 4039		31 4024		32 4010		33 3998
			35 3988		36 3978		37 3968		39 3958		40 3947
			41 3936		43 3923		44 3907		46 3890		47 3878
			48 3867		50 3859		51 3851		52 3844		54 3838
			55 3831		56 3825		58 3820		59 3815		60 3810
			62 3806		63 3801		64 3797		66 3794		67 3789
			68 3786		70 3783		71 3779		73 3775		74 3770
			76 3765		78 3760		79 3754		80 3749		82 3745
			83 3741		84 3736		86 3728		87 3720		88 3713
			90 3705		91 3694		92 3690		94 3689		95 3687
			96 3683		98 3670		99 3620		100 3545	102 3432
			103 3190	103 3114
		>;
		battery_profile_t3_num = <77>;
		battery_profile_t3 = <
			0 4372		1 4350		3 4331		4 4314		5 4298
			7 4281		8 4266		9 4250		11 4235		12 4219
			13 4204		15 4189		16 4174		17 4159		19 4144
			20 4130		21 4115		23 4101		24 4087		26 4073
			28 4060		29 4047		30 4035		32 4022		33 4010
			34 3998		36 3987		37 3976		38 3965		40 3955
			41 3945		43 3934		44 3922		45 3905		47 3887
			48 3875		49 3866		51 3858		52 3850		53 3843
			55 3836		56 3830		57 3824		59 3818		60 3813
			61 3808		63 3803		64 3799		65 3795		67 3790
			68 3787		69 3783		71 3779		72 3775		73 3766
			76 3756		77 3749		78 3744		80 3738		81 3732
			82 3727		84 3723		85 3717		86 3710		88 3702
			89 3695		90 3685		92 3677		93 3676		94 3674
			96 3672		97 3666		98 3634		100 3574	101 3490
			102 3352	104 3091
		>;
		r_profile_t0_num = <77>;
		r_profile_t0 = <
			300 4292	900 4268	933 4248	943 4229	943 4211
			940 4193	938 4177	943 4163	943 4149	945 4133
			940 4110	940 4073	1035 4021	1208 3994	1245 3978
			1255 3965	1255 3953	1258 3940	1250 3926	1240 3912
			1240 3899	1235 3887	1228 3876	1230 3867	1228 3858
			1230 3851	1233 3844	1235 3837	1238 3830	1245 3825
			1248 3819	1250 3813	1255 3809	1255 3804	1265 3800
			1273 3796	1275 3792	1280 3789	1293 3786	1305 3783
			1315 3779	1333 3775	1353 3770	1370 3765	1390 3759
			1415 3752	1443 3744	1473 3736	1505 3727	1533 3717
			1570 3709	1610 3704	1648 3699	1688 3694	1728 3684
			1763 3660	1780 3607	1815 3526	1693 3475	1583 3432
			1490 3394	1408 3363	1343 3335	1288 3312	1243 3295
			1208 3282	1190 3271	1163 3263	1148 3257	1135 3252
			1128 3247	1113 3244	1113 3240	1100 3236	1108 3233
			1080 3231	1078 3229
		>;
		r_profile_t1_num = <77>;
		r_profile_t1 = <
			183 4341	400 4319	418 4299	415 4270	458 4213
			585 4189	590 4171	598 4156	600 4140	603 4125
			605 4111	608 4097	618 4085	628 4074	633 4061
			630 4044	625 4024	618 4005	618 3990	623 3979
			633 3970	638 3961	638 3951	640 3940	630 3926
			623 3912	613 3897	608 3883	608 3872	605 3862
			615 3854	613 3846	615 3839	620 3832	625 3826
			628 3820	638 3815	643 3810	643 3805	653 3800
			658 3796	660 3792	668 3789	678 3787	683 3784
			693 3783	700 3780	710 3778	723 3775	740 3772
			753 3768	775 3764	795 3759	818 3754	845 3748
			875 3742	905 3734	940 3725	978 3716	1015 3707
			1060 3699	1125 3694	1193 3690	1275 3685	1368 3675
			1455 3650	1508 3591	1583 3496	1545 3418	1393 3356
			1245 3298	1118 3246	1018 3201	928 3169	880 3147
			845 3132	810 3122
		>;
		r_profile_t2_num = <77>;
		r_profile_t2 = <
			115 4356	163 4335	165 4318	165 4301	165 4285
			165 4269	168 4254	168 4238	168 4222	168 4207
			168 4192	170 4177	170 4162	173 4147	175 4133
			175 4118	178 4104	178 4090	180 4077	183 4064
			188 4052	190 4039	190 4024	193 4010	193 3998
			195 3988	198 3978	200 3968	203 3958	203 3947
			200 3936	198 3923	183 3907	168 3890	163 3878
			158 3867	158 3859	158 3851	158 3844	160 3838
			158 3831	160 3825	163 3820	163 3815	165 3810
			168 3806	168 3801	170 3797	173 3794	170 3789
			173 3786	173 3783	173 3779	170 3775	168 3770
			165 3765	163 3760	160 3754	160 3749	163 3745
			165 3741	168 3736	165 3728	165 3720	168 3713
			173 3705	165 3694	170 3690	178 3689	188 3687
			200 3683	210 3670	205 3620	220 3545	255 3432
			520 3190	805 3114
		>;
		r_profile_t3_num = <77>;
		r_profile_t3 = <
			115 4372	115 4350	113 4331	113 4314	115 4298
			113 4281	115 4266	115 4250	115 4235	115 4219
			118 4204	118 4189	120 4174	118 4159	118 4144
			123 4130	120 4115	123 4101	123 4087	123 4073
			125 4060	125 4047	130 4035	130 4022	133 4010
			133 3998	135 3987	138 3976	138 3965	143 3955
			145 3945	145 3934	145 3922	135 3905	120 3887
			118 3875	118 3866	118 3858	115 3850	115 3843
			118 3836	118 3830	120 3824	120 3818	123 3813
			123 3808	125 3803	128 3799	130 3795	130 3790
			133 3787	135 3783	133 3779	135 3775	125 3766
			120 3756	120 3749	123 3744	123 3738	120 3732
			120 3727	125 3723	123 3717	123 3710	123 3702
			125 3695	123 3685	115 3677	123 3676	125 3674
			133 3672	138 3666	130 3634	135 3574	150 3490
			175 3352	733 3091
		>;
	};
	battery,BL-T36_LISHEN {
		batt_temperature_table_num = <21>;
		batt_temperature_table = <
			(-20)	601129	(-15)	459581
			(-10)	362915	(-5)	280636
			0	213810	5	168665
			10	131929	15	103032
			20	81520	25	65681
			30	52685	35	42660
			40	34465	45	27890
			50	22909	55	18774
			60	15423	65	12967
			70	10791	75	9021
			80	7574
		>;

		q_max_pos_50 = <2924>;
		q_max_pos_25 = <2910>;
		q_max_pos_0 = <2367>;
		q_max_neg_10 = <1469>;

		q_max_pos_50_h_current = <2866>;
		q_max_pos_25_h_current = <2852>;
		q_max_pos_0_h_current = <2320>;
		q_max_neg_10_h_current = <1440>;

		battery_profile_t0_num = <77>;
		battery_profile_t0 = <
			0 4304		3 4280		6 4260		7 4238		10 4216
			13 4191		16 4159		19 4125		22 4104		24 4090
			27 4076		30 4058		33 4031		36 4001		39 3975
			40 3955		43 3939		46 3927		49 3918		52 3910
			54 3902		57 3893		60 3884		63 3876		66 3868
			69 3860		70 3853		73 3846		76 3839		79 3832
			82 3826		84 3820		87 3814		90 3809		93 3803
			96 3797		99 3792		100 3786	103 3781	106 3776
			109 3770	112 3763	115 3756	116 3749	119 3740
			122 3732	125 3723	128 3716	131 3710	133 3706
			136 3701	139 3691	142 3668	145 3618	146 3530
			149 3407	151 3341	151 3298	151 3269	151 3251
			151 3240	151 3232	151 3221	151 3215	151 3206
			151 3199	151 3190	151 3184	151 3178	151 3172
			151 3166	151 3158	151 3150	151 3147	151 3143
			151 3137	151 3140
		>;
		battery_profile_t1_num = <77>;
		battery_profile_t1 = <
			0 4332		1 4288		4 4256		4 4236		7 4219
			8 4203		11 4188		11 4173		13 4158		14 4144
			17 4129		18 4115		21 4101		22 4090		24 4082
			25 4071		27 4052		28 4026		31 4003		32 3987
			34 3974		35 3964		36 3955		39 3946		39 3934
			42 3920		43 3906		46 3894		46 3882		48 3872
			49 3863		54 3855		54 3848		57 3841		58 3834
			60 3828		61 3822		63 3817		65 3812		67 3807
			68 3803		69 3799		71 3795		72 3791		75 3788
			76 3785		78 3783		79 3781		82 3778		83 3776
			84 3772		85 3769		89 3764		90 3760		92 3754
			93 3747		95 3739		96 3731		99 3722		100 3712
			101 3704	103 3699	104 3696	106 3692	107 3684
			110 3663	112 3609	113 3521	114 3373	116 3273
			116 3195	116 3135	116 3096	116 3070	116 3056
			116 3043	116 3039
		>;
		battery_profile_t2_num = <77>;
		battery_profile_t2 = <
			0 4366		1 4347		3 4331		4 4314		5 4298
			7 4282		8 4267		9 4251		11 4236		12 4220
			13 4205		15 4190		16 4176		18 4161		19 4147
			20 4132		22 4118		23 4103		24 4089		27 4077
			28 4068		29 4059		31 4040		32 4018		33 4001
			35 3990		36 3982		37 3975		39 3966		40 3955
			41 3943		43 3930		44 3913		45 3897		47 3884
			48 3874		49 3865		51 3856		52 3849		54 3842
			55 3836		56 3830		58 3824		59 3818		60 3813
			62 3809		63 3804		64 3800		66 3796		67 3792
			68 3788		70 3784		71 3781		72 3776		74 3771
			76 3766		77 3761		79 3756		80 3751		81 3746
			83 3742		84 3737		85 3730		87 3721		88 3714
			90 3705		91 3694		92 3691		94 3689		95 3687
			96 3685		98 3675		99 3633		100 3562	102 3453
			103 3234	103 3141
		>;
		battery_profile_t3_num = <77>;
		battery_profile_t3 = <
			0 4375		1 4356		3 4339		4 4323		5 4307
			7 4291		8 4275		9 4260		11 4244		12 4229
			13 4213		15 4198		16 4183		17 4168		19 4154
			20 4139		21 4125		23 4110		24 4096		26 4082
			28 4068		29 4056		30 4043		32 4030		33 4017
			34 4005		36 3994		37 3982		39 3972		40 3961
			41 3949		43 3938		44 3925		45 3908		47 3891
			48 3879		49 3869		51 3861		52 3853		53 3846
			55 3839		56 3832		57 3826		59 3821		60 3815
			61 3810		63 3805		64 3800		65 3796		67 3791
			68 3788		69 3784		71 3780		72 3775		73 3766
			76 3756		77 3750		78 3744		80 3739		81 3732
			82 3727		84 3723		85 3718		86 3710		88 3702
			89 3695		90 3684		92 3677		93 3676		94 3675
			96 3673		97 3667		98 3639		100 3579	101 3492
			102 3350	103 3143
		>;
		r_profile_t0_num = <77>;
		r_profile_t0 = <
			300 4304	653 4280	683 4260	693 4238	708 4216
			730 4191	760 4159	843 4125	943 4104	968 4090
			983 4076	1000 4058	985 4031	970 4001	963 3975
			963 3955	960 3939	960 3927	960 3918	973 3910
			973 3902	973 3893	970 3884	978 3876	978 3868
			978 3860	983 3853	988 3846	988 3839	995 3832
			998 3826	1003 3820	1005 3814	1010 3809	1005 3803
			1005 3797	1010 3792	1018 3786	1015 3781	1023 3776
			1035 3770	1038 3763	1048 3756	1050 3749	1065 3740
			1083 3732	1103 3723	1125 3716	1153 3710	1190 3706
			1228 3701	1273 3691	1335 3668	1373 3618	1448 3530
			1520 3407	1355 3341	1250 3298	1180 3269	1138 3251
			1105 3240	1080 3232	1073 3221	1040 3215	1045 3206
			1013 3199	1015 3190	988 3184	960 3178	965 3172
			975 3166	978 3158	990 3150	873 3147	873 3143
			890 3140	893 3137
		>;
		r_profile_t1_num = <77>;
		r_profile_t1 = <
			183 4332	318 4288	380 4256	408 4236	415 4219
			415 4203	428 4188	425 4173	433 4158	440 4144
			438 4129	448 4115	443 4101	448 4090	460 4082
			480 4071	475 4052	468 4026	455 4003	453 3987
			460 3974	458 3964	463 3955	465 3946	455 3934
			443 3920	435 3906	430 3894	425 3882	430 3872
			430 3863	428 3855	435 3848	435 3841	435 3834
			440 3828	438 3822	445 3817	453 3812	453 3807
			458 3803	460 3799	463 3795	460 3791	465 3788
			468 3785	473 3783	475 3781	478 3778	480 3776
			488 3772	493 3769	495 3764	508 3760	520 3754
			528 3747	548 3739	565 3731	580 3722	610 3712
			635 3704	675 3699	728 3696	788 3692	863 3684
			953 3663	1040 3609	1193 3521	1433 3373	1190 3273
			1003 3195	855 3135	750 3096	723 3070	675 3056
			678 3043	600 3039
		>;
		r_profile_t2_num = <77>;
		r_profile_t2 = <
			115 4366	143 4347	148 4331	145 4314	148 4298
			148 4282	148 4267	148 4251	148 4236	148 4220
			148 4205	150 4190	153 4176	150 4161	153 4147
			153 4132	155 4118	155 4103	158 4089	160 4077
			165 4068	173 4059	168 4040	163 4018	165 4001
			170 3990	173 3982	178 3975	178 3966	180 3955
			178 3943	175 3930	163 3913	150 3897	145 3884
			143 3874	143 3865	138 3856	140 3849	140 3842
			140 3836	140 3830	140 3824	140 3818	143 3813
			145 3809	145 3804	148 3800	150 3796	150 3792
			150 3788	150 3784	153 3781	148 3776	148 3771
			143 3766	143 3761	140 3756	143 3751	140 3746
			143 3742	145 3737	143 3730	143 3721	145 3714
			145 3705	143 3694	148 3691	150 3689	153 3687
			163 3685	170 3675	170 3633	185 3562	210 3453
			358 3234	883 3141
		>;
		r_profile_t3_num = <77>;
		r_profile_t3 = <
			115 4375	100 4356	100 4339	100 4323	103 4307
			103 4291	103 4275	103 4260	103 4244	105 4229
			103 4213	105 4198	105 4183	105 4168	108 4154
			108 4139	110 4125	108 4110	108 4096	108 4082
			108 4068	113 4056	113 4043	113 4030	113 4017
			115 4005	118 3994	118 3982	123 3972	125 3961
			125 3949	128 3938	128 3925	118 3908	108 3891
			105 3879	103 3869	105 3861	103 3853	103 3846
			105 3839	103 3832	103 3826	108 3821	105 3815
			108 3810	108 3805	108 3800	110 3796	110 3791
			113 3788	115 3784	118 3780	115 3775	108 3766
			105 3756	108 3750	105 3744	108 3739	103 3732
			105 3727	105 3723	108 3718	105 3710	105 3702
			110 3695	105 3684	100 3677	105 3676	110 3675
			115 3673	123 3667	115 3639	120 3579	133 3492
			170 3350	880 3143
		>;
	};

	battery,BL-T36_BYD {
		batt_temperature_table_num = <21>;
		batt_temperature_table = <
			(-20)	601129	(-15)	459581
			(-10)	362915	(-5)	280636
			0	213810	5	168665
			10	131929	15	103032
			20	81520	25	65681
			30	52685	35	42660
			40	34465	45	27890
			50	22909	55	18774
			60	15423	65	12967
			70	10791	75	9021
			80	7574
		>;

		q_max_pos_50 = <2920>;
		q_max_pos_25 = <2887>;
		q_max_pos_0 = <1720>;
		q_max_neg_10 = <1164>;

		q_max_pos_50_h_current = <2862>;
		q_max_pos_25_h_current = <2829>;
		q_max_pos_0_h_current = <1686>;
		q_max_neg_10_h_current = <1141>;

		battery_profile_t0_num = <77>;
		battery_profile_t0 = <
			0 4266		3 4242		6 4217		10 4192		14 4165
			17 4134		21 4102		24 4075		27 4054		30 4031
			35 4006		38 3982		41 3962		44 3946		48 3933
			51 3923		56 3914		59 3906		62 3897		65 3889
			68 3881		71 3872		76 3865		79 3856		83 3848
			86 3840		89 3832		92 3824		97 3816		100 3807
			103 3799	106 3790	109 3781	113 3772	117 3763
			121 3753	124 3743	127 3732	130 3722	133 3716
			138 3711	141 3705	144 3697	148 3678	151 3635
			154 3559	157 3452	159 3407	159 3372	160 3349
			160 3333	160 3323	160 3314	160 3306	160 3297
			160 3292	160 3286	160 3281	160 3276	160 3271
			160 3268	160 3263	160 3260	160 3257	160 3254
			160 3250	160 3246	160 3243	160 3239	160 3235
			160 3231	160 3227	160 3226	160 3224	160 3222
			160 3220	160 3220
		>;
		battery_profile_t1_num = <77>;
		battery_profile_t1 = <
			0 4319		3 4284		4 4241		7 4214		9 4196
			12 4179		13 4163		16 4147		18 4132		21 4117
			24 4103		25 4091		28 4079		30 4065		33 4047
			34 4027		37 4007		39 3991		42 3977		45 3965
			46 3952		49 3938		51 3923		54 3909		55 3897
			58 3886		60 3876		63 3867		66 3859		67 3851
			70 3844		72 3837		75 3831		76 3824		79 3818
			81 3813		84 3808		87 3803		88 3799		91 3795
			93 3792		96 3789		97 3786		100 3784	103 3780
			104 3777	107 3773	109 3768	112 3764	113 3759
			116 3753	118 3746	121 3739	124 3731	125 3723
			128 3714	130 3704	133 3698	134 3694	137 3690
			139 3685	142 3671	145 3629	146 3554	149 3438
			149 3368	151 3310	151 3258	151 3217	151 3187
			151 3161	151 3145	151 3134	151 3123	151 3116
			151 3111	151 3104
		>;
		battery_profile_t2_num = <77>;
		battery_profile_t2 = <
			0 4361		1 4343		3 4326		4 4309		5 4293
			7 4277		8 4261		10 4245		11 4229		12 4214
			14 4198		15 4183		16 4168		18 4153		19 4138
			20 4124		22 4109		23 4095		24 4081		27 4070
			28 4057		30 4043		31 4028		32 4014		34 4001
			35 3989		36 3978		38 3968		39 3959		40 3947
			42 3932		43 3915		44 3899		46 3886		47 3876
			48 3867		50 3859		51 3851		53 3844		54 3838
			55 3832		57 3826		58 3820		59 3815		61 3810
			62 3806		63 3801		65 3797		66 3793		67 3790
			69 3786		70 3783		72 3778		73 3773		74 3767
			77 3762		78 3757		79 3751		81 3747		82 3743
			83 3739		85 3733		86 3725		88 3718		89 3710
			90 3700		92 3693		93 3690		94 3689		96 3686
			97 3680		98 3652		100 3591	101 3504	102 3358
			103 3151	103 3113
		>;
		battery_profile_t3_num = <77>;
		battery_profile_t3 = <
			0 4375		1 4357		3 4339		4 4323		5 4306
			7 4290		8 4274		9 4258		11 4242		12 4226
			13 4211		15 4195		16 4180		17 4165		19 4150
			20 4135		21 4121		23 4106		24 4092		27 4078
			28 4065		29 4052		31 4039		32 4026		33 4013
			35 4001		36 3990		37 3978		39 3968		40 3957
			41 3946		43 3934		44 3917		45 3899		47 3886
			48 3876		49 3867		51 3859		52 3851		53 3844
			55 3837		56 3831		57 3825		59 3819		60 3814
			61 3809		63 3804		64 3799		65 3795		67 3791
			68 3787		69 3784		71 3780		72 3774		73 3764
			76 3754		77 3749		78 3743		80 3737		81 3731
			83 3727		84 3723		85 3717		87 3709		88 3702
			89 3694		91 3684		92 3678		93 3677		95 3675
			96 3673		97 3666		99 3630		100 3569	101 3480
			103 3332	104 3091
		>;
		r_profile_t0_num = <77>;
		r_profile_t0 = <
			300 4266	1285 4242	1303 4217	1295 4192	1320 4165
			1318 4134	1380 4102	1463 4075	1503 4054	1463 4031
			1460 4006	1430 3982	1403 3962	1385 3946	1395 3933
			1400 3923	1405 3914	1390 3906	1388 3897	1383 3889
			1368 3881	1360 3872	1368 3865	1383 3856	1365 3848
			1375 3840	1370 3832	1385 3824	1365 3816	1395 3807
			1390 3799	1375 3790	1410 3781	1400 3772	1400 3763
			1413 3753	1445 3743	1458 3732	1468 3722	1480 3716
			1500 3711	1518 3705	1548 3697	1573 3678	1578 3635
			1603 3559	1630 3452	1518 3407	1430 3372	1378 3349
			1333 3333	1308 3323	1293 3314	1270 3306	1255 3297
			1230 3292	1225 3286	1210 3281	1208 3276	1190 3271
			1178 3268	1195 3263	1165 3260	1168 3257	1163 3254
			1173 3250	1180 3246	1168 3243	1188 3239	1193 3235
			1190 3231	1188 3227	1068 3226	1070 3224	1075 3222
			1085 3220	1075 3220
		>;
		r_profile_t1_num = <77>;
		r_profile_t1 = <
			183 4319	745 4284	778 4241	863 4214	878 4196
			878 4179	885 4163	875 4147	873 4132	880 4117
			865 4103	870 4091	888 4079	893 4065	878 4047
			870 4027	853 4007	860 3991	855 3977	850 3965
			858 3952	840 3938	828 3923	828 3909	815 3897
			820 3886	815 3876	818 3867	820 3859	823 3851
			820 3844	825 3837	835 3831	838 3824	840 3818
			853 3813	855 3808	860 3803	860 3799	865 3795
			885 3792	900 3789	910 3786	915 3784	935 3780
			948 3777	963 3773	983 3768	995 3764	1013 3759
			1035 3753	1065 3746	1093 3739	1120 3731	1153 3723
			1183 3714	1218 3704	1255 3698	1298 3694	1345 3690
			1400 3685	1445 3671	1473 3629	1515 3554	1595 3438
			1420 3368	1275 3310	1155 3258	1045 3217	973 3187
			913 3161	870 3145	838 3134	825 3123	800 3116
			793 3111	803 3104
		>;
		r_profile_t2_num = <77>;
		r_profile_t2 = <
			115 4361	180 4343	183 4326	180 4309	178 4293
			178 4277	175 4261	173 4245	173 4229	173 4214
			170 4198	173 4183	173 4168	173 4153	173 4138
			175 4124	173 4109	175 4095	175 4081	178 4070
			180 4057	185 4043	188 4028	188 4014	188 4001
			188 3989	190 3978	193 3968	198 3959	198 3947
			190 3932	180 3915	168 3899	163 3886	160 3876
			160 3867	160 3859	158 3851	158 3844	160 3838
			160 3832	163 3826	163 3820	163 3815	165 3810
			168 3806	168 3801	168 3797	170 3793	173 3790
			173 3786	175 3783	173 3778	170 3773	165 3767
			165 3762	165 3757	165 3751	168 3747	170 3743
			173 3739	175 3733	175 3725	180 3718	180 3710
			183 3700	188 3693	190 3690	198 3689	208 3686
			223 3680	230 3652	245 3591	278 3504	353 3358
			890 3151	803 3113
		>;
		r_profile_t3_num = <77>;
		r_profile_t3 = <
			115 4375	110 4357	108 4339	110 4323	108 4306
			108 4290	108 4274	108 4258	108 4242	105 4226
			108 4211	105 4195	108 4180	108 4165	108 4150
			108 4135	110 4121	110 4106	110 4092	110 4078
			113 4065	113 4052	113 4039	115 4026	118 4013
			118 4001	120 3990	118 3978	123 3968	125 3957
			128 3946	133 3934	123 3917	113 3899	108 3886
			108 3876	108 3867	108 3859	108 3851	108 3844
			105 3837	108 3831	108 3825	108 3819	110 3814
			110 3809	110 3804	110 3799	113 3795	115 3791
			115 3787	118 3784	120 3780	118 3774	110 3764
			108 3754	110 3749	110 3743	110 3737	108 3731
			110 3727	113 3723	113 3717	110 3709	110 3702
			110 3694	110 3684	108 3678	113 3677	113 3675
			120 3673	128 3666	120 3630	128 3569	138 3480
			168 3332	733 3091
		>;
	};
};

