/* Typical 2500mAh Battery, 3.4V cut-off */

&odm {
	/* LGC 2500mA Battery 4.4V - 3.4V cut off -Techonohill Temp DATA*/
	battery,BL-45F1F_LGC {
		/* Qmax for 0mA */
		q_max_pos_50 = <2416 >;
		q_max_pos_25 = <2408 >;
		q_max_pos_0 = <2064 >;
		q_max_neg_10 = <1539 >;
		/* Qmax for 400mA, said high current */
		q_max_pos_50_h_current = <2401 >;
		q_max_pos_25_h_current = <2373 >;
		q_max_pos_0_h_current = <1658 >;
		q_max_neg_10_h_current = <1456 >;

		/* Battery Temperature Table */
		batt_temperature_table_num = <21>;
		/* NTC 68 murata thermistor */
		batt_temperature_table = <
			(-20) 738978
			(-15) 547456
			(-10) 409600
			(-5) 309217
			0 235606
			5 180980
			10 140139
			15 109344
			20 85929
			25 68000
			30 54167
			35 43421
			40 35016
			45 28406
			50 23166
			55 18997
			60 15657
			65 12967
			70 10794
			75 9021
			80 7575 >;

		battery_profile_t0_num = <70 >;
		battery_profile_t0 = <
			0 4328 	3 4293 	6 4262 	10 4233 	13 4197
			16 4128 	19 4088 	23 4060 	26 4028 	29 3997
			32 3971 	36 3949 	39 3932 	42 3917 	45 3902
			49 3886 	52 3871 	55 3858 	58 3843 	62 3829
			65 3813 	68 3797 	71 3780 	75 3761 	78 3742
			81 3723 	84 3711 	88 3703 	91 3694 	94 3658
			97 3556 	100 3363 	100 3279 	100 3267 	100 3269
			100 3273 	100 3272 	100 3273 	100 3275 	100 3276
			100 3277 	100 3275 	100 3274 	100 3271 	100 3270
			100 3268 	100 3264 	100 3260 	100 3257 	100 3253
			100 3248 	100 3246 	100 3245 	100 3242 	100 3241
			100 3238 	100 3236 	100 3234 	100 3232 	100 3231
			100 3228 	100 3226 	100 3223 	100 3220 	100 3218
			100 3215 	100 3212 	100 3209 	100 3206 	100 3206
		>;
		battery_profile_t1_num = <70 >;
		battery_profile_t1 = <
			0 4377 	2 4348 	5 4319 	7 4291 	10 4258
			12 4205 	15 4159 	17 4130 	19 4106 	22 4085
			24 4062 	27 4036 	29 4009 	31 3984 	34 3962
			36 3939 	39 3918 	41 3899 	43 3882 	46 3869
			48 3855 	51 3843 	53 3832 	56 3823 	58 3813
			60 3804 	63 3796 	65 3788 	68 3782 	70 3776
			72 3768 	75 3761 	77 3751 	80 3739 	82 3728
			84 3715 	87 3703 	89 3692 	92 3678 	94 3656
			97 3603 	98 3529 	99 3489 	99 3461 	100 3440
			100 3423 	100 3409 	100 3399 	100 3389 	100 3381
			100 3373 	100 3368 	100 3362 	100 3358 	100 3354
			100 3349 	100 3346 	100 3343 	100 3339 	100 3337
			100 3335 	100 3332 	100 3330 	100 3328 	100 3325
			100 3324 	100 3322 	100 3319 	100 3317 	100 3317
		>;
		battery_profile_t2_num = <70 >;
		battery_profile_t2 = <
			0 4397 	2 4368 	4 4344 	6 4320 	8 4295
			10 4271 	12 4247 	15 4222 	17 4198 	19 4174
			21 4151 	23 4128 	25 4105 	27 4083 	29 4065
			31 4042 	33 4020 	35 4000 	37 3982 	39 3966
			41 3948 	44 3927 	46 3904 	48 3882 	50 3865
			52 3853 	54 3842 	56 3831 	58 3822 	60 3812
			62 3805 	64 3797 	66 3790 	68 3784 	70 3778
			73 3772 	75 3765 	77 3757 	79 3749 	81 3740
			83 3730 	85 3716 	87 3701 	89 3685 	91 3680
			93 3675 	95 3661 	97 3591 	100 3457 	100 3231
			100 3185 	100 3155 	100 3133 	100 3119 	100 3107
			100 3099 	100 3095 	100 3091 	100 3087 	100 3086
			100 3083 	100 3085 	100 3086 	100 3085 	100 3082
			100 3083 	100 3079 	100 3079 	100 3075 	100 3075
		>;
		battery_profile_t3_num = <70 >;
		battery_profile_t3 = <
			0 4401 	2 4367 	4 4340 	6 4316 	8 4290
			10 4265 	12 4241 	14 4215 	17 4191 	19 4167
			21 4144 	23 4121 	25 4098 	27 4076 	29 4055
			31 4035 	33 4014 	35 3995 	37 3978 	39 3961
			41 3944 	43 3927 	46 3905 	48 3879 	50 3862
			52 3849 	54 3837 	56 3826 	58 3816 	60 3809
			62 3800 	64 3793 	66 3786 	68 3780 	70 3774
			72 3765 	74 3750 	77 3742 	79 3733 	81 3725
			83 3716 	85 3704 	87 3688 	89 3671 	91 3665
			93 3660 	95 3650 	97 3594 	99 3477 	100 3252
			100 3102 	100 3074 	100 3063 	100 3059 	100 3057
			100 3054 	100 3050 	100 3050 	100 3047 	100 3048
			100 3046 	100 3047 	100 3047 	100 3047 	100 3044
			100 3043 	100 3042 	100 3040 	100 3040 	100 3040
		>;
		r_profile_t0_num = <70 >;
		r_profile_t0 = <
			193 4328 	373 4293 	350 4262 	343 4233 	318 4197
			333 4128 	495 4088 	515 4060 	495 4028 	443 3997
			415 3971 	403 3949 	395 3932 	390 3917 	385 3902
			400 3886 	495 3871 	493 3858 	523 3843 	498 3829
			493 3813 	488 3797 	490 3780 	488 3761 	478 3742
			475 3723 	488 3711 	518 3703 	568 3694 	603 3658
			615 3556 	708 3363 	703 3279 	673 3267 	678 3269
			685 3273 	683 3272 	683 3273 	698 3275 	698 3276
			693 3277 	695 3275 	693 3274 	690 3271 	680 3270
			683 3268 	670 3264 	658 3260 	648 3257 	635 3253
			630 3248 	623 3246 	623 3245 	623 3242 	610 3241
			613 3238 	608 3236 	600 3234 	590 3232 	608 3231
			620 3228 	580 3226 	573 3223 	573 3220 	568 3218
			573 3215 	575 3212 	575 3209 	580 3206 	590 3206
		>;
		r_profile_t1_num = <70 >;
		r_profile_t1 = <
			180 4377 	323 4348 	335 4319 	340 4291 	350 4258
			393 4205 	530 4159 	575 4130 	588 4106 	605 4085
			630 4062 	640 4036 	635 4009 	630 3984 	630 3962
			625 3939 	623 3918 	625 3899 	625 3882 	635 3869
			638 3855 	648 3843 	655 3832 	668 3823 	673 3813
			683 3804 	693 3796 	700 3788 	718 3782 	735 3776
			758 3768 	783 3761 	805 3751 	830 3739 	865 3728
			903 3715 	960 3703 	1030 3692 	1120 3678 	1225 3656
			1320 3603 	1325 3529 	1225 3489 	1153 3461 	1105 3440
			1063 3423 	1025 3409 	1003 3399 	980 3389 	963 3381
			940 3373 	923 3368 	918 3362 	903 3358 	888 3354
			888 3349 	870 3346 	878 3343 	850 3339 	853 3337
			843 3335 	840 3332 	833 3330 	833 3328 	840 3325
			835 3324 	835 3322 	835 3319 	835 3317 	818 3317
		>;
		r_profile_t2_num = <70 >;
		r_profile_t2 = <
			98 4397 	135 4368 	143 4344 	145 4320 	148 4295
			153 4271 	158 4247 	158 4222 	163 4198 	163 4174
			170 4151 	173 4128 	175 4105 	178 4083 	185 4065
			198 4042 	205 4020 	208 4000 	210 3982 	210 3966
			208 3948 	198 3927 	180 3904 	165 3882 	160 3865
			163 3853 	163 3842 	163 3831 	170 3822 	170 3812
			175 3805 	178 3797 	180 3790 	183 3784 	183 3778
			180 3772 	178 3765 	178 3757 	178 3749 	183 3740
			188 3730 	193 3716 	198 3701 	193 3685 	208 3680
			235 3675 	278 3661 	278 3591 	340 3457 	580 3231
			468 3185 	395 3155 	333 3133 	298 3119 	278 3107
			255 3099 	253 3095 	230 3091 	228 3087 	223 3086
			223 3083 	218 3085 	218 3086 	223 3085 	220 3082
			208 3083 	210 3079 	198 3079 	203 3075 	193 3075
		>;
		r_profile_t3_num = <70 >;
		r_profile_t3 = <
			115 4401 	105 4367 	108 4340 	110 4316 	108 4290
			110 4265 	110 4241 	110 4215 	110 4191 	113 4167
			115 4144 	118 4121 	118 4098 	118 4076 	123 4055
			128 4035 	125 4014 	130 3995 	135 3978 	140 3961
			143 3944 	150 3927 	140 3905 	118 3879 	113 3862
			113 3849 	113 3837 	113 3826 	113 3816 	120 3809
			120 3800 	125 3793 	128 3786 	128 3780 	133 3774
			128 3765 	113 3750 	118 3742 	115 3733 	118 3725
			120 3716 	123 3704 	120 3688 	120 3671 	123 3665
			133 3660 	145 3650 	143 3594 	160 3477 	210 3252
			263 3102 	188 3074 	163 3063 	158 3059 	143 3057
			145 3054 	135 3050 	130 3050 	125 3047 	120 3048
			125 3046 	120 3047 	118 3047 	120 3047 	118 3044
			108 3043 	108 3042 	118 3040 	118 3040 	123 3040
		>;
	};

	/* TOCAD 2500mA Battery 4.4V - 3.4V cut off -Techonohill Temp DATA*/
	battery,BL-45F1F_TOCAD {
		/* Qmax for 0mA */
		q_max_pos_50 = <2437 >;
		q_max_pos_25 = <2424 >;
		q_max_pos_0 = <2215 >;
		q_max_neg_10 = <1650 >;
		/* Qmax for 400mA, said high current */
		q_max_pos_50_h_current = <2421 >;
		q_max_pos_25_h_current = <2395 >;
		q_max_pos_0_h_current = <1617 >;
		q_max_neg_10_h_current = <1411 >;

		/* Battery Temperature Table */
		batt_temperature_table_num = <21>;
		/* NTC 68 murata thermistor */
		batt_temperature_table = <
			(-20) 776892
			(-15) 572026
			(-10) 425433
			(-5) 319418
			0 241977
			5 184871
			10 142382
			15 110500
			20 86383
			25 68000
			30 53885
			35 42973
			40 34479
			45 27827
			50 22584
			55 18429
			60 15116
			65 12462
			70 10324
			75 8593
			80 7184 >;

		battery_profile_t0_num = <70 >;
		battery_profile_t0 = <
			0 4147 	3 4106 	6 4075 	9 4044 	12 4008
			15 3975 	18 3948 	21 3928 	24 3909 	27 3886
			30 3862 	33 3847 	36 3835 	39 3826 	42 3817
			45 3808 	48 3800 	51 3794 	54 3788 	57 3784
			60 3781 	63 3777 	66 3771 	69 3764 	72 3755
			75 3741 	78 3724 	81 3704 	85 3690 	88 3683
			91 3678 	94 3665 	97 3596 	98 3524 	99 3496
			99 3476 	99 3455 	99 3440 	100 3427 	100 3417
			100 3408 	100 3397 	100 3388 	100 3380 	100 3372
			100 3363 	100 3356 	100 3347 	101 3339 	101 3331
			101 3326 	101 3320 	101 3315 	101 3310 	101 3306
			101 3301 	101 3297 	101 3294 	101 3291 	101 3289
			101 3287 	101 3281 	101 3275 	101 3270 	101 3267
			101 3263 	101 3261 	101 3258 	101 3256 	101 3256
		>;
		battery_profile_t1_num = <70 >;
		battery_profile_t1 = <
			0 4377 	2 4339 	5 4295 	7 4252 	9 4214
			11 4180 	13 4150 	16 4123 	18 4097 	20 4075
			22 4052 	25 4030 	27 4009 	29 3990 	32 3971
			34 3953 	36 3936 	38 3916 	40 3895 	43 3874
			45 3855 	47 3840 	50 3828 	52 3818 	54 3809
			56 3802 	59 3796 	61 3790 	63 3787 	65 3784
			68 3780 	70 3777 	72 3772 	74 3766 	77 3758
			79 3748 	81 3735 	83 3721 	86 3706 	88 3692
			90 3682 	92 3673 	94 3664 	95 3658 	96 3653
			97 3647 	97 3640 	97 3633 	98 3624 	98 3614
			98 3605 	98 3597 	99 3588 	99 3580 	99 3571
			99 3563 	99 3555 	99 3548 	99 3540 	99 3534
			100 3528 	100 3522 	100 3516 	100 3510 	100 3505
			100 3500 	100 3494 	100 3494 	100 3494 	100 3400
		>;
		battery_profile_t2_num = <70 >;
		battery_profile_t2 = <
			0 4387 	2 4353 	4 4328 	6 4304 	8 4280
			10 4257 	12 4233 	14 4209 	16 4186 	18 4162
			21 4140 	23 4117 	25 4096 	27 4075 	29 4055
			31 4035 	33 4016 	35 3998 	37 3981 	39 3965
			41 3950 	43 3932 	45 3911 	47 3886 	49 3867
			51 3853 	53 3842 	56 3832 	58 3823 	60 3815
			62 3807 	64 3801 	66 3794 	68 3788 	70 3783
			72 3778 	74 3773 	76 3768 	78 3761 	80 3752
			82 3743 	84 3731 	86 3714 	88 3693 	90 3687
			93 3683 	95 3679 	97 3657 	99 3547 	100 3321
			100 3217 	100 3177 	100 3153 	100 3132 	100 3122
			100 3115 	100 3108 	100 3102 	100 3098 	100 3095
			100 3097 	100 3091 	100 3090 	100 3092 	100 3092
			100 3084 	100 3086 	100 3087 	100 3079 	100 3079
		>;
		battery_profile_t3_num = <70 >;
		battery_profile_t3 = <
			0 4395 	2 4358 	4 4331 	6 4307 	8 4283
			10 4259 	12 4235 	14 4211 	16 4187 	18 4164
			20 4141 	22 4119 	25 4098 	27 4076 	29 4056
			31 4036 	33 4017 	35 3999 	37 3982 	39 3966
			41 3950 	43 3935 	45 3921 	47 3898 	49 3872
			51 3857 	53 3845 	55 3834 	57 3825 	59 3817
			61 3808 	63 3802 	65 3795 	67 3789 	69 3784
			72 3779 	74 3769 	76 3756 	78 3748 	80 3739
			82 3730 	84 3721 	86 3703 	88 3686 	90 3676
			92 3673 	94 3672 	96 3658 	98 3567 	100 3388
			100 3162 	100 3125 	100 3108 	100 3096 	100 3089
			100 3081 	100 3080 	100 3075 	100 3070 	100 3066
			100 3064 	100 3062 	100 3061 	100 3058 	100 3054
			100 3054 	100 3056 	100 3055 	100 3051 	100 3051
		>;
		r_profile_t0_num = <70 >;
		r_profile_t0 = <
			193 4147 	770 4106 	673 4075 	595 4044 	580 4008
			605 3975 	675 3948 	615 3928 	545 3909 	485 3886
			443 3862 	433 3847 	415 3835 	403 3826 	393 3817
			428 3808 	528 3800 	495 3794 	520 3788 	500 3784
			515 3781 	518 3777 	533 3771 	545 3764 	555 3755
			573 3741 	595 3724 	615 3704 	650 3690 	713 3683
			785 3678 	903 3665 	1023 3596 	1313 3524 	1243 3496
			1190 3476 	1143 3455 	1103 3440 	1078 3427 	1048 3417
			1023 3408 	1003 3397 	975 3388 	965 3380 	933 3372
			908 3363 	893 3356 	878 3347 	858 3339 	840 3331
			815 3326 	813 3320 	800 3315 	793 3310 	765 3306
			763 3301 	758 3297 	755 3294 	743 3291 	740 3289
			740 3287 	725 3281 	698 3275 	678 3270 	678 3267
			683 3263 	675 3261 	673 3258 	680 3256 	675 3256
		>;
		r_profile_t1_num = <70 >;
		r_profile_t1 = <
			180 4377 	493 4339 	525 4295 	573 4252 	620 4214
			658 4180 	698 4150 	723 4123 	738 4097 	755 4075
			760 4052 	760 4030 	765 4009 	770 3990 	775 3971
			783 3953 	783 3936 	775 3916 	768 3895 	755 3874
			745 3855 	743 3840 	743 3828 	745 3818 	745 3809
			755 3802 	763 3796 	775 3790 	793 3787 	818 3784
			845 3780 	875 3777 	905 3772 	945 3766 	980 3758
			1018 3748 	1060 3735 	1108 3721 	1173 3706 	1248 3692
			1348 3682 	1488 3673 	1663 3664 	1645 3658 	1635 3653
			1618 3647 	1603 3640 	1590 3633 	1563 3624 	1540 3614
			1515 3605 	1505 3597 	1475 3588 	1460 3580 	1433 3571
			1418 3563 	1405 3555 	1373 3548 	1360 3540 	1335 3534
			1325 3528 	1325 3522 	1300 3516 	1285 3510 	1268 3505
			1253 3500 	1263 3494 	1255 3494 	1255 3494 	1020 3400
		>;
		r_profile_t2_num = <70 >;
		r_profile_t2 = <
			98 4387 	155 4353 	165 4328 	175 4304 	178 4280
			183 4257 	188 4233 	188 4209 	193 4186 	193 4162
			193 4140 	198 4117 	200 4096 	203 4075 	208 4055
			223 4035 	240 4016 	243 3998 	250 3981 	245 3965
			243 3950 	243 3932 	225 3911 	200 3886 	185 3867
			175 3853 	175 3842 	175 3832 	180 3823 	183 3815
			185 3807 	190 3801 	190 3794 	190 3788 	188 3783
			185 3778 	185 3773 	188 3768 	185 3761 	183 3752
			183 3743 	188 3731 	193 3714 	193 3693 	203 3687
			213 3683 	240 3679 	283 3657 	315 3547 	525 3321
			543 3217 	448 3177 	388 3153 	345 3132 	313 3122
			298 3115 	285 3108 	275 3102 	260 3098 	265 3095
			253 3097 	248 3091 	258 3090 	238 3092 	230 3092
			240 3084 	225 3086 	223 3087 	225 3079 	218 3079
		>;
		r_profile_t3_num = <70 >;
		r_profile_t3 = <
			115 4395 	100 4358 	100 4331 	103 4307 	100 4283
			100 4259 	103 4235 	103 4211 	103 4187 	103 4164
			103 4141 	103 4119 	108 4098 	108 4076 	110 4056
			110 4036 	113 4017 	115 3999 	120 3982 	125 3966
			130 3950 	140 3935 	153 3921 	135 3898 	108 3872
			103 3857 	100 3845 	100 3834 	103 3825 	103 3817
			103 3808 	108 3802 	110 3795 	110 3789 	115 3784
			118 3779 	110 3769 	103 3756 	100 3748 	100 3739
			100 3730 	100 3721 	95 3703 	100 3686 	100 3676
			103 3673 	113 3672 	115 3658 	123 3567 	155 3388
			408 3162 	315 3125 	280 3108 	250 3096 	238 3089
			228 3081 	200 3080 	193 3075 	198 3070 	183 3066
			165 3064 	173 3062 	168 3061 	150 3058 	148 3054
			150 3054 	140 3056 	145 3055 	138 3051 	135 3051
		>;
	};

	/* BYD 2500mA Battery 4.4V - 3.4V cut off -Techonohill Temp DATA*/
	battery,BL-45F1F_BYD {
		/* Qmax for 0mA */
		q_max_pos_50 = <2472 >;
		q_max_pos_25 = <2466 >;
		q_max_pos_0 = <1687 >;
		q_max_neg_10 = <1025 >;
		/* Qmax for 400mA, said high current */
		q_max_pos_50_h_current = <2457 >;
		q_max_pos_25_h_current = <2427 >;
		q_max_pos_0_h_current = <1196 >;
		q_max_neg_10_h_current = <957 >;

		/* Battery Temperature Table */
		batt_temperature_table_num = <21>;
		/* NTC 68 murata thermistor */
		batt_temperature_table = <
			(-20) 738931
			(-15) 547472
			(-10) 409600
			(-5) 309299
			0 235622
			5 181001
			10 140153
			15 109349
			20 85934
			25 68000
			30 54165
			35 43418
			40 35014
			45 28400
			50 23164
			55 18994
			60 15655
			65 12967
			70 10791
			75 9021
			80 7574 >;

		battery_profile_t0_num = <70 >;
		battery_profile_t0 = <
			0 4285 	5 4246 	10 4191 	15 4114 	19 4076
			24 4052 	29 4032 	34 4004 	39 3970 	44 3941
			49 3919 	53 3899 	58 3878 	63 3854 	68 3828
			73 3805 	78 3785 	83 3767 	87 3741 	92 3683
			97 3565 	100 3323 	100 3283 	100 3262 	100 3245
			100 3230 	100 3223 	100 3216 	100 3214 	100 3211
			100 3209 	100 3205 	100 3203 	100 3200 	100 3200
			100 3198 	100 3197 	100 3193 	100 3191 	100 3188
			100 3185 	100 3182 	100 3178 	100 3175 	100 3171
			100 3167 	100 3164 	100 3159 	100 3155 	100 3151
			100 3146 	100 3141 	100 3136 	100 3131 	100 3121
			100 3116 	100 3110 	100 3105 	100 3098 	100 3092
			100 3084 	100 3075 	100 3067 	100 3057 	100 3046
			100 3035 	100 3025 	100 3015 	100 3005 	100 3005
		>;
		battery_profile_t1_num = <70 >;
		battery_profile_t1 = <
			0 4376 	3 4332 	6 4275 	9 4220 	12 4189
			15 4161 	18 4133 	21 4103 	24 4076 	27 4054
			30 4028 	32 3994 	35 3962 	38 3940 	41 3927
			44 3916 	47 3903 	50 3888 	53 3874 	56 3862
			59 3847 	62 3833 	65 3819 	68 3804 	71 3789
			74 3774 	77 3757 	80 3742 	83 3728 	86 3717
			89 3708 	92 3695 	94 3654 	97 3553 	99 3475
			99 3435 	100 3411 	100 3395 	100 3382 	100 3372
			100 3363 	100 3355 	100 3349 	100 3343 	100 3338
			100 3334 	100 3330 	100 3326 	100 3323 	100 3320
			100 3317 	100 3314 	100 3312 	100 3310 	100 3307
			100 3304 	100 3302 	100 3301 	100 3298 	100 3297
			100 3295 	100 3294 	100 3292 	100 3290 	100 3287
			100 3286 	100 3285 	100 3282 	100 3279 	100 3279
		>;
		battery_profile_t2_num = <70 >;
		battery_profile_t2 = <
			0 4393 	2 4361 	4 4335 	6 4310 	8 4285
			10 4261 	12 4237 	14 4213 	16 4189 	18 4167
			20 4144 	22 4123 	24 4101 	26 4080 	28 4065
			30 4044 	32 4011 	34 3991 	36 3980 	38 3966
			40 3949 	42 3929 	44 3906 	46 3884 	49 3868
			51 3855 	53 3844 	55 3834 	57 3825 	59 3816
			61 3808 	63 3801 	65 3794 	67 3789 	69 3783
			71 3778 	73 3771 	75 3764 	77 3758 	79 3749
			81 3742 	83 3735 	85 3724 	87 3712 	89 3695
			91 3690 	93 3686 	95 3681 	97 3641 	99 3521
			100 3296 	100 3208 	100 3168 	100 3144 	100 3127
			100 3118 	100 3104 	100 3097 	100 3089 	100 3084
			100 3081 	100 3081 	100 3080 	100 3079 	100 3076
			100 3073 	100 3071 	100 3069 	100 3066 	100 3066
		>;
		battery_profile_t3_num = <70 >;
		battery_profile_t3 = <
			0 4398 	2 4365 	4 4338 	6 4312 	8 4287
			10 4262 	12 4238 	14 4215 	16 4191 	18 4168
			20 4145 	22 4123 	24 4101 	26 4080 	28 4059
			30 4039 	32 4020 	34 4001 	36 3983 	38 3966
			40 3950 	42 3934 	44 3913 	46 3889 	48 3871
			50 3857 	52 3845 	54 3834 	56 3825 	58 3816
			60 3808 	62 3800 	64 3794 	66 3788 	69 3782
			71 3776 	73 3767 	75 3753 	77 3743 	79 3735
			81 3728 	83 3721 	85 3710 	87 3699 	89 3684
			91 3676 	93 3675 	95 3671 	97 3634 	99 3530
			100 3323 	100 3137 	100 3086 	100 3065 	100 3054
			100 3051 	100 3046 	100 3044 	100 3045 	100 3041
			100 3041 	100 3039 	100 3037 	100 3034 	100 3032
			100 3028 	100 3024 	100 3021 	100 3017 	100 3017
		>;
		r_profile_t0_num = <70 >;
		r_profile_t0 = <
			193 4285 	970 4246 	820 4191 	833 4114 	923 4076
			858 4052 	810 4032 	753 4004 	653 3970 	548 3941
			510 3919 	505 3899 	493 3878 	470 3854 	450 3828
			468 3805 	603 3785 	595 3767 	665 3741 	638 3683
			650 3565 	815 3323 	708 3283 	658 3262 	615 3245
			590 3230 	565 3223 	550 3216 	540 3214 	535 3211
			530 3209 	555 3205 	533 3203 	523 3200 	515 3200
			578 3198 	673 3197 	723 3193 	715 3191 	730 3188
			620 3185 	773 3182 	780 3178 	780 3175 	623 3171
			780 3167 	630 3164 	788 3159 	773 3155 	748 3151
			620 3146 	630 3141 	605 3136 	603 3131 	803 3121
			793 3116 	788 3110 	793 3105 	803 3098 	818 3092
			818 3084 	645 3075 	910 3067 	918 3057 	785 3046
			630 3035 	900 3025 	938 3015 	965 3005 	700 3005
		>;
		r_profile_t1_num = <70 >;
		r_profile_t1 = <
			180 4376 	870 4332 	890 4275 	1033 4220 	1090 4189
			1085 4161 	1073 4133 	1050 4103 	1033 4076 	1035 4054
			1020 4028 	985 3994 	963 3962 	945 3940 	953 3927
			963 3916 	968 3903 	965 3888 	968 3874 	968 3862
			968 3847 	968 3833 	970 3819 	970 3804 	973 3789
			978 3774 	983 3757 	988 3742 	1000 3728 	1023 3717
			1063 3708 	1123 3695 	1175 3654 	1235 3553 	1190 3475
			1090 3435 	1028 3411 	990 3395 	958 3382 	933 3372
			910 3363 	890 3355 	880 3349 	865 3343 	850 3338
			845 3334 	840 3330 	833 3326 	810 3323 	825 3320
			810 3317 	810 3314 	788 3312 	795 3310 	823 3307
			823 3304 	765 3302 	800 3301 	800 3298 	770 3297
			773 3295 	773 3294 	773 3292 	810 3290 	810 3287
			780 3286 	780 3285 	775 3282 	815 3279 	785 3279
		>;
		r_profile_t2_num = <70 >;
		r_profile_t2 = <
			98 4393 	145 4361 	155 4335 	163 4310 	168 4285
			170 4261 	175 4237 	175 4213 	175 4189 	178 4167
			180 4144 	185 4123 	185 4101 	188 4080 	200 4065
			230 4044 	225 4011 	223 3991 	238 3980 	233 3966
			225 3949 	223 3929 	198 3906 	185 3884 	175 3868
			173 3855 	173 3844 	173 3834 	175 3825 	175 3816
			178 3808 	180 3801 	183 3794 	185 3789 	183 3783
			185 3778 	178 3771 	175 3764 	178 3758 	175 3749
			178 3742 	185 3735 	190 3724 	198 3712 	198 3695
			210 3690 	225 3686 	258 3681 	298 3641 	428 3521
			743 3296 	535 3208 	430 3168 	375 3144 	325 3127
			298 3118 	278 3104 	258 3097 	243 3089 	233 3084
			230 3081 	228 3081 	228 3080 	230 3079 	223 3076
			210 3073 	178 3071 	175 3069 	195 3066 	200 3066
		>;
		r_profile_t3_num = <70 >;
		r_profile_t3 = <
			115 4398 	108 4365 	108 4338 	105 4312 	105 4287
			105 4262 	103 4238 	108 4215 	108 4191 	108 4168
			108 4145 	110 4123 	110 4101 	113 4080 	113 4059
			115 4039 	118 4020 	118 4001 	123 3983 	128 3966
			133 3950 	138 3934 	133 3913 	115 3889 	108 3871
			105 3857 	105 3845 	105 3834 	108 3825 	108 3816
			108 3808 	110 3800 	113 3794 	115 3788 	118 3782
			120 3776 	118 3767 	108 3753 	105 3743 	105 3735
			108 3728 	108 3721 	108 3710 	110 3699 	108 3684
			105 3676 	113 3675 	123 3671 	118 3634 	138 3530
			200 3323 	350 3137 	225 3086 	178 3065 	153 3054
			133 3051 	135 3046 	123 3044 	123 3045 	118 3041
			118 3041 	100 3039 	115 3037 	113 3034 	113 3032
			113 3028 	95 3024 	100 3021 	115 3017 	128 3017
		>;
	};
};

