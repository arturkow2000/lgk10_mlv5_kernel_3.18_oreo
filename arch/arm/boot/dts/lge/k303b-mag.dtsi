/*
 * LG Electronics k303b-mag sensor device tree source
 *
 * Copyright (c) 2016 LG Electronics Co., Ltd.
 *              http://www.lge.com
 *
 */

cust_mag: cust_mag@1e {
	compatible = "mediatek,k303b-mag";
	reg = <0x1e>;
	status = "okay";
	i2c_num = <1>;
	i2c_addr = <0x1e 0 0 0>;
	direction = <0>;
	power_id = <0xffff>;
	power_vol = <0>;
	firlen = <0>;
	is_batch_supported = <0>;
};
