/* Typical 3000mAh Battery, 3.4V cut-off */

&odm {
	battery,BL-T31_TOCAD {
		batt_temperature_table_num = <21>;
		batt_temperature_table = <
			(-20)	776892	(-15)	572026
			(-10)	425433	(-5)	319418
			0	241977	5	184871
			10	142382	15	110500
			20	86383	25	68000
			30	53885	35	42973
			40	34479	45	27827
			50	22584	55	18429
			60	15116	65	12462
			70	10324	75	8593
			80	7184
		>;

		q_max_pos_50 = <2998>;
		q_max_pos_25 = <2959>;
		q_max_pos_0 = <2627>;
		q_max_neg_10 = <2325>;

		q_max_pos_50_h_current = <2968>;
		q_max_pos_25_h_current = <2921>;
		q_max_pos_0_h_current = <1519>;
		q_max_neg_10_h_current = <486>;

		battery_profile_t0_num = <80>;
		battery_profile_t0 = <
			0 4252 	2 4232 	3 4213 	5 4195 	7 4178
			9 4162 	10 4147 	12 4129 	14 4108 	15 4080
			17 4044 	19 4004 	21 3981 	22 3967 	24 3957
			26 3946 	28 3934 	29 3922 	31 3909 	33 3897
			34 3885 	36 3873 	38 3863 	40 3854 	41 3845
			43 3838 	45 3831 	46 3825 	48 3820 	50 3815
			52 3810 	53 3806 	55 3802 	57 3799 	58 3796
			60 3793 	62 3790 	64 3788 	65 3784 	67 3781
			69 3776 	70 3772 	72 3767 	74 3761 	76 3755
			77 3747 	79 3739 	81 3731 	83 3722 	84 3713
			86 3706 	88 3701 	89 3696 	91 3691 	93 3681
			95 3660 	96 3619 	97 3577 	98 3539 	99 3507
			99 3477 	99 3450 	100 3427 	100 3404 	100 3385
			100 3367 	100 3352 	100 3339 	100 3327 	100 3317
			100 3308 	100 3301 	100 3294 	100 3289 	100 3284
			100 3279 	100 3274 	100 3270 	100 3266 	100 3266
		>;
		battery_profile_t1_num = <80>;
		battery_profile_t1 = <
			0 4304 	2 4270 	3 4219 	5 4185 	6 4166
			8 4149 	9 4134 	11 4118 	12 4104 	14 4090
			15 4078 	17 4066 	18 4050 	20 4031 	21 4013
			23 3997 	24 3983 	26 3972 	27 3961 	29 3950
			30 3937 	32 3923 	33 3909 	35 3895 	37 3883
			38 3873 	40 3863 	41 3855 	43 3847 	44 3840
			46 3834 	47 3827 	49 3821 	50 3815 	52 3811
			53 3806 	55 3801 	56 3797 	58 3793 	59 3790
			61 3788 	62 3785 	64 3783 	65 3781 	67 3778
			68 3775 	70 3772 	72 3769 	73 3765 	75 3760
			76 3756 	78 3750 	79 3743 	81 3736 	82 3728
			84 3720 	85 3711 	87 3702 	88 3695 	90 3692
			91 3689 	93 3684 	94 3677 	96 3652 	97 3593
			99 3525 	99 3476 	100 3432 	100 3391 	100 3354
			100 3317 	100 3285 	100 3253 	100 3228 	100 3206
			100 3187 	100 3171 	100 3160 	100 3150 	100 3150
		>;
		battery_profile_t2_num = <80>;
		battery_profile_t2 = <
			0 4351 	1 4332 	3 4316 	4 4300 	5 4285
			7 4269 	8 4253 	9 4238 	11 4222 	12 4207
			14 4192 	15 4177 	16 4162 	18 4147 	19 4132
			20 4118 	22 4103 	23 4089 	24 4076 	26 4063
			27 4050 	28 4037 	30 4022 	31 4009 	32 3997
			34 3986 	35 3976 	36 3964 	38 3952 	39 3939
			41 3924 	42 3908 	43 3894 	45 3882 	46 3872
			47 3864 	49 3856 	50 3849 	51 3842 	53 3835
			54 3829 	55 3824 	57 3818 	58 3813 	59 3808
			61 3804 	62 3799 	64 3795 	65 3791 	66 3788
			68 3784 	69 3780 	70 3776 	72 3772 	73 3767
			74 3762 	76 3758 	77 3752 	78 3747 	80 3743
			81 3739 	82 3732 	84 3724 	85 3716 	86 3709
			88 3697 	89 3691 	91 3689 	92 3688 	93 3686
			95 3682 	96 3664 	97 3609 	99 3530 	100 3406
			100 3136 	100 3076 	100 3041 	100 3014 	100 3014
		>;
		battery_profile_t3_num = <80>;
		battery_profile_t3 = <
			0 4364 	1 4348 	3 4332 	4 4317 	5 4302
			7 4287 	8 4271 	9 4255 	11 4240 	12 4224
			13 4209 	15 4194 	16 4179 	17 4163 	19 4149
			20 4134 	21 4119 	23 4105 	24 4091 	25 4077
			27 4064 	28 4051 	29 4038 	31 4025 	32 4013
			33 4000 	35 3989 	36 3977 	37 3966 	39 3954
			40 3942 	41 3929 	43 3914 	44 3898 	45 3885
			47 3874 	48 3866 	49 3858 	51 3850 	52 3843
			53 3836 	55 3830 	56 3824 	57 3818 	59 3813
			60 3808 	61 3803 	63 3799 	64 3794 	65 3790
			67 3786 	68 3782 	69 3778 	71 3773 	72 3763
			73 3754 	75 3749 	76 3743 	77 3737 	79 3732
			80 3727 	81 3722 	83 3717 	84 3708 	85 3701
			87 3693 	88 3682 	89 3677 	91 3676 	92 3675
			93 3673 	95 3669 	96 3649 	97 3595 	99 3518
			100 3399 	100 3122 	100 3034 	100 3001 	100 3001
		>;
		r_profile_t0_num = <80>;
		r_profile_t0 = <
			1228 4252 	1228 4232 	1255 4213 	1253 4195 	1253 4178
			1253 4162 	1245 4147 	1235 4129 	1243 4108 	1245 4080
			1238 4044 	1355 4004 	1443 3981 	1473 3967 	1475 3957
			1490 3946 	1485 3934 	1478 3922 	1470 3909 	1453 3897
			1460 3885 	1455 3873 	1443 3863 	1440 3854 	1433 3845
			1455 3838 	1443 3831 	1465 3825 	1455 3820 	1453 3815
			1473 3810 	1475 3806 	1485 3802 	1490 3799 	1488 3796
			1500 3793 	1515 3790 	1515 3788 	1543 3784 	1545 3781
			1570 3776 	1578 3772 	1595 3767 	1620 3761 	1630 3755
			1658 3747 	1685 3739 	1710 3731 	1730 3722 	1743 3713
			1758 3706 	1785 3701 	1838 3696 	1880 3691 	1915 3681
			1963 3660 	2003 3619 	1943 3577 	1943 3539 	1943 3507
			1943 3477 	1943 3450 	1943 3427 	1943 3404 	1943 3385
			1943 3367 	1943 3352 	1943 3339 	1943 3327 	1943 3317
			1943 3308 	1943 3301 	1943 3294 	1943 3289 	1943 3284
			1943 3279 	1943 3274 	1943 3270 	1943 3266 	1943 3266
		>;
		r_profile_t1_num = <80>;
		r_profile_t1 = <
			773 4304 	773 4270 	815 4219 	943 4185 	988 4166
			973 4149 	998 4134 	975 4118 	993 4104 	1003 4090
			993 4078 	998 4066 	1010 4050 	1003 4031 	990 4013
			990 3997 	985 3983 	990 3972 	970 3961 	968 3950
			965 3937 	965 3923 	958 3909 	955 3895 	950 3883
			955 3873 	953 3863 	938 3855 	938 3847 	945 3840
			958 3834 	950 3827 	965 3821 	968 3815 	968 3811
			970 3806 	968 3801 	975 3797 	983 3793 	1003 3790
			1005 3788 	1005 3785 	1028 3783 	1023 3781 	1045 3778
			1055 3775 	1065 3772 	1095 3769 	1110 3765 	1145 3760
			1163 3756 	1213 3750 	1228 3743 	1283 3736 	1305 3728
			1355 3720 	1388 3711 	1430 3702 	1480 3695 	1530 3692
			1568 3689 	1643 3684 	1710 3677 	1758 3652 	1783 3593
			1815 3525 	1690 3476 	1690 3432 	1690 3391 	1690 3354
			1690 3317 	1690 3285 	1690 3253 	1690 3228 	1690 3206
			1690 3187 	1690 3171 	1690 3160 	1690 3150 	1690 3150
		>;
		r_profile_t2_num = <80>;
		r_profile_t2 = <
			230 4351 	230 4332 	235 4316 	235 4300 	238 4285
			238 4269 	235 4253 	238 4238 	238 4222 	240 4207
			240 4192 	240 4177 	243 4162 	243 4147 	243 4132
			245 4118 	245 4103 	248 4089 	250 4076 	253 4063
			258 4050 	260 4037 	260 4022 	263 4009 	265 3997
			268 3986 	270 3976 	270 3964 	270 3952 	268 3939
			258 3924 	243 3908 	235 3894 	228 3882 	225 3872
			225 3864 	223 3856 	225 3849 	225 3842 	223 3835
			225 3829 	228 3824 	228 3818 	228 3813 	230 3808
			233 3804 	230 3799 	233 3795 	233 3791 	235 3788
			235 3784 	235 3780 	233 3776 	233 3772 	230 3767
			228 3762 	228 3758 	225 3752 	225 3747 	228 3743
			230 3739 	233 3732 	233 3724 	233 3716 	240 3709
			235 3697 	238 3691 	240 3689 	248 3688 	258 3686
			270 3682 	278 3664 	280 3609 	303 3530 	350 3406
			350 3136 	350 3076 	350 3041 	350 3014 	350 3014
		>;
		r_profile_t3_num = <80>;
		r_profile_t3 = <
			190 4364 	190 4348 	190 4332 	190 4317 	193 4302
			195 4287 	193 4271 	193 4255 	195 4240 	195 4224
			198 4209 	200 4194 	203 4179 	200 4163 	203 4149
			203 4134 	203 4119 	205 4105 	205 4091 	205 4077
			208 4064 	210 4051 	213 4038 	213 4025 	218 4013
			215 4000 	220 3989 	223 3977 	225 3966 	228 3954
			228 3942 	228 3929 	223 3914 	213 3898 	203 3885
			200 3874 	200 3866 	200 3858 	198 3850 	198 3843
			198 3836 	200 3830 	200 3824 	200 3818 	203 3813
			203 3808 	205 3803 	208 3799 	205 3794 	208 3790
			208 3786 	210 3782 	210 3778 	208 3773 	198 3763
			198 3754 	200 3749 	198 3743 	195 3737 	198 3732
			198 3727 	198 3722 	200 3717 	195 3708 	198 3701
			198 3693 	198 3682 	195 3677 	198 3676 	203 3675
			205 3673 	208 3669 	205 3649 	208 3595 	215 3518
			228 3399 	228 3122 	228 3034 	228 3001 	228 3001
		>;
	};
	battery,BL-T31_LGC {
		batt_temperature_table_num = <21>;
		batt_temperature_table = <
			(-20)	776892	(-15)	572026
			(-10)	425433	(-5)	319418
			0	241977	5	184871
			10	142382	15	110500
			20	86383	25	68000
			30	53885	35	42973
			40	34479	45	27827
			50	22584	55	18429
			60	15116	65	12462
			70	10324	75	8593
			80	7184
		>;

		q_max_pos_50 = <3053>;
		q_max_pos_25 = <3035>;
		q_max_pos_0 = <2778>;
		q_max_neg_10 = <1869>;

		q_max_pos_50_h_current = <3033>;
		q_max_pos_25_h_current = <2980>;
		q_max_pos_0_h_current = <2268>;
		q_max_neg_10_h_current = <880>;

		battery_profile_t0_num = <80>;
		battery_profile_t0 = <
			0 4283 	2 4259 	4 4240 	6 4222 	9 4203
			11 4184 	13 4163 	15 4140 	17 4114 	19 4083
			21 4053 	24 4024 	26 3996 	28 3971 	30 3951
			32 3935 	34 3923 	36 3913 	39 3903 	41 3894
			43 3885 	45 3876 	47 3868 	49 3859 	51 3851
			53 3843 	56 3835 	58 3827 	60 3818 	62 3809
			64 3800 	66 3791 	68 3781 	71 3772 	73 3763
			75 3754 	77 3745 	79 3736 	81 3728 	83 3720
			86 3713 	88 3706 	90 3697 	92 3683 	94 3656
			96 3604 	98 3513 	100 3442 	100 3387 	101 3345
			101 3318 	101 3303 	101 3293 	101 3284 	101 3277
			101 3274 	101 3268 	101 3263 	101 3261 	101 3258
			101 3254 	101 3251 	101 3247 	101 3243 	101 3239
			101 3236 	101 3233 	101 3229 	101 3225 	101 3221
			101 3216 	101 3214 	101 3212 	101 3210 	101 3207
			101 3205 	102 3202 	102 3199 	102 3197 	102 3197
		>;
		battery_profile_t1_num = <80>;
		battery_profile_t1 = <
			0 4338 	1 4317 	3 4298 	4 4272 	6 4237
			7 4203 	9 4176 	10 4157 	12 4140 	13 4125
			14 4110 	16 4097 	17 4088 	19 4079 	20 4065
			22 4044 	23 4020 	24 4000 	26 3985 	27 3973
			29 3964 	30 3957 	32 3949 	33 3941 	35 3930
			36 3918 	37 3905 	39 3892 	40 3879 	42 3868
			43 3858 	45 3849 	46 3841 	47 3834 	49 3827
			50 3821 	52 3816 	53 3811 	55 3806 	56 3801
			58 3797 	59 3792 	60 3789 	62 3787 	63 3785
			65 3783 	66 3781 	68 3780 	69 3778 	71 3776
			72 3774 	73 3771 	75 3767 	76 3763 	78 3758
			79 3752 	81 3746 	82 3738 	83 3730 	85 3721
			86 3712 	88 3704 	89 3698 	91 3694 	92 3690
			94 3685 	95 3672 	96 3641 	98 3576 	99 3476
			100 3417 	100 3363 	101 3307 	101 3257 	101 3209
			101 3168 	101 3139 	101 3117 	101 3100 	101 3100
		>;
		battery_profile_t2_num = <80>;
		battery_profile_t2 = <
			0 4340 	1 4315 	3 4295 	4 4277 	5 4261
			7 4245 	8 4229 	9 4214 	11 4199 	12 4184
			13 4170 	14 4155 	16 4141 	17 4127 	18 4113
			20 4099 	21 4085 	22 4074 	24 4066 	25 4054
			26 4033 	28 4013 	29 3998 	30 3988 	32 3982
			33 3974 	34 3965 	36 3956 	37 3946 	38 3937
			40 3927 	41 3917 	42 3907 	43 3894 	45 3879
			46 3866 	47 3854 	49 3845 	50 3838 	51 3831
			53 3825 	54 3819 	55 3814 	57 3809 	58 3805
			59 3801 	61 3797 	62 3793 	63 3789 	65 3786
			66 3784 	67 3781 	68 3778 	70 3776 	71 3774
			72 3771 	74 3768 	75 3765 	76 3761 	78 3756
			79 3750 	80 3746 	82 3741 	83 3735 	84 3727
			86 3718 	87 3710 	88 3699 	90 3692 	91 3690
			92 3688 	94 3686 	95 3681 	96 3660 	97 3603
			99 3521 	100 3393 	101 3180 	101 3115 	101 3115
		>;
		battery_profile_t3_num = <80>;
		battery_profile_t3 = <
			0 4367 	1 4336 	3 4312 	4 4292 	5 4274
			7 4257 	8 4241 	9 4225 	10 4210 	12 4195
			13 4180 	14 4165 	16 4151 	17 4136 	18 4122
			20 4108 	21 4094 	22 4080 	24 4067 	25 4054
			26 4041 	28 4028 	29 4016 	30 4004 	31 3993
			33 3982 	34 3971 	35 3961 	37 3951 	38 3941
			39 3932 	41 3923 	42 3914 	43 3905 	45 3894
			46 3878 	47 3862 	48 3850 	50 3842 	51 3834
			52 3827 	54 3821 	55 3815 	56 3811 	58 3806
			59 3801 	60 3797 	62 3792 	63 3788 	64 3784
			65 3781 	67 3779 	68 3776 	69 3773 	71 3771
			72 3767 	73 3758 	75 3749 	76 3745 	77 3741
			79 3736 	80 3731 	81 3727 	83 3722 	84 3716
			85 3707 	86 3699 	88 3691 	89 3679 	90 3677
			92 3675 	93 3673 	94 3670 	96 3661 	97 3622
			98 3557 	100 3462 	100 3294 	100 3049 	100 3049
		>;
		r_profile_t0_num = <80>;
		r_profile_t0 = <
			710 4283 	710 4259 	738 4240 	763 4222 	770 4203
			783 4184 	805 4163 	840 4140 	885 4114 	950 4083
			1045 4053 	1113 4024 	1138 3996 	1138 3971 	1135 3951
			1133 3935 	1138 3923 	1148 3913 	1155 3903 	1150 3894
			1165 3885 	1158 3876 	1170 3868 	1165 3859 	1165 3851
			1178 3843 	1183 3835 	1185 3827 	1185 3818 	1195 3809
			1205 3800 	1208 3791 	1208 3781 	1213 3772 	1230 3763
			1225 3754 	1255 3745 	1263 3736 	1285 3728 	1320 3720
			1320 3713 	1320 3706 	1320 3697 	1320 3683 	1320 3656
			1320 3604 	1320 3513 	1320 3442 	1320 3387 	1320 3345
			1320 3318 	1320 3303 	1320 3293 	1320 3284 	1320 3277
			1320 3274 	1320 3268 	1320 3263 	1320 3261 	1320 3258
			1320 3254 	1320 3251 	1320 3247 	1320 3243 	1320 3239
			1320 3236 	1320 3233 	1320 3229 	1320 3225 	1320 3221
			1320 3216 	1320 3214 	1320 3212 	1320 3210 	1320 3207
			1320 3205 	1320 3202 	1320 3199 	1320 3197 	1320 3197
		>;
		r_profile_t1_num = <80>;
		r_profile_t1 = <
			343 4338 	343 4317 	355 4298 	355 4272 	380 4237
			418 4203 	470 4176 	500 4157 	508 4140 	513 4125
			510 4110 	518 4097 	543 4088 	580 4079 	585 4065
			573 4044 	558 4020 	548 4000 	545 3985 	538 3973
			548 3964 	558 3957 	553 3949 	558 3941 	560 3930
			550 3918 	535 3905 	540 3892 	533 3879 	530 3868
			518 3858 	520 3849 	523 3841 	533 3834 	525 3827
			523 3821 	538 3816 	538 3811 	530 3806 	543 3801
			553 3797 	553 3792 	548 3789 	560 3787 	573 3785
			565 3783 	588 3781 	598 3780 	608 3778 	625 3776
			648 3774 	688 3771 	710 3767 	735 3763 	773 3758
			800 3752 	833 3746 	858 3738 	893 3730 	925 3721
			958 3712 	1005 3704 	1055 3698 	1128 3694 	1233 3690
			1233 3685 	1233 3672 	1233 3641 	1233 3576 	1233 3476
			1233 3417 	1233 3363 	1233 3307 	1233 3257 	1233 3209
			1233 3168 	1233 3139 	1233 3117 	1233 3100 	1233 3100
		>;
		r_profile_t2_num = <80>;
		r_profile_t2 = <
			248 4340 	248 4315 	248 4295 	248 4277 	250 4261
			253 4245 	250 4229 	250 4214 	250 4199 	250 4184
			253 4170 	253 4155 	255 4141 	255 4127 	255 4113
			258 4099 	258 4085 	258 4074 	268 4066 	268 4054
			265 4033 	263 4013 	263 3998 	265 3988 	270 3982
			290 3974 	290 3965 	295 3956 	295 3946 	298 3937
			295 3927 	295 3917 	295 3907 	288 3894 	278 3879
			268 3866 	260 3854 	258 3845 	258 3838 	255 3831
			255 3825 	253 3819 	255 3814 	255 3809 	255 3805
			258 3801 	258 3797 	258 3793 	258 3789 	258 3786
			260 3784 	258 3781 	255 3778 	255 3776 	255 3774
			253 3771 	253 3768 	253 3765 	255 3761 	255 3756
			250 3750 	258 3746 	255 3741 	258 3735 	263 3727
			260 3718 	265 3710 	265 3699 	268 3692 	273 3690
			283 3688 	298 3686 	318 3681 	333 3660 	355 3603
			410 3521 	410 3393 	410 3180 	410 3115 	410 3115
		>;
		r_profile_t3_num = <80>;
		r_profile_t3 = <
			153 4367 	153 4336 	150 4312 	150 4292 	150 4274
			148 4257 	148 4241 	148 4225 	148 4210 	148 4195
			150 4180 	150 4165 	153 4151 	150 4136 	153 4122
			153 4108 	153 4094 	153 4080 	155 4067 	155 4054
			155 4041 	155 4028 	158 4016 	158 4004 	158 3993
			160 3982 	160 3971 	163 3961 	163 3951 	165 3941
			168 3932 	173 3923 	175 3914 	178 3905 	178 3894
			168 3878 	155 3862 	148 3850 	148 3842 	145 3834
			145 3827 	145 3821 	145 3815 	153 3811 	148 3806
			148 3801 	150 3797 	150 3792 	153 3788 	153 3784
			158 3781 	163 3779 	158 3776 	158 3773 	160 3771
			158 3767 	145 3758 	143 3749 	145 3745 	148 3741
			145 3736 	145 3731 	148 3727 	148 3722 	148 3716
			148 3707 	148 3699 	150 3691 	145 3679 	148 3677
			150 3675 	153 3673 	155 3670 	155 3661 	160 3622
			170 3557 	185 3462 	185 3294 	185 3049 	185 3049
		>;
	};
};

