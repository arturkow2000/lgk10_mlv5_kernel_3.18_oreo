## drivers/misc/mediatek/lcm/sw49107_lgd_hdplus_dsi_cmd_cv7a/Kconfig
```kconfig
config SW49107_LGD_HDPLUS_DSI_CMD_CV7A
	bool "Enable LGD SW49107 INCELL Command Mode HD+ panel for CV7A"
	default n
	help
		LGD SW49106 INCELL Command Mode HD+ panel for CV7A
```

## drivers/misc/mediatek/lcm/sw49107_tovis_fhdplus_dsi_cmd_cv7a/Kconfig
```kconfig
config SW49107_TOVIS_FHDPLUS_DSI_CMD_CV7A
	bool "Enable TOVIS SW49107 INCELL Command Mode FHD+ panel for CV7A"
	default n
	help
		TOVIS SW49106 INCELL Command Mode FHD+ panel for CV7A
```

## drivers/misc/mediatek/lcm/td4100_hd720_dsi_vdo_tovis_lv5/Kconfig
```kconfig
config TOVIS_INCELL_TD4100_HD_LV5
        bool "Enable TOVIS TD4100 INCELL HD panel for LV5"
        default n
```

## drivers/misc/mediatek/lcm/td4100_hd720_dsi_vdo_tovis_lv7/Kconfig
```kconfig
config TOVIS_INCELL_TD4100_HD_LV7_SPR
	bool "Enable TOVIS TD4100 INCELL HD panel for LV7_SPR"
	default n
	help
		TOVIS TD4100 INCELL HD panel for LV7_SPR
```

## drivers/misc/mediatek/sensors-0.0/Kconfig
```kconfig
source "drivers/misc/mediatek/sensors-0.0/accelerometer/Kconfig"
source "drivers/misc/mediatek/sensors-0.0/alsps/Kconfig"
source "drivers/misc/mediatek/sensors-0.0/magnetometer/Kconfig"
source "drivers/misc/mediatek/sensors-0.0/hwmon/Kconfig"
source "drivers/misc/mediatek/sensors-0.0/sensor_cal/Kconfig"
```

## drivers/misc/mediatek/sensors-0.0/accelerometer/k303b-acc-new/Kconfig
```kconfig
config MTK_K303B_ACC_NEW
	bool "K303B for LGE Devices"
	default n
	help
	  It support different accelerometer sensor.
          If this option is set,
	  it will support
          K303B Accelerometer.
```

## drivers/misc/mediatek/sensors-0.0/hwmon/Kconfig
```kconfig
config LGE_SENSOR_SLOPE_DETECTOR
  bool CONFIG_LGE_SENSOR_SLOPE_DETECTOR
  default n
  help
    CONFIG_LGE_SENSOR_SLOPE_DETECTOR

config LGE_SENSOR_UNIFIED_NODE
  bool CONFIG_LGE_SENSOR_UNIFIED_NODE
  default n
  help
    CONFIG_LGE_SENSOR_UNIFIED_NODE

config MTK_HWMON
  bool CONFIG_MTK_HWMON
  default n
  help
    CONFIG_MTK_HWMON
```

## drivers/misc/mediatek/sensors-1.0/accelerometer/BHI160_ACC/Kconfig
```kconfig
#
# Makefile for Bosch sensors driver.
#
config MTK_BHI160_ACC
	bool "MTK_BHI160_ACC for MediaTek package"
	default n
	help
	  It support different accelerometer sensor.
          If this option is set,
	  it will support
          MTK_BHI160 Accelerometer.
```

## drivers/misc/mediatek/sensors-1.0/accelerometer/bhy/Kconfig
```kconfig
#
# Makefile for Bosch sensors driver.
#
config MTK_BHY_ACC
	bool "MTK_BHY_ACC for MediaTek package"
	default n
	help
	  It support different accelerometer sensor.
          If this option is set,
	  it will support
          MTK_BHY Accelerometer.
```

## drivers/misc/mediatek/sensors-1.0/accelerometer/icm406xx_a/Kconfig
```kconfig
config MTK_ICM406XX_A
        bool "ICM406XX for MediaTek package"
        default n
        help
        It support different accelerometer sensor.
        If this option is set,
	  	it will support
         ICM406XX accelerometer.
```

## drivers/misc/mediatek/sensors-1.0/accelerometer/k2hh/Kconfig
```kconfig
config MTK_K2HH_ACC
	bool "K2HH for MediaTek package"
	default n
	help
	  It support different accelerometer sensor.
          If this option is set,
	  it will support
          K2hh Accelerometer.
```

## drivers/misc/mediatek/sensors-1.0/accelerometer/k303b_acc/Kconfig
```kconfig
config MTK_K303B_ACC
	bool "K303B for MediaTek package"
	default n
	help
	  It support different accelerometer sensor.
          If this option is set,
	  it will support
          k303b Accelerometer.
```

## drivers/misc/mediatek/sensors-1.0/barometer/SPL06/Kconfig
```kconfig
config MTK_SPL06
	tristate "SPL06 digital Pressure Sensor"
	depends on I2C && SYSFS
	help
	 If you say yes here, you get support for Goertek's SPL06 digital pressure sensors.
```

## drivers/misc/mediatek/sensors-1.0/gyroscope/BHI160_GYRO/Kconfig
```kconfig
config MTK_BHI160_GYRO
        bool "MTK_BHI160_GYRO for MediaTek package"
        default n
        help
        It support different gyroscope sensor.
        If this option is set,
	  	it will support
        MTK_BHI160 gyroscope.
```

## drivers/misc/mediatek/sensors-1.0/gyroscope/bhygy/Kconfig
```kconfig
config MTK_BHY_GYRO
        bool "MTK_BHY_GYRO for MediaTek package"
        default n
        help
        It support different gyroscope sensor.
        If this option is set,
	  	it will support
        bhy gyroscope.
```

## drivers/misc/mediatek/sensors-1.0/gyroscope/icm406xx_g/Kconfig
```kconfig
config MTK_ICM406XX_G
        bool "ICM406XX for MediaTek package"
        default n
        help
        It support different gyroscope sensor.
        If this option is set,
	  	it will support
         ICM406XX gyroscope.
```

## drivers/misc/mediatek/sensors-1.0/hwmon/Kconfig
```kconfig
config LGE_SENSOR_UNIFIED_NODE
  bool CONFIG_LGE_SENSOR_UNIFIED_NODE
  default n
  help
    CONFIG_LGE_SENSOR_UNIFIED_NODE

config MTK_HWMON
	bool "MTK HWMON Config"
	default n
	help
	  CONFIG_MTK_HWMON for sensor common util
```

## drivers/misc/mediatek/sensors-1.0/magnetometer/akm09918/Kconfig
```kconfig
config MTK_AKM09916
	bool "AKM09916 for MediaTek package"
	default n
	help
	  It support different magnetometer sensor.
	  If this option is set,
	  it will support
	  AKMD09916 magnetometer.

config MTK_AKM09918
	bool "AKM09918 for MediaTek package"
	default n
	help
	  It support different magnetometer sensor.
	  If this option is set,
	  it will support
	  AKMD09918 magnetometer.
```

## drivers/misc/mediatek/sensors-1.0/magnetometer/k303b-mag/Kconfig
```kconfig
config MTK_K303B_MAG
	bool "K303B for MediaTek package"
	default n
	help
	  It support different magnetometer sensor.
          If this option is set,
	  it will support
          K303B Magnetometer.
```

## drivers/misc/mediatek/sensors-1.0/situation/BHI160_GESTURE/Kconfig
```kconfig
config MTK_BHI160_GESTURE
        bool "BHI160 gesture for MediaTek package"
        default n
        help
        It support different gesture sensor.
        If this option is set,
	  	it will support
        BHI160 gesture.
```

## drivers/misc/mediatek/sensors-1.0/situation/bhy_gesture/Kconfig
```kconfig
config MTK_BHY_GESTURE
        bool "BHY gesture for MediaTek package"
        default n
        help
        It support different gesture sensor.
        If this option is set,
	  	it will support
        BHY gesture.
```

## drivers/misc/mediatek/sensors-1.0/situation/bmi160_stc/Kconfig
```kconfig
config LGE_SENSOR_SLOPE_DETECTOR
	bool CONFIG_LGE_SENSOR_SLOPE_DETECTOR
	default n
	help
	  CONFIG_LGE_SENSOR_SLOPE_DETECTOR
```

## drivers/misc/mediatek/sensors-1.0/step_counter/icm406xx_sc/Kconfig
```kconfig
config MTK_ICM406XX_SC
        bool "ICM406XX for MediaTek package"
        default n
        help
        It support different step_counter sensor.
        If this option is set,
	  	it will support
         ICM406XX step_counter.
```

## drivers/misc/mediatek/thermal/Kconfig
```kconfig
config MTK_THERMAL_PA_VIA_ATCMD
	bool "MTK_THERMAL_PA_VIA_ATCMD"
	help
	  Internal switch for thermal management to query modem RF
	  temperature via AT command.

config LGE_PM_VTS
	bool "LG Electronic Virtual Thermal Sensor"
	default n
	depends on THERMAL
	help
	  Virtual Sensor representing real world temperature

config FEATURE_MUTT_CA_CONTROL
	bool "MUTT_CA_CONTROL_COOLER"
	default n
	depends on THERMAL
	help
	  Feature to control CA cooler
```

## drivers/misc/mediatek/video/Kconfig
```kconfig
menuconfig MTK_FB
	bool "MediaTek Framebuffer Driver"
	depends on FB
	select FB_CFB_FILLRECT
	select FB_CFB_COPYAREA
	select FB_CFB_IMAGEBLIT
	select FB_SOFT_CURSOR
	---help---
	  This selects the MediaTek(R) frame buffer driver.
	  If you want to use MediaTek(R) frame buffer diver, say Y here.
	  If unsure, say N.

config MTK_VIDEOX
	bool CONFIG_MTK_VIDEOX
	default n
	help
	  CONFIG_MTK_VIDEOX

config MTK_LCM_PHYSICAL_ROTATION
	string "MTK_LCM_PHYSICAL_ROTATION"
	help
	  To set the angle between dimension of UI layout and LCM scan
	  direction

config LCM_HEIGHT
	string "LCM_HEIGHT"
	default "1920"
	help
	  To set LCM resolution height size

config LCM_WIDTH
	string "LCM_WIDTH"
	default "1080"
	help
	  To set LCM resolution width size

config CUSTOM_LCM_X
	string "LCM_X"
	default "0"
	help
	  To set CUSTOM_LCM_X size

config CUSTOM_LCM_Y
	string "LCM_Y"
	default "0"
	help
	  To set CUSTOM_LCM_Y size

config MTK_FB_SUPPORT_ASSERTION_LAYER
	bool "AEE Assertion Layer Support"
	depends on MTK_FB
	select FONT_SUPPORT
	select FONT_8x16
	default y
	---help---
	  This enable support for AEE assertion layer.
	  If you want to enable AEE assertion layer support, say Y here.
	  If unsure, say N.

config MTK_AAL_SUPPORT
	bool "MTK_AAL_SUPPORT"
	default n
	help
	  Decide whether to support ambient-light adaptive luma and
	  display visual enhancement.
	  This feature requires the cowork of AAL user-space algorithm process.
	  Please also turn on MTK_AAL_SUPPORT in ProjectConfig.mk.

config MTK_OD_SUPPORT
	bool "MTK_OD_SUPPORT"
	default n
	help
	  Over drive LCD to enhance the response time.
	  On high frame rate (e.g. 120Hz) platform, the LCD response time is
	  not short enough to display clear moving objects.
	  This feature allows to speed up the change time of each pixels.
	  MUST fill the over-drive table correctly according to LCD property.
config SINGLE_PANEL_OUTPUT
	bool "SINGLE_PANEL_OUTPUT"
	default n
	help
	  Decide whether to support single panel display feature.
	  Panel and tv can't not display at the same time.
	  When hdmi plug in, only show display in tv, panle will be black screen.
	  And when hdmi plug out, panel will resume.

config MTK_OVERLAY_ENGINE_SUPPORT
	bool "MTK_OVERLAY_ENGINE_SUPPORT"
	default n
	help
	  This enable support overlay time division multiplex.

config MTK_CONSUMER_PARTIAL_UPDATE_SUPPORT
	bool "MTK_CONSUMER_PARTIAL_UPDATE_SUPPORT"
	default n
	help
	  This enable support display partial support.

config MTK_ROUND_CORNER_SUPPORT
	bool "enable medietak display round corner"
	default n
	help
	  define CONFIG_MTK_ROUND_CORNER_SUPPORT to enable Mediatek Round Corner on display.
	  If you want to use Meditek Round Corner on display, please make sure it is Y in xxx_defconfig.mk.
	  This feature require round corner pattern provided in lcm driver folder.
	  If unsure, set N.

config MTK_PQ_COLOR_MODE
	string "Config PQ_COLOR_MODE (MDP & DISP COLOR on/off)"
	default "DISP"
	help
	  This control mdp color on/off and disp color on/off
	  if value equals to DISP, only display color is on.
	  if value equals to MDP, only mdp color is on.
	  if value equals to DISP_MDP, mdp and display color are both on.
	  if value equals to OFF, mdp and display color are both off.

config LCM_SEND_CMD_IN_VIDEO
	bool LCM_SEND_CMD_IN_VIDEO
	help
	  To send display off and sleep in command to Display IC on Mipi HS mode.

config LGE_READER_MODE
        bool "LGE reader mode"
        default n
        help
          The reader mode provides support to change color temperature
          by sending proper cmds to panel.

config LGE_COMFORT_VIEW
        bool "LGE comfort mode"
        default n
        help
          The comfort view provides support to change color temperature
          by sending proper cmds to panel.

config LGE_LCM_SETTING
        bool "LGE_LCM_SETTING"
        default n
        help
            control the lcm porch value and pll_clock ssc value
            by sending the MIPI parameter to the DDIC.

config LGE_LCM_BACKLIGHT_PWM
        bool "LGE_LCM_BACKLIGHT_PWM"
        default n
        help
            To check backlight pwm or normal backlight

config BACKLIGHT_DRIVER_REG_TUNING
        bool "LGE_BACKLIGHT_DRIVER_REG_TUNING"
        default n
        help
            control the backlight/dsv registers.

config LGE_DSI_PARAM_TUNING
        bool "LGE_DSI_PARAM_TUNING"
        default n
        help
            control the lcm porch value and pll_clock ssc value
            by sending the MIPI parameter to the DDIC.

config LGE_INIT_CMD_TUNING
        bool "LGE_INIT_CMD_TUNING"
        default n
        help
            control the init commands by sending the MIPI parameter to the DDIC.

config LGE_BACKLIGHT_BRIGHTNESS_TUNING
        bool "LGE_BACKLIGHT_BRIGHTNESS_TUNING"
        default n
        help
            control the backlight brightness.

config LGE_VSYNC_SKIP
        bool "LGE_VSYNC_SKIP"
        default n
        help
            CONFIG_LGE_VSYNC_SKIP

config LGE_INTERVAL_MONITOR
	bool "Frame Interval Monitor"
	---help---
	This feature provides Frame Interval Monitor scheme.

config LGE_FBCN
	bool "Frame Based Clock Normalizer"
	---help---
	This feature provides Frame Based Clock Normalizer scheme.

config TUNING_MIPI_CLOCK
        bool "TUNING_TUNING_MIPI_CLOCK"
        default n
        help
          Control the pll clock by sending the MIPI parameter to the DDIC.

config LGE_USE_TOUCH_NOTIFIER
        bool "LGE_USE_TOUCH_NOTIFIER"
        default n
        help
          This feature provides support to using the touch notifier.
```
